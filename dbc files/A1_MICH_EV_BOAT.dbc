VERSION ""

NS_ :

BS_:

BU_:

BO_ 550 command1: 8 Vector__XXX
 SG_ throttleCurrent : 0|16@1- (1,0) [0|0] "" Vector__XXX

BO_ 2 receive1: 8 Vector__XXX
 SG_ controllerTemp : 0|16@1- (1,0) [0|0] "10*C" Vector__XXX
 SG_ motorTemp : 16|16@1+ (1,0) [0|0] "" Vector__XXX
