VERSION ""

NS_ :

BS_:
BU_: BCM DST

BO_ 1120 BCM_Faults: 8 BCM
 SG_ bcm_dtc_060 m30 : 47|24@0+ (1,0) [0|16777215] "DTC ID" Vector__XXX
 SG_ bcm_dtc_061 m31 : 23|24@0+ (1,0) [0|16777215] "DTC ID" Vector__XXX
 SG_ bcm_dtc_062 m31 : 47|24@0+ (1,0) [0|16777215] "DTC ID" Vector__XXX
 SG_ bcm_dtc_063 m32 : 23|24@0+ (1,0) [0|16777215] "DTC ID" Vector__XXX
 SG_ bcm_dtc_064 m32 : 47|24@0+ (1,0) [0|16777215] "DTC ID" Vector__XXX
 SG_ bcm_dtc_065 m33 : 23|24@0+ (1,0) [0|16777215] "DTC ID" Vector__XXX
 SG_ bcm_dtc_066 m33 : 47|24@0+ (1,0) [0|16777215] "DTC ID" Vector__XXX
 SG_ bcm_dtc_067 m34 : 23|24@0+ (1,0) [0|16777215] "DTC ID" Vector__XXX
 SG_ bcm_dtc_068 m34 : 47|24@0+ (1,0) [0|16777215] "DTC ID" Vector__XXX
 SG_ bcm_dtc_069 m35 : 23|24@0+ (1,0) [0|16777215] "DTC ID" Vector__XXX
 SG_ bcm_dtc_070 m35 : 47|24@0+ (1,0) [0|16777215] "DTC ID" Vector__XXX
 SG_ bcm_dtc_071 m36 : 23|24@0+ (1,0) [0|16777215] "DTC ID" Vector__XXX
 SG_ bcm_dtc_072 m36 : 47|24@0+ (1,0) [0|16777215] "DTC ID" Vector__XXX
 SG_ bcm_dtc_073 m37 : 23|24@0+ (1,0) [0|16777215] "DTC ID" Vector__XXX
 SG_ bcm_dtc_074 m37 : 47|24@0+ (1,0) [0|16777215] "DTC ID" Vector__XXX
 SG_ bcm_dtc_page M : 7|8@0+ (1,0) [0|255] "page number" Vector__XXX

VAL_ 1120 bcm_dtc_060 0 " - " 11276288 "DTC_VEPO" 11276289 "DTC_HSC_MISSING" 11460608 "DTC_NVM_SOC" 11460609 "DTC_NVM_HYST" 11460610 "DTC_NVM_KOT" 11460611 "DTC_NVM_PERIODIC_SHUTDOWN_TIME" 11460612 "DTC_NVM_WAKE" 11460613 "DTC_NVM_CALENDAR_LIFE" 11460614 "DTC_NVM_CYCLE_LIFE" 11460615 "DTC_NVM_DTC" 11460616 "DTC_NVM_APP_SCRATCHPAD" 11517962 "DTC_LOOPTIME_TASK_A" 11517963 "DTC_LOOPTIME_TASK_B" 11517964 "DTC_LOOPTIME_TASK_C" 11517965 "DTC_LOOPTIME_TASK_D" 11517966 "DTC_LOOPTIME_TASK_E" 11517967 "DTC_ILIM_MAX_DISCHARGE" 15728640 "DTC_EPO" 16171008 "DTC_CONT_OPEN" 16171009 "DTC_CONT_CLOSE" 16171010 "DTC_CONT_OPEN_CURRENT" 16171264 "DTC_CONT_CLOSE_ON_RESET" 16171265 "DTC_CONT_CLOSE_SIG_FAILED" 16171520 "DTC_PRECHARGE_TIMEOUT" 16171777 "DTC_CONT_NEG_WELD_AT_SU" 16171778 "DTC_CONT_POS_A_WELD_AT_SU" 16171779 "DTC_CONT_POS_B_WELD_AT_SU" 16172033 "DTC_CONT_NEG_WELD_AT_SD" 16172034 "DTC_CONT_POS_A_WELD_AT_SD" 16172036 "DTC_CONT_POS_B_WELD_AT_SD" 16172289 "DTC_CONT_NEG_OPEN" 16172290 "DTC_CONT_POS_A_OPEN" 16172291 "DTC_CONT_POS_B_OPEN" 16172545 "DTC_CONT_NEG_VDIF" 16172546 "DTC_CONT_POS_A_VDIF" 16172548 "DTC_CONT_POS_B_VDIF" 16174848 "DTC_HVIL" 16174849 "DTC_LVBAT_LO" 16174850 "DTC_LVBAT_HI" 16174851 "DTC_LVBAT_ERR" 16522240 "DTC_CSM_MISSING" 16522752 "DTC_CSM_VBAT" 16522753 "DTC_CSM_VPOS" 16522754 "DTC_CSM_VNEG" 16522755 "DTC_CSM_CPOS" 16522756 "DTC_CSM_CNEG" 16522757 "DTC_CSM_APOS" 16522758 "DTC_CSM_ANEG" 16522759 "DTC_CSM_FUSE_HI" 16522760 "DTC_CSM_FUSE_LO" 16521728 "DTC_CSM_ASIC" 16521729 "DTC_CSM_AILO" 16521730 "DTC_CSM_AIHI" 16520957 "DTC_LEAKAGE_DETECT_FAULT" 16522444 "DTC_REALTIMECLOCK_FAULT" 16520945 "DTC_CSM_LEAK_FAIL_CALC" 16520946 "DTC_CSM_LEAK_FAIL_HW" 16520947 "DTC_CSM_LEAK_EXT_SHORT" 16520948 "DTC_CSM_LEAK_MID_PACK_SHORT" 16520949 "DTC_CSM_LEAK_ERROR" 16520950 "DTC_CSM_LEAK_UNKNOWN" 16523008 "DTC_CSM_VER_MISMATCH" 16523009 "DTC_CSM_DTC_SET" 16523010 "DTC_CSM_CAL_FAULT" 16496320 "DTC_MBB_TOO_FEW" 16496321 "DTC_MBB_TOO_MANY" 16496352 "DTC_CELL_VMAX_ERR" 16496353 "DTC_CELL_VMIN_ERR" 16496354 "DTC_CELL_VMAX" 16496362 "DTC_CELL_VMAX_SEVERE" 16496355 "DTC_CELL_VMIN" 16496363 "DTC_CELL_VMIN_SEVERE" 16496356 "DTC_MOD_VOLTAGE_COMPARE" 16496336 "DTC_CELL_T_ERR" 16496337 "DTC_CELL_TMAX1" 16496338 "DTC_CELL_TMAX2" 16496339 "DTC_CELL_TMIN" 16497665 "DTC_MBB_01_MISSING" 16497666 "DTC_MBB_02_MISSING" 16497667 "DTC_MBB_03_MISSING" 16497668 "DTC_MBB_04_MISSING" 16497669 "DTC_MBB_05_MISSING" 16497670 "DTC_MBB_06_MISSING" 16497671 "DTC_MBB_07_MISSING" 16497672 "DTC_MBB_08_MISSING" 16497673 "DTC_MBB_09_MISSING" 16497680 "DTC_MBB_10_MISSING" 16497681 "DTC_MBB_11_MISSING" 16497682 "DTC_MBB_12_MISSING" 16497683 "DTC_MBB_13_MISSING" 16497684 "DTC_MBB_14_MISSING" 16497685 "DTC_MBB_15_MISSING" 16497686 "DTC_MBB_16_MISSING" 16497687 "DTC_MBB_17_MISSING" 16497688 "DTC_MBB_18_MISSING" 16497689 "DTC_MBB_19_MISSING" 16497696 "DTC_MBB_20_MISSING" 16497697 "DTC_MBB_21_MISSING" 16497698 "DTC_MBB_22_MISSING" 16497699 "DTC_MBB_23_MISSING" 16497700 "DTC_MBB_24_MISSING" 16498177 "DTC_MBB_01_VFAULT" 16498178 "DTC_MBB_02_VFAULT" 16498179 "DTC_MBB_03_VFAULT" 16498180 "DTC_MBB_04_VFAULT" 16498181 "DTC_MBB_05_VFAULT" 16498182 "DTC_MBB_06_VFAULT" 16498183 "DTC_MBB_07_VFAULT" 16498184 "DTC_MBB_08_VFAULT" 16498185 "DTC_MBB_09_VFAULT" 16498192 "DTC_MBB_10_VFAULT" 16498193 "DTC_MBB_11_VFAULT" 16498194 "DTC_MBB_12_VFAULT" 16498195 "DTC_MBB_13_VFAULT" 16498196 "DTC_MBB_14_VFAULT" 16498197 "DTC_MBB_15_VFAULT" 16498198 "DTC_MBB_16_VFAULT" 16498199 "DTC_MBB_17_VFAULT" 16498200 "DTC_MBB_18_VFAULT" 16498201 "DTC_MBB_19_VFAULT" 16498208 "DTC_MBB_20_VFAULT" 16498209 "DTC_MBB_21_VFAULT" 16498210 "DTC_MBB_22_VFAULT" 16498211 "DTC_MBB_23_VFAULT" 16498212 "DTC_MBB_24_VFAULT" 16497921 "DTC_MBB_01_TFAULT" 16497922 "DTC_MBB_02_TFAULT" 16497923 "DTC_MBB_03_TFAULT" 16497924 "DTC_MBB_04_TFAULT" 16497925 "DTC_MBB_05_TFAULT" 16497926 "DTC_MBB_06_TFAULT" 16497927 "DTC_MBB_07_TFAULT" 16497928 "DTC_MBB_08_TFAULT" 16497929 "DTC_MBB_09_TFAULT" 16497936 "DTC_MBB_10_TFAULT" 16497937 "DTC_MBB_11_TFAULT" 16497938 "DTC_MBB_12_TFAULT" 16497939 "DTC_MBB_13_TFAULT" 16497940 "DTC_MBB_14_TFAULT" 16497941 "DTC_MBB_15_TFAULT" 16497942 "DTC_MBB_16_TFAULT" 16497943 "DTC_MBB_17_TFAULT" 16497944 "DTC_MBB_18_TFAULT" 16497945 "DTC_MBB_19_TFAULT" 16497952 "DTC_MBB_20_TFAULT" 16497953 "DTC_MBB_21_TFAULT" 16497954 "DTC_MBB_22_TFAULT" 16497955 "DTC_MBB_23_TFAULT" 16497956 "DTC_MBB_24_TFAULT" 16498688 "DTC_BRUSA_MISSING" 16498689 "DTC_BRUSA_IDC" 16498690 "DTC_BRUSA_REQ_VS_CMD" 16560128 "DTC_IBAT_MISMATCH" 16576512 "DTC_DIS_MAX_I2T" 16576513 "DTC_CHG_MAX_I2T" 16576768 "DTC_DIS_WARNING_I2T" 16576769 "DTC_CHG_WARNING_I2T" 16523520 "DTC_LEM_A_OOR_HI" 16523521 "DTC_LEM_A_OOR_LO" 16523522 "DTC_LEM_A_FAULT" 16523776 "DTC_LEM_B_OOR_HI" 16523777 "DTC_LEM_B_OOR_LO" 16523778 "DTC_LEM_B_FAULT" 16506880 "DTC_VBAT_MISMATCH" 16506881 "DTC_VBAT_VMAX" 16506882 "DTC_VBAT_VMIN" 16506883 "DTC_PACK_FUSE_A" 16506884 "DTC_PACK_FUSE_B" 16252928 "DTC_KEY_OFF_TIME_ERROR" 16252929 "DTC_PERIODIC_OFF_TIME_ERROR" 14290944 "DTC_AIN_BPWR_FAIL_LO" 14290945 "DTC_AIN_BPWR_FAIL_HI" 14290946 "DTC_AIN_BPWR_OOR_LO" 14290947 "DTC_AIN_BPWR_OOR_HI" 14290960 "DTC_AIN_14V_FAIL_LO" 14290961 "DTC_AIN_14V_FAIL_HI" 14290962 "DTC_AIN_14V_OOR_LO" 14290963 "DTC_AIN_14V_OOR_HI" 14290976 "DTC_AIN_HPWR_FAIL_LO" 14290977 "DTC_AIN_HPWR_FAIL_HI" 14290978 "DTC_AIN_HPWR_OOR_LO" 14290979 "DTC_AIN_HPWR_OOR_HI" 14290992 "DTC_AIN_6V_FAIL_LO" 14290993 "DTC_AIN_6V_FAIL_HI" 14290994 "DTC_AIN_6V_OOR_LO" 14290995 "DTC_AIN_6V_OOR_HI" 14291008 "DTC_AIN_HVIL_FAIL_LO" 14291009 "DTC_AIN_HVIL_FAIL_HI" 14291010 "DTC_AIN_HVIL_OOR_LO" 14291011 "DTC_AIN_HVIL_OOR_HI" 14291024 "DTC_AIN_5V_PWR_FAIL_LO" 14291025 "DTC_AIN_5V_PWR_FAIL_HI" 14291026 "DTC_AIN_5V_PWR_OOR_LO" 14291027 "DTC_AIN_5V_PWR_OOR_HI" 14291040 "DTC_AIN_LEM_HI_FAIL_LO" 14291041 "DTC_AIN_LEM_HI_FAIL_HI" 14291042 "DTC_AIN_LEM_HI_OOR_LO" 14291043 "DTC_AIN_LEM_HI_OOR_HI" 14291056 "DTC_AIN_LEM_LO_FAIL_LO" 14291057 "DTC_AIN_LEM_LO_FAIL_HI" 14291058 "DTC_AIN_LEM_LO_OOR_LO" 14291059 "DTC_AIN_LEM_LO_OOR_HI" 14291072 "DTC_AIN_BCT_AI_FAIL_LO" 14291073 "DTC_AIN_BCT_AI_FAIL_HI" 14291074 "DTC_AIN_BCT_AI_OOR_LO" 14291075 "DTC_AIN_BCT_AI_OOR_HI" 14291088 "DTC_AIN_WTR2_AI_FAIL_LO" 14291089 "DTC_AIN_WTR2_AI_FAIL_HI" 14291090 "DTC_AIN_WTR2_AI_OOR_LO" 14291091 "DTC_AIN_WTR2_AI_OOR_HI" 14291104 "DTC_AIN_WTR1_AI_FAIL_LO" 14291105 "DTC_AIN_WTR1_AI_FAIL_HI" 14291106 "DTC_AIN_WTR1_AI_OOR_LO" 14291107 "DTC_AIN_WTR1_AI_OOR_HI" 14291120 "DTC_AIN_AIA_FAIL_LO" 14291121 "DTC_AIN_AIA_FAIL_HI" 14291122 "DTC_AIN_AIA_OOR_LO" 14291123 "DTC_AIN_AIA_OOR_HI" 14291136 "DTC_AIN_PROX_AI_FAIL_LO" 14291137 "DTC_AIN_PROX_AI_FAIL_HI" 14291138 "DTC_AIN_PROX_AI_OOR_LO" 14291139 "DTC_AIN_PROX_AI_OOR_HI" 14291152 "DTC_AIN_TWV_FB_FAIL_LO" 14291153 "DTC_AIN_TWV_FB_FAIL_HI" 14291154 "DTC_AIN_TWV_FB_OOR_LO" 14291155 "DTC_AIN_TWV_FB_OOR_HI" 14291168 "DTC_AIN_5V_KA_FAIL_LO" 14291169 "DTC_AIN_5V_KA_FAIL_HI" 14291170 "DTC_AIN_5V_KA_OOR_LO" 14291171 "DTC_AIN_5V_KA_OOR_HI" 14291184 "DTC_AIN_CTR1_LSD_FAIL_LO" 14291185 "DTC_AIN_CTR1_LSD_FAIL_HI" 14291186 "DTC_AIN_CTR1_LSD_OOR_LO" 14291187 "DTC_AIN_CTR1_LSD_OOR_HI" 14291200 "DTC_AIN_CTR2_LSD_FAIL_LO" 14291201 "DTC_AIN_CTR2_LSD_FAIL_HI" 14291202 "DTC_AIN_CTR2_LSD_OOR_LO" 14291203 "DTC_AIN_CTR2_LSD_OOR_HI" 14291216 "DTC_AIN_CTR3_LSD_FAIL_LO" 14291217 "DTC_AIN_CTR3_LSD_FAIL_HI" 14291218 "DTC_AIN_CTR3_LSD_OOR_LO" 14291219 "DTC_AIN_CTR3_LSD_OOR_HI" 14291232 "DTC_AIN_CTR4_LSD_FAIL_LO" 14291233 "DTC_AIN_CTR4_LSD_FAIL_HI" 14291234 "DTC_AIN_CTR4_LSD_OOR_LO" 14291235 "DTC_AIN_CTR4_LSD_OOR_HI" 14291248 "DTC_AIN_CTR5_LSD_FAIL_LO" 14291249 "DTC_AIN_CTR5_LSD_FAIL_HI" 14291250 "DTC_AIN_CTR5_LSD_OOR_LO" 14291251 "DTC_AIN_CTR5_LSD_OOR_HI" 14291264 "DTC_AIN_CTR6_LSD_FAIL_LO" 14291265 "DTC_AIN_CTR6_LSD_FAIL_HI" 14291266 "DTC_AIN_CTR6_LSD_OOR_LO" 14291267 "DTC_AIN_CTR6_LSD_OOR_HI" 14291280 "DTC_AIN_CTR7_LSD_FAIL_LO" 14291281 "DTC_AIN_CTR7_LSD_FAIL_HI" 14291282 "DTC_AIN_CTR7_LSD_OOR_LO" 14291283 "DTC_AIN_CTR7_LSD_OOR_HI" 14291296 "DTC_AIN_CTR_PWR_CUR_FAIL_LO" 14291297 "DTC_AIN_CTR_PWR_CUR_FAIL_HI" 14291298 "DTC_AIN_CTR_PWR_CUR_OOR_LO" 14291299 "DTC_AIN_CTR_PWR_CUR_OOR_HI" 14291312 "DTC_AIN_CTR_HLD_CUR_FAIL_LO" 14291313 "DTC_AIN_CTR_HLD_CUR_FAIL_HI" 14291314 "DTC_AIN_CTR_HLD_CUR_OOR_LO" 14291315 "DTC_AIN_CTR_HLD_CUR_OOR_HI" 13431040 "DTC_CTR_FAULT_LATCH" 13431041 "DTC_CTR_FAULT_INVALID_HEARTBEAT" 13373440 "DTC_CTR1_LSD_FAILED_LO" 13373441 "DTC_CTR1_LSD_FAILED_HI" 13373442 "DTC_CTR1_HSD_FAILED_LO" 13373443 "DTC_CTR1_HSD_FAILED_HI" 13373444 "DTC_CTR1_PULL_IN_SHORT" 13373445 "DTC_CTR1_PULL_IN_OPEN" 13373446 "DTC_CTR1_COIL_INVALID" 13373447 "DTC_CTR1_COIL_OPEN" 13373448 "DTC_CTR1_CIRCUIT_FAILED" 13377536 "DTC_CTR2_LSD_FAILED_LO" 13377537 "DTC_CTR2_LSD_FAILED_HI" 13377538 "DTC_CTR2_HSD_FAILED_LO" 13377539 "DTC_CTR2_HSD_FAILED_HI" 13377540 "DTC_CTR2_PULL_IN_SHORT" 13377541 "DTC_CTR2_PULL_IN_OPEN" 13377542 "DTC_CTR2_COIL_INVALID" 13377543 "DTC_CTR2_COIL_OPEN" 13377544 "DTC_CTR2_CIRCUIT_FAILED" 13381632 "DTC_CTR3_LSD_FAILED_LO" 13381633 "DTC_CTR3_LSD_FAILED_HI" 13381634 "DTC_CTR3_HSD_FAILED_LO" 13381635 "DTC_CTR3_HSD_FAILED_HI" 13381636 "DTC_CTR3_PULL_IN_SHORT" 13381637 "DTC_CTR3_PULL_IN_OPEN" 13381638 "DTC_CTR3_COIL_INVALID" 13381639 "DTC_CTR3_COIL_OPEN" 13381640 "DTC_CTR3_CIRCUIT_FAILED" 13385728 "DTC_CTR4_LSD_FAILED_LO" 13385729 "DTC_CTR4_LSD_FAILED_HI" 13385730 "DTC_CTR4_HSD_FAILED_LO" 13385731 "DTC_CTR4_HSD_FAILED_HI" 13385732 "DTC_CTR4_PULL_IN_SHORT" 13385733 "DTC_CTR4_PULL_IN_OPEN" 13385734 "DTC_CTR4_COIL_INVALID" 13385735 "DTC_CTR4_COIL_OPEN" 13385736 "DTC_CTR4_CIRCUIT_FAILED" 13389824 "DTC_CTR5_LSD_FAILED_LO" 13389825 "DTC_CTR5_LSD_FAILED_HI" 13389826 "DTC_CTR5_HSD_FAILED_LO" 13389827 "DTC_CTR5_HSD_FAILED_HI" 13389828 "DTC_CTR5_PULL_IN_SHORT" 13389829 "DTC_CTR5_PULL_IN_OPEN" 13389830 "DTC_CTR5_COIL_INVALID" 13389831 "DTC_CTR5_COIL_OPEN" 13389832 "DTC_CTR5_CIRCUIT_FAILED" 13393920 "DTC_CTR6_LSD_FAILED_LO" 13393921 "DTC_CTR6_LSD_FAILED_HI" 13393922 "DTC_CTR6_HSD_FAILED_LO" 13393923 "DTC_CTR6_HSD_FAILED_HI" 13393924 "DTC_CTR6_PULL_IN_SHORT" 13393925 "DTC_CTR6_PULL_IN_OPEN" 13393926 "DTC_CTR6_COIL_INVALID" 13393927 "DTC_CTR6_COIL_OPEN" 13393928 "DTC_CTR6_CIRCUIT_FAILED" 13398016 "DTC_CTR7_LSD_FAILED_LO" 13398017 "DTC_CTR7_LSD_FAILED_HI" 13398018 "DTC_CTR7_HSD_FAILED_LO" 13398019 "DTC_CTR7_HSD_FAILED_HI" 13398020 "DTC_CTR7_PULL_IN_SHORT" 13398021 "DTC_CTR7_PULL_IN_OPEN" 13398022 "DTC_CTR7_COIL_INVALID" 13398023 "DTC_CTR7_COIL_OPEN" 13398024 "DTC_CTR7_CIRCUIT_FAILED" 14483456 "DTC_DRV_SW14V_PWR_FAILED_LO" 14483457 "DTC_DRV_SW14V_PWR_FAILED_HI" 14483472 "DTC_DRV_CHRGA_ENA_FAILED_LO" 14483473 "DTC_DRV_CHRGA_ENA_FAILED_HI" 14483488 "DTC_DRV_CHRGB_ENA_FAILED_LO" 14483489 "DTC_DRV_CHRGB_ENA_FAILED_HI" 14483504 "DTC_DRV_LSDA_FAILED_LO" 14483505 "DTC_DRV_LSDA_FAILED_HI" 14483520 "DTC_DRV_LSDB_FAILED_LO" 14483521 "DTC_DRV_LSDB_FAILED_HI" 14483536 "DTC_DRV_HSDA_FAILED_LO" 14483537 "DTC_DRV_HSDA_FAILED_HI" 14483552 "DTC_DRV_HSDB_FAILED_LO" 14483553 "DTC_DRV_HSDB_FAILED_HI" 14553088 "DTC_ICM_FGD1_FAIL_LO" 14553089 "DTC_ICM_FGD1_FAIL_HI" 14553090 "DTC_ICM_FGD1_OOR_LO" 14553091 "DTC_ICM_FGD1_OOR_HI" 14553104 "DTC_ICM_FGD2_FAIL_LO" 14553105 "DTC_ICM_FGD2_FAIL_HI" 14553106 "DTC_ICM_FGD2_OOR_LO" 14553107 "DTC_ICM_FGD2_OOR_HI" 14553120 "DTC_ICM_PILOT_FAIL_LO" 14553121 "DTC_ICM_PILOT_FAIL_HI" 14553122 "DTC_ICM_PILOT_OOR_LO" 14553123 "DTC_ICM_PILOT_OOR_HI" 14553136 "DTC_ICM_MOD_FLT_FAIL_LO" 14553137 "DTC_ICM_MOD_FLT_FAIL_HI" 14553138 "DTC_ICM_MOD_FLT_OOR_LO" 14553139 "DTC_ICM_MOD_FLT_OOR_HI" 14553152 "DTC_ICM_CLK_FAIL_LO" 14553153 "DTC_ICM_CLK_FAIL_HI" 14553154 "DTC_ICM_CLK_OOR_LO" 14553155 "DTC_ICM_CLK_OOR_HI" 14553168 "DTC_ICM_LSD_A_FAIL_LO" 14553169 "DTC_ICM_LSD_A_FAIL_HI" 14553170 "DTC_ICM_LSD_A_OOR_LO" 14553171 "DTC_ICM_LSD_A_OOR_HI" 14553184 "DTC_ICM_LSD_B_FAIL_LO" 14553185 "DTC_ICM_LSD_B_FAIL_HI" 14553186 "DTC_ICM_LSD_B_OOR_LO" 14553187 "DTC_ICM_LSD_B_OOR_HI" 14553200 "DTC_ICM_PWM_A_FAIL_LO" 14553201 "DTC_ICM_PWM_A_FAIL_HI" 14553202 "DTC_ICM_PWM_A_OOR_LO" 14553203 "DTC_ICM_PWM_A_OOR_HI" 14553216 "DTC_ICM_PWM_B_FAIL_LO" 14553217 "DTC_ICM_PWM_B_FAIL_HI" 14553218 "DTC_ICM_PWM_B_OOR_LO" 14553219 "DTC_ICM_PWM_B_OOR_HI" 14553232 "DTC_ICM_PWM_C_FAIL_LO" 14553233 "DTC_ICM_PWM_C_FAIL_HI" 14553234 "DTC_ICM_PWM_C_OOR_LO" 14553235 "DTC_ICM_PWM_C_OOR_HI" 14553248 "DTC_ICM_PWM_D_FAIL_LO" 14553249 "DTC_ICM_PWM_D_FAIL_HI" 14553250 "DTC_ICM_PWM_D_OOR_LO" 14553251 "DTC_ICM_PWM_D_OOR_HI" 14606336 "DTC_NVM_EE_0_COMM_WRITE_TO" 14606337 "DTC_NVM_EE_0_COMM_READ_TO" 14606338 "DTC_NVM_EE_0_WRITE_VERIFY" 14606339 "DTC_NVM_EE_0_READ_VERIFY" 14606340 "DTC_NVM_EE_0_READ_ERR" 14606341 "DTC_NVM_EE_0_WRITE_ERR" 14564800 "DTC_PWM_LSD_A_DC_MISMATCH" 14565344 "DTC_PWM_LSD_A_FREQ_MISMATCH" 14564801 "DTC_PWM_PWM_A_DC_MISMATCH" 14565345 "DTC_PWM_PWM_A_FREQ_MISMATCH" 14564802 "DTC_PWM_PWM_B_DC_MISMATCH" 14565346 "DTC_PWM_PWM_B_FREQ_MISMATCH" 14564803 "DTC_PWM_PWM_C_DC_MISMATCH" 14565347 "DTC_PWM_PWM_C_FREQ_MISMATCH" 14564804 "DTC_PWM_PWM_D_DC_MISMATCH" 14565348 "DTC_PWM_PWM_D_FREQ_MISMATCH" 14417920 "DTC_PWR_WAKEUP_CLK_FAILED" 14417921 "DTC_PWR_WAKEUP_CLK_OOR_LO" 14417922 "DTC_PWR_WAKEUP_CLK_OOR_HI" 14614570 "DTC_SDP_HPWR_OOR_HI" 14614571 "DTC_SDP_HPWR_OOR_LO" 14614572 "DTC_SDP_HPWR_COMM_TO" 14614573 "DTC_SDP_DEVICE_FAILURE";
VAL_ 1120 bcm_dtc_061 0 " - " 11276288 "DTC_VEPO" 11276289 "DTC_HSC_MISSING" 11460608 "DTC_NVM_SOC" 11460609 "DTC_NVM_HYST" 11460610 "DTC_NVM_KOT" 11460611 "DTC_NVM_PERIODIC_SHUTDOWN_TIME" 11460612 "DTC_NVM_WAKE" 11460613 "DTC_NVM_CALENDAR_LIFE" 11460614 "DTC_NVM_CYCLE_LIFE" 11460615 "DTC_NVM_DTC" 11460616 "DTC_NVM_APP_SCRATCHPAD" 11517962 "DTC_LOOPTIME_TASK_A" 11517963 "DTC_LOOPTIME_TASK_B" 11517964 "DTC_LOOPTIME_TASK_C" 11517965 "DTC_LOOPTIME_TASK_D" 11517966 "DTC_LOOPTIME_TASK_E" 11517967 "DTC_ILIM_MAX_DISCHARGE" 15728640 "DTC_EPO" 16171008 "DTC_CONT_OPEN" 16171009 "DTC_CONT_CLOSE" 16171010 "DTC_CONT_OPEN_CURRENT" 16171264 "DTC_CONT_CLOSE_ON_RESET" 16171265 "DTC_CONT_CLOSE_SIG_FAILED" 16171520 "DTC_PRECHARGE_TIMEOUT" 16171777 "DTC_CONT_NEG_WELD_AT_SU" 16171778 "DTC_CONT_POS_A_WELD_AT_SU" 16171779 "DTC_CONT_POS_B_WELD_AT_SU" 16172033 "DTC_CONT_NEG_WELD_AT_SD" 16172034 "DTC_CONT_POS_A_WELD_AT_SD" 16172036 "DTC_CONT_POS_B_WELD_AT_SD" 16172289 "DTC_CONT_NEG_OPEN" 16172290 "DTC_CONT_POS_A_OPEN" 16172291 "DTC_CONT_POS_B_OPEN" 16172545 "DTC_CONT_NEG_VDIF" 16172546 "DTC_CONT_POS_A_VDIF" 16172548 "DTC_CONT_POS_B_VDIF" 16174848 "DTC_HVIL" 16174849 "DTC_LVBAT_LO" 16174850 "DTC_LVBAT_HI" 16174851 "DTC_LVBAT_ERR" 16522240 "DTC_CSM_MISSING" 16522752 "DTC_CSM_VBAT" 16522753 "DTC_CSM_VPOS" 16522754 "DTC_CSM_VNEG" 16522755 "DTC_CSM_CPOS" 16522756 "DTC_CSM_CNEG" 16522757 "DTC_CSM_APOS" 16522758 "DTC_CSM_ANEG" 16522759 "DTC_CSM_FUSE_HI" 16522760 "DTC_CSM_FUSE_LO" 16521728 "DTC_CSM_ASIC" 16521729 "DTC_CSM_AILO" 16521730 "DTC_CSM_AIHI" 16520957 "DTC_LEAKAGE_DETECT_FAULT" 16522444 "DTC_REALTIMECLOCK_FAULT" 16520945 "DTC_CSM_LEAK_FAIL_CALC" 16520946 "DTC_CSM_LEAK_FAIL_HW" 16520947 "DTC_CSM_LEAK_EXT_SHORT" 16520948 "DTC_CSM_LEAK_MID_PACK_SHORT" 16520949 "DTC_CSM_LEAK_ERROR" 16520950 "DTC_CSM_LEAK_UNKNOWN" 16523008 "DTC_CSM_VER_MISMATCH" 16523009 "DTC_CSM_DTC_SET" 16523010 "DTC_CSM_CAL_FAULT" 16496320 "DTC_MBB_TOO_FEW" 16496321 "DTC_MBB_TOO_MANY" 16496352 "DTC_CELL_VMAX_ERR" 16496353 "DTC_CELL_VMIN_ERR" 16496354 "DTC_CELL_VMAX" 16496362 "DTC_CELL_VMAX_SEVERE" 16496355 "DTC_CELL_VMIN" 16496363 "DTC_CELL_VMIN_SEVERE" 16496356 "DTC_MOD_VOLTAGE_COMPARE" 16496336 "DTC_CELL_T_ERR" 16496337 "DTC_CELL_TMAX1" 16496338 "DTC_CELL_TMAX2" 16496339 "DTC_CELL_TMIN" 16497665 "DTC_MBB_01_MISSING" 16497666 "DTC_MBB_02_MISSING" 16497667 "DTC_MBB_03_MISSING" 16497668 "DTC_MBB_04_MISSING" 16497669 "DTC_MBB_05_MISSING" 16497670 "DTC_MBB_06_MISSING" 16497671 "DTC_MBB_07_MISSING" 16497672 "DTC_MBB_08_MISSING" 16497673 "DTC_MBB_09_MISSING" 16497680 "DTC_MBB_10_MISSING" 16497681 "DTC_MBB_11_MISSING" 16497682 "DTC_MBB_12_MISSING" 16497683 "DTC_MBB_13_MISSING" 16497684 "DTC_MBB_14_MISSING" 16497685 "DTC_MBB_15_MISSING" 16497686 "DTC_MBB_16_MISSING" 16497687 "DTC_MBB_17_MISSING" 16497688 "DTC_MBB_18_MISSING" 16497689 "DTC_MBB_19_MISSING" 16497696 "DTC_MBB_20_MISSING" 16497697 "DTC_MBB_21_MISSING" 16497698 "DTC_MBB_22_MISSING" 16497699 "DTC_MBB_23_MISSING" 16497700 "DTC_MBB_24_MISSING" 16498177 "DTC_MBB_01_VFAULT" 16498178 "DTC_MBB_02_VFAULT" 16498179 "DTC_MBB_03_VFAULT" 16498180 "DTC_MBB_04_VFAULT" 16498181 "DTC_MBB_05_VFAULT" 16498182 "DTC_MBB_06_VFAULT" 16498183 "DTC_MBB_07_VFAULT" 16498184 "DTC_MBB_08_VFAULT" 16498185 "DTC_MBB_09_VFAULT" 16498192 "DTC_MBB_10_VFAULT" 16498193 "DTC_MBB_11_VFAULT" 16498194 "DTC_MBB_12_VFAULT" 16498195 "DTC_MBB_13_VFAULT" 16498196 "DTC_MBB_14_VFAULT" 16498197 "DTC_MBB_15_VFAULT" 16498198 "DTC_MBB_16_VFAULT" 16498199 "DTC_MBB_17_VFAULT" 16498200 "DTC_MBB_18_VFAULT" 16498201 "DTC_MBB_19_VFAULT" 16498208 "DTC_MBB_20_VFAULT" 16498209 "DTC_MBB_21_VFAULT" 16498210 "DTC_MBB_22_VFAULT" 16498211 "DTC_MBB_23_VFAULT" 16498212 "DTC_MBB_24_VFAULT" 16497921 "DTC_MBB_01_TFAULT" 16497922 "DTC_MBB_02_TFAULT" 16497923 "DTC_MBB_03_TFAULT" 16497924 "DTC_MBB_04_TFAULT" 16497925 "DTC_MBB_05_TFAULT" 16497926 "DTC_MBB_06_TFAULT" 16497927 "DTC_MBB_07_TFAULT" 16497928 "DTC_MBB_08_TFAULT" 16497929 "DTC_MBB_09_TFAULT" 16497936 "DTC_MBB_10_TFAULT" 16497937 "DTC_MBB_11_TFAULT" 16497938 "DTC_MBB_12_TFAULT" 16497939 "DTC_MBB_13_TFAULT" 16497940 "DTC_MBB_14_TFAULT" 16497941 "DTC_MBB_15_TFAULT" 16497942 "DTC_MBB_16_TFAULT" 16497943 "DTC_MBB_17_TFAULT" 16497944 "DTC_MBB_18_TFAULT" 16497945 "DTC_MBB_19_TFAULT" 16497952 "DTC_MBB_20_TFAULT" 16497953 "DTC_MBB_21_TFAULT" 16497954 "DTC_MBB_22_TFAULT" 16497955 "DTC_MBB_23_TFAULT" 16497956 "DTC_MBB_24_TFAULT" 16498688 "DTC_BRUSA_MISSING" 16498689 "DTC_BRUSA_IDC" 16498690 "DTC_BRUSA_REQ_VS_CMD" 16560128 "DTC_IBAT_MISMATCH" 16576512 "DTC_DIS_MAX_I2T" 16576513 "DTC_CHG_MAX_I2T" 16576768 "DTC_DIS_WARNING_I2T" 16576769 "DTC_CHG_WARNING_I2T" 16523520 "DTC_LEM_A_OOR_HI" 16523521 "DTC_LEM_A_OOR_LO" 16523522 "DTC_LEM_A_FAULT" 16523776 "DTC_LEM_B_OOR_HI" 16523777 "DTC_LEM_B_OOR_LO" 16523778 "DTC_LEM_B_FAULT" 16506880 "DTC_VBAT_MISMATCH" 16506881 "DTC_VBAT_VMAX" 16506882 "DTC_VBAT_VMIN" 16506883 "DTC_PACK_FUSE_A" 16506884 "DTC_PACK_FUSE_B" 16252928 "DTC_KEY_OFF_TIME_ERROR" 16252929 "DTC_PERIODIC_OFF_TIME_ERROR" 14290944 "DTC_AIN_BPWR_FAIL_LO" 14290945 "DTC_AIN_BPWR_FAIL_HI" 14290946 "DTC_AIN_BPWR_OOR_LO" 14290947 "DTC_AIN_BPWR_OOR_HI" 14290960 "DTC_AIN_14V_FAIL_LO" 14290961 "DTC_AIN_14V_FAIL_HI" 14290962 "DTC_AIN_14V_OOR_LO" 14290963 "DTC_AIN_14V_OOR_HI" 14290976 "DTC_AIN_HPWR_FAIL_LO" 14290977 "DTC_AIN_HPWR_FAIL_HI" 14290978 "DTC_AIN_HPWR_OOR_LO" 14290979 "DTC_AIN_HPWR_OOR_HI" 14290992 "DTC_AIN_6V_FAIL_LO" 14290993 "DTC_AIN_6V_FAIL_HI" 14290994 "DTC_AIN_6V_OOR_LO" 14290995 "DTC_AIN_6V_OOR_HI" 14291008 "DTC_AIN_HVIL_FAIL_LO" 14291009 "DTC_AIN_HVIL_FAIL_HI" 14291010 "DTC_AIN_HVIL_OOR_LO" 14291011 "DTC_AIN_HVIL_OOR_HI" 14291024 "DTC_AIN_5V_PWR_FAIL_LO" 14291025 "DTC_AIN_5V_PWR_FAIL_HI" 14291026 "DTC_AIN_5V_PWR_OOR_LO" 14291027 "DTC_AIN_5V_PWR_OOR_HI" 14291040 "DTC_AIN_LEM_HI_FAIL_LO" 14291041 "DTC_AIN_LEM_HI_FAIL_HI" 14291042 "DTC_AIN_LEM_HI_OOR_LO" 14291043 "DTC_AIN_LEM_HI_OOR_HI" 14291056 "DTC_AIN_LEM_LO_FAIL_LO" 14291057 "DTC_AIN_LEM_LO_FAIL_HI" 14291058 "DTC_AIN_LEM_LO_OOR_LO" 14291059 "DTC_AIN_LEM_LO_OOR_HI" 14291072 "DTC_AIN_BCT_AI_FAIL_LO" 14291073 "DTC_AIN_BCT_AI_FAIL_HI" 14291074 "DTC_AIN_BCT_AI_OOR_LO" 14291075 "DTC_AIN_BCT_AI_OOR_HI" 14291088 "DTC_AIN_WTR2_AI_FAIL_LO" 14291089 "DTC_AIN_WTR2_AI_FAIL_HI" 14291090 "DTC_AIN_WTR2_AI_OOR_LO" 14291091 "DTC_AIN_WTR2_AI_OOR_HI" 14291104 "DTC_AIN_WTR1_AI_FAIL_LO" 14291105 "DTC_AIN_WTR1_AI_FAIL_HI" 14291106 "DTC_AIN_WTR1_AI_OOR_LO" 14291107 "DTC_AIN_WTR1_AI_OOR_HI" 14291120 "DTC_AIN_AIA_FAIL_LO" 14291121 "DTC_AIN_AIA_FAIL_HI" 14291122 "DTC_AIN_AIA_OOR_LO" 14291123 "DTC_AIN_AIA_OOR_HI" 14291136 "DTC_AIN_PROX_AI_FAIL_LO" 14291137 "DTC_AIN_PROX_AI_FAIL_HI" 14291138 "DTC_AIN_PROX_AI_OOR_LO" 14291139 "DTC_AIN_PROX_AI_OOR_HI" 14291152 "DTC_AIN_TWV_FB_FAIL_LO" 14291153 "DTC_AIN_TWV_FB_FAIL_HI" 14291154 "DTC_AIN_TWV_FB_OOR_LO" 14291155 "DTC_AIN_TWV_FB_OOR_HI" 14291168 "DTC_AIN_5V_KA_FAIL_LO" 14291169 "DTC_AIN_5V_KA_FAIL_HI" 14291170 "DTC_AIN_5V_KA_OOR_LO" 14291171 "DTC_AIN_5V_KA_OOR_HI" 14291184 "DTC_AIN_CTR1_LSD_FAIL_LO" 14291185 "DTC_AIN_CTR1_LSD_FAIL_HI" 14291186 "DTC_AIN_CTR1_LSD_OOR_LO" 14291187 "DTC_AIN_CTR1_LSD_OOR_HI" 14291200 "DTC_AIN_CTR2_LSD_FAIL_LO" 14291201 "DTC_AIN_CTR2_LSD_FAIL_HI" 14291202 "DTC_AIN_CTR2_LSD_OOR_LO" 14291203 "DTC_AIN_CTR2_LSD_OOR_HI" 14291216 "DTC_AIN_CTR3_LSD_FAIL_LO" 14291217 "DTC_AIN_CTR3_LSD_FAIL_HI" 14291218 "DTC_AIN_CTR3_LSD_OOR_LO" 14291219 "DTC_AIN_CTR3_LSD_OOR_HI" 14291232 "DTC_AIN_CTR4_LSD_FAIL_LO" 14291233 "DTC_AIN_CTR4_LSD_FAIL_HI" 14291234 "DTC_AIN_CTR4_LSD_OOR_LO" 14291235 "DTC_AIN_CTR4_LSD_OOR_HI" 14291248 "DTC_AIN_CTR5_LSD_FAIL_LO" 14291249 "DTC_AIN_CTR5_LSD_FAIL_HI" 14291250 "DTC_AIN_CTR5_LSD_OOR_LO" 14291251 "DTC_AIN_CTR5_LSD_OOR_HI" 14291264 "DTC_AIN_CTR6_LSD_FAIL_LO" 14291265 "DTC_AIN_CTR6_LSD_FAIL_HI" 14291266 "DTC_AIN_CTR6_LSD_OOR_LO" 14291267 "DTC_AIN_CTR6_LSD_OOR_HI" 14291280 "DTC_AIN_CTR7_LSD_FAIL_LO" 14291281 "DTC_AIN_CTR7_LSD_FAIL_HI" 14291282 "DTC_AIN_CTR7_LSD_OOR_LO" 14291283 "DTC_AIN_CTR7_LSD_OOR_HI" 14291296 "DTC_AIN_CTR_PWR_CUR_FAIL_LO" 14291297 "DTC_AIN_CTR_PWR_CUR_FAIL_HI" 14291298 "DTC_AIN_CTR_PWR_CUR_OOR_LO" 14291299 "DTC_AIN_CTR_PWR_CUR_OOR_HI" 14291312 "DTC_AIN_CTR_HLD_CUR_FAIL_LO" 14291313 "DTC_AIN_CTR_HLD_CUR_FAIL_HI" 14291314 "DTC_AIN_CTR_HLD_CUR_OOR_LO" 14291315 "DTC_AIN_CTR_HLD_CUR_OOR_HI" 13431040 "DTC_CTR_FAULT_LATCH" 13431041 "DTC_CTR_FAULT_INVALID_HEARTBEAT" 13373440 "DTC_CTR1_LSD_FAILED_LO" 13373441 "DTC_CTR1_LSD_FAILED_HI" 13373442 "DTC_CTR1_HSD_FAILED_LO" 13373443 "DTC_CTR1_HSD_FAILED_HI" 13373444 "DTC_CTR1_PULL_IN_SHORT" 13373445 "DTC_CTR1_PULL_IN_OPEN" 13373446 "DTC_CTR1_COIL_INVALID" 13373447 "DTC_CTR1_COIL_OPEN" 13373448 "DTC_CTR1_CIRCUIT_FAILED" 13377536 "DTC_CTR2_LSD_FAILED_LO" 13377537 "DTC_CTR2_LSD_FAILED_HI" 13377538 "DTC_CTR2_HSD_FAILED_LO" 13377539 "DTC_CTR2_HSD_FAILED_HI" 13377540 "DTC_CTR2_PULL_IN_SHORT" 13377541 "DTC_CTR2_PULL_IN_OPEN" 13377542 "DTC_CTR2_COIL_INVALID" 13377543 "DTC_CTR2_COIL_OPEN" 13377544 "DTC_CTR2_CIRCUIT_FAILED" 13381632 "DTC_CTR3_LSD_FAILED_LO" 13381633 "DTC_CTR3_LSD_FAILED_HI" 13381634 "DTC_CTR3_HSD_FAILED_LO" 13381635 "DTC_CTR3_HSD_FAILED_HI" 13381636 "DTC_CTR3_PULL_IN_SHORT" 13381637 "DTC_CTR3_PULL_IN_OPEN" 13381638 "DTC_CTR3_COIL_INVALID" 13381639 "DTC_CTR3_COIL_OPEN" 13381640 "DTC_CTR3_CIRCUIT_FAILED" 13385728 "DTC_CTR4_LSD_FAILED_LO" 13385729 "DTC_CTR4_LSD_FAILED_HI" 13385730 "DTC_CTR4_HSD_FAILED_LO" 13385731 "DTC_CTR4_HSD_FAILED_HI" 13385732 "DTC_CTR4_PULL_IN_SHORT" 13385733 "DTC_CTR4_PULL_IN_OPEN" 13385734 "DTC_CTR4_COIL_INVALID" 13385735 "DTC_CTR4_COIL_OPEN" 13385736 "DTC_CTR4_CIRCUIT_FAILED" 13389824 "DTC_CTR5_LSD_FAILED_LO" 13389825 "DTC_CTR5_LSD_FAILED_HI" 13389826 "DTC_CTR5_HSD_FAILED_LO" 13389827 "DTC_CTR5_HSD_FAILED_HI" 13389828 "DTC_CTR5_PULL_IN_SHORT" 13389829 "DTC_CTR5_PULL_IN_OPEN" 13389830 "DTC_CTR5_COIL_INVALID" 13389831 "DTC_CTR5_COIL_OPEN" 13389832 "DTC_CTR5_CIRCUIT_FAILED" 13393920 "DTC_CTR6_LSD_FAILED_LO" 13393921 "DTC_CTR6_LSD_FAILED_HI" 13393922 "DTC_CTR6_HSD_FAILED_LO" 13393923 "DTC_CTR6_HSD_FAILED_HI" 13393924 "DTC_CTR6_PULL_IN_SHORT" 13393925 "DTC_CTR6_PULL_IN_OPEN" 13393926 "DTC_CTR6_COIL_INVALID" 13393927 "DTC_CTR6_COIL_OPEN" 13393928 "DTC_CTR6_CIRCUIT_FAILED" 13398016 "DTC_CTR7_LSD_FAILED_LO" 13398017 "DTC_CTR7_LSD_FAILED_HI" 13398018 "DTC_CTR7_HSD_FAILED_LO" 13398019 "DTC_CTR7_HSD_FAILED_HI" 13398020 "DTC_CTR7_PULL_IN_SHORT" 13398021 "DTC_CTR7_PULL_IN_OPEN" 13398022 "DTC_CTR7_COIL_INVALID" 13398023 "DTC_CTR7_COIL_OPEN" 13398024 "DTC_CTR7_CIRCUIT_FAILED" 14483456 "DTC_DRV_SW14V_PWR_FAILED_LO" 14483457 "DTC_DRV_SW14V_PWR_FAILED_HI" 14483472 "DTC_DRV_CHRGA_ENA_FAILED_LO" 14483473 "DTC_DRV_CHRGA_ENA_FAILED_HI" 14483488 "DTC_DRV_CHRGB_ENA_FAILED_LO" 14483489 "DTC_DRV_CHRGB_ENA_FAILED_HI" 14483504 "DTC_DRV_LSDA_FAILED_LO" 14483505 "DTC_DRV_LSDA_FAILED_HI" 14483520 "DTC_DRV_LSDB_FAILED_LO" 14483521 "DTC_DRV_LSDB_FAILED_HI" 14483536 "DTC_DRV_HSDA_FAILED_LO" 14483537 "DTC_DRV_HSDA_FAILED_HI" 14483552 "DTC_DRV_HSDB_FAILED_LO" 14483553 "DTC_DRV_HSDB_FAILED_HI" 14553088 "DTC_ICM_FGD1_FAIL_LO" 14553089 "DTC_ICM_FGD1_FAIL_HI" 14553090 "DTC_ICM_FGD1_OOR_LO" 14553091 "DTC_ICM_FGD1_OOR_HI" 14553104 "DTC_ICM_FGD2_FAIL_LO" 14553105 "DTC_ICM_FGD2_FAIL_HI" 14553106 "DTC_ICM_FGD2_OOR_LO" 14553107 "DTC_ICM_FGD2_OOR_HI" 14553120 "DTC_ICM_PILOT_FAIL_LO" 14553121 "DTC_ICM_PILOT_FAIL_HI" 14553122 "DTC_ICM_PILOT_OOR_LO" 14553123 "DTC_ICM_PILOT_OOR_HI" 14553136 "DTC_ICM_MOD_FLT_FAIL_LO" 14553137 "DTC_ICM_MOD_FLT_FAIL_HI" 14553138 "DTC_ICM_MOD_FLT_OOR_LO" 14553139 "DTC_ICM_MOD_FLT_OOR_HI" 14553152 "DTC_ICM_CLK_FAIL_LO" 14553153 "DTC_ICM_CLK_FAIL_HI" 14553154 "DTC_ICM_CLK_OOR_LO" 14553155 "DTC_ICM_CLK_OOR_HI" 14553168 "DTC_ICM_LSD_A_FAIL_LO" 14553169 "DTC_ICM_LSD_A_FAIL_HI" 14553170 "DTC_ICM_LSD_A_OOR_LO" 14553171 "DTC_ICM_LSD_A_OOR_HI" 14553184 "DTC_ICM_LSD_B_FAIL_LO" 14553185 "DTC_ICM_LSD_B_FAIL_HI" 14553186 "DTC_ICM_LSD_B_OOR_LO" 14553187 "DTC_ICM_LSD_B_OOR_HI" 14553200 "DTC_ICM_PWM_A_FAIL_LO" 14553201 "DTC_ICM_PWM_A_FAIL_HI" 14553202 "DTC_ICM_PWM_A_OOR_LO" 14553203 "DTC_ICM_PWM_A_OOR_HI" 14553216 "DTC_ICM_PWM_B_FAIL_LO" 14553217 "DTC_ICM_PWM_B_FAIL_HI" 14553218 "DTC_ICM_PWM_B_OOR_LO" 14553219 "DTC_ICM_PWM_B_OOR_HI" 14553232 "DTC_ICM_PWM_C_FAIL_LO" 14553233 "DTC_ICM_PWM_C_FAIL_HI" 14553234 "DTC_ICM_PWM_C_OOR_LO" 14553235 "DTC_ICM_PWM_C_OOR_HI" 14553248 "DTC_ICM_PWM_D_FAIL_LO" 14553249 "DTC_ICM_PWM_D_FAIL_HI" 14553250 "DTC_ICM_PWM_D_OOR_LO" 14553251 "DTC_ICM_PWM_D_OOR_HI" 14606336 "DTC_NVM_EE_0_COMM_WRITE_TO" 14606337 "DTC_NVM_EE_0_COMM_READ_TO" 14606338 "DTC_NVM_EE_0_WRITE_VERIFY" 14606339 "DTC_NVM_EE_0_READ_VERIFY" 14606340 "DTC_NVM_EE_0_READ_ERR" 14606341 "DTC_NVM_EE_0_WRITE_ERR" 14564800 "DTC_PWM_LSD_A_DC_MISMATCH" 14565344 "DTC_PWM_LSD_A_FREQ_MISMATCH" 14564801 "DTC_PWM_PWM_A_DC_MISMATCH" 14565345 "DTC_PWM_PWM_A_FREQ_MISMATCH" 14564802 "DTC_PWM_PWM_B_DC_MISMATCH" 14565346 "DTC_PWM_PWM_B_FREQ_MISMATCH" 14564803 "DTC_PWM_PWM_C_DC_MISMATCH" 14565347 "DTC_PWM_PWM_C_FREQ_MISMATCH" 14564804 "DTC_PWM_PWM_D_DC_MISMATCH" 14565348 "DTC_PWM_PWM_D_FREQ_MISMATCH" 14417920 "DTC_PWR_WAKEUP_CLK_FAILED" 14417921 "DTC_PWR_WAKEUP_CLK_OOR_LO" 14417922 "DTC_PWR_WAKEUP_CLK_OOR_HI" 14614570 "DTC_SDP_HPWR_OOR_HI" 14614571 "DTC_SDP_HPWR_OOR_LO" 14614572 "DTC_SDP_HPWR_COMM_TO" 14614573 "DTC_SDP_DEVICE_FAILURE";
VAL_ 1120 bcm_dtc_062 0 " - " 11276288 "DTC_VEPO" 11276289 "DTC_HSC_MISSING" 11460608 "DTC_NVM_SOC" 11460609 "DTC_NVM_HYST" 11460610 "DTC_NVM_KOT" 11460611 "DTC_NVM_PERIODIC_SHUTDOWN_TIME" 11460612 "DTC_NVM_WAKE" 11460613 "DTC_NVM_CALENDAR_LIFE" 11460614 "DTC_NVM_CYCLE_LIFE" 11460615 "DTC_NVM_DTC" 11460616 "DTC_NVM_APP_SCRATCHPAD" 11517962 "DTC_LOOPTIME_TASK_A" 11517963 "DTC_LOOPTIME_TASK_B" 11517964 "DTC_LOOPTIME_TASK_C" 11517965 "DTC_LOOPTIME_TASK_D" 11517966 "DTC_LOOPTIME_TASK_E" 11517967 "DTC_ILIM_MAX_DISCHARGE" 15728640 "DTC_EPO" 16171008 "DTC_CONT_OPEN" 16171009 "DTC_CONT_CLOSE" 16171010 "DTC_CONT_OPEN_CURRENT" 16171264 "DTC_CONT_CLOSE_ON_RESET" 16171265 "DTC_CONT_CLOSE_SIG_FAILED" 16171520 "DTC_PRECHARGE_TIMEOUT" 16171777 "DTC_CONT_NEG_WELD_AT_SU" 16171778 "DTC_CONT_POS_A_WELD_AT_SU" 16171779 "DTC_CONT_POS_B_WELD_AT_SU" 16172033 "DTC_CONT_NEG_WELD_AT_SD" 16172034 "DTC_CONT_POS_A_WELD_AT_SD" 16172036 "DTC_CONT_POS_B_WELD_AT_SD" 16172289 "DTC_CONT_NEG_OPEN" 16172290 "DTC_CONT_POS_A_OPEN" 16172291 "DTC_CONT_POS_B_OPEN" 16172545 "DTC_CONT_NEG_VDIF" 16172546 "DTC_CONT_POS_A_VDIF" 16172548 "DTC_CONT_POS_B_VDIF" 16174848 "DTC_HVIL" 16174849 "DTC_LVBAT_LO" 16174850 "DTC_LVBAT_HI" 16174851 "DTC_LVBAT_ERR" 16522240 "DTC_CSM_MISSING" 16522752 "DTC_CSM_VBAT" 16522753 "DTC_CSM_VPOS" 16522754 "DTC_CSM_VNEG" 16522755 "DTC_CSM_CPOS" 16522756 "DTC_CSM_CNEG" 16522757 "DTC_CSM_APOS" 16522758 "DTC_CSM_ANEG" 16522759 "DTC_CSM_FUSE_HI" 16522760 "DTC_CSM_FUSE_LO" 16521728 "DTC_CSM_ASIC" 16521729 "DTC_CSM_AILO" 16521730 "DTC_CSM_AIHI" 16520957 "DTC_LEAKAGE_DETECT_FAULT" 16522444 "DTC_REALTIMECLOCK_FAULT" 16520945 "DTC_CSM_LEAK_FAIL_CALC" 16520946 "DTC_CSM_LEAK_FAIL_HW" 16520947 "DTC_CSM_LEAK_EXT_SHORT" 16520948 "DTC_CSM_LEAK_MID_PACK_SHORT" 16520949 "DTC_CSM_LEAK_ERROR" 16520950 "DTC_CSM_LEAK_UNKNOWN" 16523008 "DTC_CSM_VER_MISMATCH" 16523009 "DTC_CSM_DTC_SET" 16523010 "DTC_CSM_CAL_FAULT" 16496320 "DTC_MBB_TOO_FEW" 16496321 "DTC_MBB_TOO_MANY" 16496352 "DTC_CELL_VMAX_ERR" 16496353 "DTC_CELL_VMIN_ERR" 16496354 "DTC_CELL_VMAX" 16496362 "DTC_CELL_VMAX_SEVERE" 16496355 "DTC_CELL_VMIN" 16496363 "DTC_CELL_VMIN_SEVERE" 16496356 "DTC_MOD_VOLTAGE_COMPARE" 16496336 "DTC_CELL_T_ERR" 16496337 "DTC_CELL_TMAX1" 16496338 "DTC_CELL_TMAX2" 16496339 "DTC_CELL_TMIN" 16497665 "DTC_MBB_01_MISSING" 16497666 "DTC_MBB_02_MISSING" 16497667 "DTC_MBB_03_MISSING" 16497668 "DTC_MBB_04_MISSING" 16497669 "DTC_MBB_05_MISSING" 16497670 "DTC_MBB_06_MISSING" 16497671 "DTC_MBB_07_MISSING" 16497672 "DTC_MBB_08_MISSING" 16497673 "DTC_MBB_09_MISSING" 16497680 "DTC_MBB_10_MISSING" 16497681 "DTC_MBB_11_MISSING" 16497682 "DTC_MBB_12_MISSING" 16497683 "DTC_MBB_13_MISSING" 16497684 "DTC_MBB_14_MISSING" 16497685 "DTC_MBB_15_MISSING" 16497686 "DTC_MBB_16_MISSING" 16497687 "DTC_MBB_17_MISSING" 16497688 "DTC_MBB_18_MISSING" 16497689 "DTC_MBB_19_MISSING" 16497696 "DTC_MBB_20_MISSING" 16497697 "DTC_MBB_21_MISSING" 16497698 "DTC_MBB_22_MISSING" 16497699 "DTC_MBB_23_MISSING" 16497700 "DTC_MBB_24_MISSING" 16498177 "DTC_MBB_01_VFAULT" 16498178 "DTC_MBB_02_VFAULT" 16498179 "DTC_MBB_03_VFAULT" 16498180 "DTC_MBB_04_VFAULT" 16498181 "DTC_MBB_05_VFAULT" 16498182 "DTC_MBB_06_VFAULT" 16498183 "DTC_MBB_07_VFAULT" 16498184 "DTC_MBB_08_VFAULT" 16498185 "DTC_MBB_09_VFAULT" 16498192 "DTC_MBB_10_VFAULT" 16498193 "DTC_MBB_11_VFAULT" 16498194 "DTC_MBB_12_VFAULT" 16498195 "DTC_MBB_13_VFAULT" 16498196 "DTC_MBB_14_VFAULT" 16498197 "DTC_MBB_15_VFAULT" 16498198 "DTC_MBB_16_VFAULT" 16498199 "DTC_MBB_17_VFAULT" 16498200 "DTC_MBB_18_VFAULT" 16498201 "DTC_MBB_19_VFAULT" 16498208 "DTC_MBB_20_VFAULT" 16498209 "DTC_MBB_21_VFAULT" 16498210 "DTC_MBB_22_VFAULT" 16498211 "DTC_MBB_23_VFAULT" 16498212 "DTC_MBB_24_VFAULT" 16497921 "DTC_MBB_01_TFAULT" 16497922 "DTC_MBB_02_TFAULT" 16497923 "DTC_MBB_03_TFAULT" 16497924 "DTC_MBB_04_TFAULT" 16497925 "DTC_MBB_05_TFAULT" 16497926 "DTC_MBB_06_TFAULT" 16497927 "DTC_MBB_07_TFAULT" 16497928 "DTC_MBB_08_TFAULT" 16497929 "DTC_MBB_09_TFAULT" 16497936 "DTC_MBB_10_TFAULT" 16497937 "DTC_MBB_11_TFAULT" 16497938 "DTC_MBB_12_TFAULT" 16497939 "DTC_MBB_13_TFAULT" 16497940 "DTC_MBB_14_TFAULT" 16497941 "DTC_MBB_15_TFAULT" 16497942 "DTC_MBB_16_TFAULT" 16497943 "DTC_MBB_17_TFAULT" 16497944 "DTC_MBB_18_TFAULT" 16497945 "DTC_MBB_19_TFAULT" 16497952 "DTC_MBB_20_TFAULT" 16497953 "DTC_MBB_21_TFAULT" 16497954 "DTC_MBB_22_TFAULT" 16497955 "DTC_MBB_23_TFAULT" 16497956 "DTC_MBB_24_TFAULT" 16498688 "DTC_BRUSA_MISSING" 16498689 "DTC_BRUSA_IDC" 16498690 "DTC_BRUSA_REQ_VS_CMD" 16560128 "DTC_IBAT_MISMATCH" 16576512 "DTC_DIS_MAX_I2T" 16576513 "DTC_CHG_MAX_I2T" 16576768 "DTC_DIS_WARNING_I2T" 16576769 "DTC_CHG_WARNING_I2T" 16523520 "DTC_LEM_A_OOR_HI" 16523521 "DTC_LEM_A_OOR_LO" 16523522 "DTC_LEM_A_FAULT" 16523776 "DTC_LEM_B_OOR_HI" 16523777 "DTC_LEM_B_OOR_LO" 16523778 "DTC_LEM_B_FAULT" 16506880 "DTC_VBAT_MISMATCH" 16506881 "DTC_VBAT_VMAX" 16506882 "DTC_VBAT_VMIN" 16506883 "DTC_PACK_FUSE_A" 16506884 "DTC_PACK_FUSE_B" 16252928 "DTC_KEY_OFF_TIME_ERROR" 16252929 "DTC_PERIODIC_OFF_TIME_ERROR" 14290944 "DTC_AIN_BPWR_FAIL_LO" 14290945 "DTC_AIN_BPWR_FAIL_HI" 14290946 "DTC_AIN_BPWR_OOR_LO" 14290947 "DTC_AIN_BPWR_OOR_HI" 14290960 "DTC_AIN_14V_FAIL_LO" 14290961 "DTC_AIN_14V_FAIL_HI" 14290962 "DTC_AIN_14V_OOR_LO" 14290963 "DTC_AIN_14V_OOR_HI" 14290976 "DTC_AIN_HPWR_FAIL_LO" 14290977 "DTC_AIN_HPWR_FAIL_HI" 14290978 "DTC_AIN_HPWR_OOR_LO" 14290979 "DTC_AIN_HPWR_OOR_HI" 14290992 "DTC_AIN_6V_FAIL_LO" 14290993 "DTC_AIN_6V_FAIL_HI" 14290994 "DTC_AIN_6V_OOR_LO" 14290995 "DTC_AIN_6V_OOR_HI" 14291008 "DTC_AIN_HVIL_FAIL_LO" 14291009 "DTC_AIN_HVIL_FAIL_HI" 14291010 "DTC_AIN_HVIL_OOR_LO" 14291011 "DTC_AIN_HVIL_OOR_HI" 14291024 "DTC_AIN_5V_PWR_FAIL_LO" 14291025 "DTC_AIN_5V_PWR_FAIL_HI" 14291026 "DTC_AIN_5V_PWR_OOR_LO" 14291027 "DTC_AIN_5V_PWR_OOR_HI" 14291040 "DTC_AIN_LEM_HI_FAIL_LO" 14291041 "DTC_AIN_LEM_HI_FAIL_HI" 14291042 "DTC_AIN_LEM_HI_OOR_LO" 14291043 "DTC_AIN_LEM_HI_OOR_HI" 14291056 "DTC_AIN_LEM_LO_FAIL_LO" 14291057 "DTC_AIN_LEM_LO_FAIL_HI" 14291058 "DTC_AIN_LEM_LO_OOR_LO" 14291059 "DTC_AIN_LEM_LO_OOR_HI" 14291072 "DTC_AIN_BCT_AI_FAIL_LO" 14291073 "DTC_AIN_BCT_AI_FAIL_HI" 14291074 "DTC_AIN_BCT_AI_OOR_LO" 14291075 "DTC_AIN_BCT_AI_OOR_HI" 14291088 "DTC_AIN_WTR2_AI_FAIL_LO" 14291089 "DTC_AIN_WTR2_AI_FAIL_HI" 14291090 "DTC_AIN_WTR2_AI_OOR_LO" 14291091 "DTC_AIN_WTR2_AI_OOR_HI" 14291104 "DTC_AIN_WTR1_AI_FAIL_LO" 14291105 "DTC_AIN_WTR1_AI_FAIL_HI" 14291106 "DTC_AIN_WTR1_AI_OOR_LO" 14291107 "DTC_AIN_WTR1_AI_OOR_HI" 14291120 "DTC_AIN_AIA_FAIL_LO" 14291121 "DTC_AIN_AIA_FAIL_HI" 14291122 "DTC_AIN_AIA_OOR_LO" 14291123 "DTC_AIN_AIA_OOR_HI" 14291136 "DTC_AIN_PROX_AI_FAIL_LO" 14291137 "DTC_AIN_PROX_AI_FAIL_HI" 14291138 "DTC_AIN_PROX_AI_OOR_LO" 14291139 "DTC_AIN_PROX_AI_OOR_HI" 14291152 "DTC_AIN_TWV_FB_FAIL_LO" 14291153 "DTC_AIN_TWV_FB_FAIL_HI" 14291154 "DTC_AIN_TWV_FB_OOR_LO" 14291155 "DTC_AIN_TWV_FB_OOR_HI" 14291168 "DTC_AIN_5V_KA_FAIL_LO" 14291169 "DTC_AIN_5V_KA_FAIL_HI" 14291170 "DTC_AIN_5V_KA_OOR_LO" 14291171 "DTC_AIN_5V_KA_OOR_HI" 14291184 "DTC_AIN_CTR1_LSD_FAIL_LO" 14291185 "DTC_AIN_CTR1_LSD_FAIL_HI" 14291186 "DTC_AIN_CTR1_LSD_OOR_LO" 14291187 "DTC_AIN_CTR1_LSD_OOR_HI" 14291200 "DTC_AIN_CTR2_LSD_FAIL_LO" 14291201 "DTC_AIN_CTR2_LSD_FAIL_HI" 14291202 "DTC_AIN_CTR2_LSD_OOR_LO" 14291203 "DTC_AIN_CTR2_LSD_OOR_HI" 14291216 "DTC_AIN_CTR3_LSD_FAIL_LO" 14291217 "DTC_AIN_CTR3_LSD_FAIL_HI" 14291218 "DTC_AIN_CTR3_LSD_OOR_LO" 14291219 "DTC_AIN_CTR3_LSD_OOR_HI" 14291232 "DTC_AIN_CTR4_LSD_FAIL_LO" 14291233 "DTC_AIN_CTR4_LSD_FAIL_HI" 14291234 "DTC_AIN_CTR4_LSD_OOR_LO" 14291235 "DTC_AIN_CTR4_LSD_OOR_HI" 14291248 "DTC_AIN_CTR5_LSD_FAIL_LO" 14291249 "DTC_AIN_CTR5_LSD_FAIL_HI" 14291250 "DTC_AIN_CTR5_LSD_OOR_LO" 14291251 "DTC_AIN_CTR5_LSD_OOR_HI" 14291264 "DTC_AIN_CTR6_LSD_FAIL_LO" 14291265 "DTC_AIN_CTR6_LSD_FAIL_HI" 14291266 "DTC_AIN_CTR6_LSD_OOR_LO" 14291267 "DTC_AIN_CTR6_LSD_OOR_HI" 14291280 "DTC_AIN_CTR7_LSD_FAIL_LO" 14291281 "DTC_AIN_CTR7_LSD_FAIL_HI" 14291282 "DTC_AIN_CTR7_LSD_OOR_LO" 14291283 "DTC_AIN_CTR7_LSD_OOR_HI" 14291296 "DTC_AIN_CTR_PWR_CUR_FAIL_LO" 14291297 "DTC_AIN_CTR_PWR_CUR_FAIL_HI" 14291298 "DTC_AIN_CTR_PWR_CUR_OOR_LO" 14291299 "DTC_AIN_CTR_PWR_CUR_OOR_HI" 14291312 "DTC_AIN_CTR_HLD_CUR_FAIL_LO" 14291313 "DTC_AIN_CTR_HLD_CUR_FAIL_HI" 14291314 "DTC_AIN_CTR_HLD_CUR_OOR_LO" 14291315 "DTC_AIN_CTR_HLD_CUR_OOR_HI" 13431040 "DTC_CTR_FAULT_LATCH" 13431041 "DTC_CTR_FAULT_INVALID_HEARTBEAT" 13373440 "DTC_CTR1_LSD_FAILED_LO" 13373441 "DTC_CTR1_LSD_FAILED_HI" 13373442 "DTC_CTR1_HSD_FAILED_LO" 13373443 "DTC_CTR1_HSD_FAILED_HI" 13373444 "DTC_CTR1_PULL_IN_SHORT" 13373445 "DTC_CTR1_PULL_IN_OPEN" 13373446 "DTC_CTR1_COIL_INVALID" 13373447 "DTC_CTR1_COIL_OPEN" 13373448 "DTC_CTR1_CIRCUIT_FAILED" 13377536 "DTC_CTR2_LSD_FAILED_LO" 13377537 "DTC_CTR2_LSD_FAILED_HI" 13377538 "DTC_CTR2_HSD_FAILED_LO" 13377539 "DTC_CTR2_HSD_FAILED_HI" 13377540 "DTC_CTR2_PULL_IN_SHORT" 13377541 "DTC_CTR2_PULL_IN_OPEN" 13377542 "DTC_CTR2_COIL_INVALID" 13377543 "DTC_CTR2_COIL_OPEN" 13377544 "DTC_CTR2_CIRCUIT_FAILED" 13381632 "DTC_CTR3_LSD_FAILED_LO" 13381633 "DTC_CTR3_LSD_FAILED_HI" 13381634 "DTC_CTR3_HSD_FAILED_LO" 13381635 "DTC_CTR3_HSD_FAILED_HI" 13381636 "DTC_CTR3_PULL_IN_SHORT" 13381637 "DTC_CTR3_PULL_IN_OPEN" 13381638 "DTC_CTR3_COIL_INVALID" 13381639 "DTC_CTR3_COIL_OPEN" 13381640 "DTC_CTR3_CIRCUIT_FAILED" 13385728 "DTC_CTR4_LSD_FAILED_LO" 13385729 "DTC_CTR4_LSD_FAILED_HI" 13385730 "DTC_CTR4_HSD_FAILED_LO" 13385731 "DTC_CTR4_HSD_FAILED_HI" 13385732 "DTC_CTR4_PULL_IN_SHORT" 13385733 "DTC_CTR4_PULL_IN_OPEN" 13385734 "DTC_CTR4_COIL_INVALID" 13385735 "DTC_CTR4_COIL_OPEN" 13385736 "DTC_CTR4_CIRCUIT_FAILED" 13389824 "DTC_CTR5_LSD_FAILED_LO" 13389825 "DTC_CTR5_LSD_FAILED_HI" 13389826 "DTC_CTR5_HSD_FAILED_LO" 13389827 "DTC_CTR5_HSD_FAILED_HI" 13389828 "DTC_CTR5_PULL_IN_SHORT" 13389829 "DTC_CTR5_PULL_IN_OPEN" 13389830 "DTC_CTR5_COIL_INVALID" 13389831 "DTC_CTR5_COIL_OPEN" 13389832 "DTC_CTR5_CIRCUIT_FAILED" 13393920 "DTC_CTR6_LSD_FAILED_LO" 13393921 "DTC_CTR6_LSD_FAILED_HI" 13393922 "DTC_CTR6_HSD_FAILED_LO" 13393923 "DTC_CTR6_HSD_FAILED_HI" 13393924 "DTC_CTR6_PULL_IN_SHORT" 13393925 "DTC_CTR6_PULL_IN_OPEN" 13393926 "DTC_CTR6_COIL_INVALID" 13393927 "DTC_CTR6_COIL_OPEN" 13393928 "DTC_CTR6_CIRCUIT_FAILED" 13398016 "DTC_CTR7_LSD_FAILED_LO" 13398017 "DTC_CTR7_LSD_FAILED_HI" 13398018 "DTC_CTR7_HSD_FAILED_LO" 13398019 "DTC_CTR7_HSD_FAILED_HI" 13398020 "DTC_CTR7_PULL_IN_SHORT" 13398021 "DTC_CTR7_PULL_IN_OPEN" 13398022 "DTC_CTR7_COIL_INVALID" 13398023 "DTC_CTR7_COIL_OPEN" 13398024 "DTC_CTR7_CIRCUIT_FAILED" 14483456 "DTC_DRV_SW14V_PWR_FAILED_LO" 14483457 "DTC_DRV_SW14V_PWR_FAILED_HI" 14483472 "DTC_DRV_CHRGA_ENA_FAILED_LO" 14483473 "DTC_DRV_CHRGA_ENA_FAILED_HI" 14483488 "DTC_DRV_CHRGB_ENA_FAILED_LO" 14483489 "DTC_DRV_CHRGB_ENA_FAILED_HI" 14483504 "DTC_DRV_LSDA_FAILED_LO" 14483505 "DTC_DRV_LSDA_FAILED_HI" 14483520 "DTC_DRV_LSDB_FAILED_LO" 14483521 "DTC_DRV_LSDB_FAILED_HI" 14483536 "DTC_DRV_HSDA_FAILED_LO" 14483537 "DTC_DRV_HSDA_FAILED_HI" 14483552 "DTC_DRV_HSDB_FAILED_LO" 14483553 "DTC_DRV_HSDB_FAILED_HI" 14553088 "DTC_ICM_FGD1_FAIL_LO" 14553089 "DTC_ICM_FGD1_FAIL_HI" 14553090 "DTC_ICM_FGD1_OOR_LO" 14553091 "DTC_ICM_FGD1_OOR_HI" 14553104 "DTC_ICM_FGD2_FAIL_LO" 14553105 "DTC_ICM_FGD2_FAIL_HI" 14553106 "DTC_ICM_FGD2_OOR_LO" 14553107 "DTC_ICM_FGD2_OOR_HI" 14553120 "DTC_ICM_PILOT_FAIL_LO" 14553121 "DTC_ICM_PILOT_FAIL_HI" 14553122 "DTC_ICM_PILOT_OOR_LO" 14553123 "DTC_ICM_PILOT_OOR_HI" 14553136 "DTC_ICM_MOD_FLT_FAIL_LO" 14553137 "DTC_ICM_MOD_FLT_FAIL_HI" 14553138 "DTC_ICM_MOD_FLT_OOR_LO" 14553139 "DTC_ICM_MOD_FLT_OOR_HI" 14553152 "DTC_ICM_CLK_FAIL_LO" 14553153 "DTC_ICM_CLK_FAIL_HI" 14553154 "DTC_ICM_CLK_OOR_LO" 14553155 "DTC_ICM_CLK_OOR_HI" 14553168 "DTC_ICM_LSD_A_FAIL_LO" 14553169 "DTC_ICM_LSD_A_FAIL_HI" 14553170 "DTC_ICM_LSD_A_OOR_LO" 14553171 "DTC_ICM_LSD_A_OOR_HI" 14553184 "DTC_ICM_LSD_B_FAIL_LO" 14553185 "DTC_ICM_LSD_B_FAIL_HI" 14553186 "DTC_ICM_LSD_B_OOR_LO" 14553187 "DTC_ICM_LSD_B_OOR_HI" 14553200 "DTC_ICM_PWM_A_FAIL_LO" 14553201 "DTC_ICM_PWM_A_FAIL_HI" 14553202 "DTC_ICM_PWM_A_OOR_LO" 14553203 "DTC_ICM_PWM_A_OOR_HI" 14553216 "DTC_ICM_PWM_B_FAIL_LO" 14553217 "DTC_ICM_PWM_B_FAIL_HI" 14553218 "DTC_ICM_PWM_B_OOR_LO" 14553219 "DTC_ICM_PWM_B_OOR_HI" 14553232 "DTC_ICM_PWM_C_FAIL_LO" 14553233 "DTC_ICM_PWM_C_FAIL_HI" 14553234 "DTC_ICM_PWM_C_OOR_LO" 14553235 "DTC_ICM_PWM_C_OOR_HI" 14553248 "DTC_ICM_PWM_D_FAIL_LO" 14553249 "DTC_ICM_PWM_D_FAIL_HI" 14553250 "DTC_ICM_PWM_D_OOR_LO" 14553251 "DTC_ICM_PWM_D_OOR_HI" 14606336 "DTC_NVM_EE_0_COMM_WRITE_TO" 14606337 "DTC_NVM_EE_0_COMM_READ_TO" 14606338 "DTC_NVM_EE_0_WRITE_VERIFY" 14606339 "DTC_NVM_EE_0_READ_VERIFY" 14606340 "DTC_NVM_EE_0_READ_ERR" 14606341 "DTC_NVM_EE_0_WRITE_ERR" 14564800 "DTC_PWM_LSD_A_DC_MISMATCH" 14565344 "DTC_PWM_LSD_A_FREQ_MISMATCH" 14564801 "DTC_PWM_PWM_A_DC_MISMATCH" 14565345 "DTC_PWM_PWM_A_FREQ_MISMATCH" 14564802 "DTC_PWM_PWM_B_DC_MISMATCH" 14565346 "DTC_PWM_PWM_B_FREQ_MISMATCH" 14564803 "DTC_PWM_PWM_C_DC_MISMATCH" 14565347 "DTC_PWM_PWM_C_FREQ_MISMATCH" 14564804 "DTC_PWM_PWM_D_DC_MISMATCH" 14565348 "DTC_PWM_PWM_D_FREQ_MISMATCH" 14417920 "DTC_PWR_WAKEUP_CLK_FAILED" 14417921 "DTC_PWR_WAKEUP_CLK_OOR_LO" 14417922 "DTC_PWR_WAKEUP_CLK_OOR_HI" 14614570 "DTC_SDP_HPWR_OOR_HI" 14614571 "DTC_SDP_HPWR_OOR_LO" 14614572 "DTC_SDP_HPWR_COMM_TO" 14614573 "DTC_SDP_DEVICE_FAILURE";
VAL_ 1120 bcm_dtc_063 0 " - " 11276288 "DTC_VEPO" 11276289 "DTC_HSC_MISSING" 11460608 "DTC_NVM_SOC" 11460609 "DTC_NVM_HYST" 11460610 "DTC_NVM_KOT" 11460611 "DTC_NVM_PERIODIC_SHUTDOWN_TIME" 11460612 "DTC_NVM_WAKE" 11460613 "DTC_NVM_CALENDAR_LIFE" 11460614 "DTC_NVM_CYCLE_LIFE" 11460615 "DTC_NVM_DTC" 11460616 "DTC_NVM_APP_SCRATCHPAD" 11517962 "DTC_LOOPTIME_TASK_A" 11517963 "DTC_LOOPTIME_TASK_B" 11517964 "DTC_LOOPTIME_TASK_C" 11517965 "DTC_LOOPTIME_TASK_D" 11517966 "DTC_LOOPTIME_TASK_E" 11517967 "DTC_ILIM_MAX_DISCHARGE" 15728640 "DTC_EPO" 16171008 "DTC_CONT_OPEN" 16171009 "DTC_CONT_CLOSE" 16171010 "DTC_CONT_OPEN_CURRENT" 16171264 "DTC_CONT_CLOSE_ON_RESET" 16171265 "DTC_CONT_CLOSE_SIG_FAILED" 16171520 "DTC_PRECHARGE_TIMEOUT" 16171777 "DTC_CONT_NEG_WELD_AT_SU" 16171778 "DTC_CONT_POS_A_WELD_AT_SU" 16171779 "DTC_CONT_POS_B_WELD_AT_SU" 16172033 "DTC_CONT_NEG_WELD_AT_SD" 16172034 "DTC_CONT_POS_A_WELD_AT_SD" 16172036 "DTC_CONT_POS_B_WELD_AT_SD" 16172289 "DTC_CONT_NEG_OPEN" 16172290 "DTC_CONT_POS_A_OPEN" 16172291 "DTC_CONT_POS_B_OPEN" 16172545 "DTC_CONT_NEG_VDIF" 16172546 "DTC_CONT_POS_A_VDIF" 16172548 "DTC_CONT_POS_B_VDIF" 16174848 "DTC_HVIL" 16174849 "DTC_LVBAT_LO" 16174850 "DTC_LVBAT_HI" 16174851 "DTC_LVBAT_ERR" 16522240 "DTC_CSM_MISSING" 16522752 "DTC_CSM_VBAT" 16522753 "DTC_CSM_VPOS" 16522754 "DTC_CSM_VNEG" 16522755 "DTC_CSM_CPOS" 16522756 "DTC_CSM_CNEG" 16522757 "DTC_CSM_APOS" 16522758 "DTC_CSM_ANEG" 16522759 "DTC_CSM_FUSE_HI" 16522760 "DTC_CSM_FUSE_LO" 16521728 "DTC_CSM_ASIC" 16521729 "DTC_CSM_AILO" 16521730 "DTC_CSM_AIHI" 16520957 "DTC_LEAKAGE_DETECT_FAULT" 16522444 "DTC_REALTIMECLOCK_FAULT" 16520945 "DTC_CSM_LEAK_FAIL_CALC" 16520946 "DTC_CSM_LEAK_FAIL_HW" 16520947 "DTC_CSM_LEAK_EXT_SHORT" 16520948 "DTC_CSM_LEAK_MID_PACK_SHORT" 16520949 "DTC_CSM_LEAK_ERROR" 16520950 "DTC_CSM_LEAK_UNKNOWN" 16523008 "DTC_CSM_VER_MISMATCH" 16523009 "DTC_CSM_DTC_SET" 16523010 "DTC_CSM_CAL_FAULT" 16496320 "DTC_MBB_TOO_FEW" 16496321 "DTC_MBB_TOO_MANY" 16496352 "DTC_CELL_VMAX_ERR" 16496353 "DTC_CELL_VMIN_ERR" 16496354 "DTC_CELL_VMAX" 16496362 "DTC_CELL_VMAX_SEVERE" 16496355 "DTC_CELL_VMIN" 16496363 "DTC_CELL_VMIN_SEVERE" 16496356 "DTC_MOD_VOLTAGE_COMPARE" 16496336 "DTC_CELL_T_ERR" 16496337 "DTC_CELL_TMAX1" 16496338 "DTC_CELL_TMAX2" 16496339 "DTC_CELL_TMIN" 16497665 "DTC_MBB_01_MISSING" 16497666 "DTC_MBB_02_MISSING" 16497667 "DTC_MBB_03_MISSING" 16497668 "DTC_MBB_04_MISSING" 16497669 "DTC_MBB_05_MISSING" 16497670 "DTC_MBB_06_MISSING" 16497671 "DTC_MBB_07_MISSING" 16497672 "DTC_MBB_08_MISSING" 16497673 "DTC_MBB_09_MISSING" 16497680 "DTC_MBB_10_MISSING" 16497681 "DTC_MBB_11_MISSING" 16497682 "DTC_MBB_12_MISSING" 16497683 "DTC_MBB_13_MISSING" 16497684 "DTC_MBB_14_MISSING" 16497685 "DTC_MBB_15_MISSING" 16497686 "DTC_MBB_16_MISSING" 16497687 "DTC_MBB_17_MISSING" 16497688 "DTC_MBB_18_MISSING" 16497689 "DTC_MBB_19_MISSING" 16497696 "DTC_MBB_20_MISSING" 16497697 "DTC_MBB_21_MISSING" 16497698 "DTC_MBB_22_MISSING" 16497699 "DTC_MBB_23_MISSING" 16497700 "DTC_MBB_24_MISSING" 16498177 "DTC_MBB_01_VFAULT" 16498178 "DTC_MBB_02_VFAULT" 16498179 "DTC_MBB_03_VFAULT" 16498180 "DTC_MBB_04_VFAULT" 16498181 "DTC_MBB_05_VFAULT" 16498182 "DTC_MBB_06_VFAULT" 16498183 "DTC_MBB_07_VFAULT" 16498184 "DTC_MBB_08_VFAULT" 16498185 "DTC_MBB_09_VFAULT" 16498192 "DTC_MBB_10_VFAULT" 16498193 "DTC_MBB_11_VFAULT" 16498194 "DTC_MBB_12_VFAULT" 16498195 "DTC_MBB_13_VFAULT" 16498196 "DTC_MBB_14_VFAULT" 16498197 "DTC_MBB_15_VFAULT" 16498198 "DTC_MBB_16_VFAULT" 16498199 "DTC_MBB_17_VFAULT" 16498200 "DTC_MBB_18_VFAULT" 16498201 "DTC_MBB_19_VFAULT" 16498208 "DTC_MBB_20_VFAULT" 16498209 "DTC_MBB_21_VFAULT" 16498210 "DTC_MBB_22_VFAULT" 16498211 "DTC_MBB_23_VFAULT" 16498212 "DTC_MBB_24_VFAULT" 16497921 "DTC_MBB_01_TFAULT" 16497922 "DTC_MBB_02_TFAULT" 16497923 "DTC_MBB_03_TFAULT" 16497924 "DTC_MBB_04_TFAULT" 16497925 "DTC_MBB_05_TFAULT" 16497926 "DTC_MBB_06_TFAULT" 16497927 "DTC_MBB_07_TFAULT" 16497928 "DTC_MBB_08_TFAULT" 16497929 "DTC_MBB_09_TFAULT" 16497936 "DTC_MBB_10_TFAULT" 16497937 "DTC_MBB_11_TFAULT" 16497938 "DTC_MBB_12_TFAULT" 16497939 "DTC_MBB_13_TFAULT" 16497940 "DTC_MBB_14_TFAULT" 16497941 "DTC_MBB_15_TFAULT" 16497942 "DTC_MBB_16_TFAULT" 16497943 "DTC_MBB_17_TFAULT" 16497944 "DTC_MBB_18_TFAULT" 16497945 "DTC_MBB_19_TFAULT" 16497952 "DTC_MBB_20_TFAULT" 16497953 "DTC_MBB_21_TFAULT" 16497954 "DTC_MBB_22_TFAULT" 16497955 "DTC_MBB_23_TFAULT" 16497956 "DTC_MBB_24_TFAULT" 16498688 "DTC_BRUSA_MISSING" 16498689 "DTC_BRUSA_IDC" 16498690 "DTC_BRUSA_REQ_VS_CMD" 16560128 "DTC_IBAT_MISMATCH" 16576512 "DTC_DIS_MAX_I2T" 16576513 "DTC_CHG_MAX_I2T" 16576768 "DTC_DIS_WARNING_I2T" 16576769 "DTC_CHG_WARNING_I2T" 16523520 "DTC_LEM_A_OOR_HI" 16523521 "DTC_LEM_A_OOR_LO" 16523522 "DTC_LEM_A_FAULT" 16523776 "DTC_LEM_B_OOR_HI" 16523777 "DTC_LEM_B_OOR_LO" 16523778 "DTC_LEM_B_FAULT" 16506880 "DTC_VBAT_MISMATCH" 16506881 "DTC_VBAT_VMAX" 16506882 "DTC_VBAT_VMIN" 16506883 "DTC_PACK_FUSE_A" 16506884 "DTC_PACK_FUSE_B" 16252928 "DTC_KEY_OFF_TIME_ERROR" 16252929 "DTC_PERIODIC_OFF_TIME_ERROR" 14290944 "DTC_AIN_BPWR_FAIL_LO" 14290945 "DTC_AIN_BPWR_FAIL_HI" 14290946 "DTC_AIN_BPWR_OOR_LO" 14290947 "DTC_AIN_BPWR_OOR_HI" 14290960 "DTC_AIN_14V_FAIL_LO" 14290961 "DTC_AIN_14V_FAIL_HI" 14290962 "DTC_AIN_14V_OOR_LO" 14290963 "DTC_AIN_14V_OOR_HI" 14290976 "DTC_AIN_HPWR_FAIL_LO" 14290977 "DTC_AIN_HPWR_FAIL_HI" 14290978 "DTC_AIN_HPWR_OOR_LO" 14290979 "DTC_AIN_HPWR_OOR_HI" 14290992 "DTC_AIN_6V_FAIL_LO" 14290993 "DTC_AIN_6V_FAIL_HI" 14290994 "DTC_AIN_6V_OOR_LO" 14290995 "DTC_AIN_6V_OOR_HI" 14291008 "DTC_AIN_HVIL_FAIL_LO" 14291009 "DTC_AIN_HVIL_FAIL_HI" 14291010 "DTC_AIN_HVIL_OOR_LO" 14291011 "DTC_AIN_HVIL_OOR_HI" 14291024 "DTC_AIN_5V_PWR_FAIL_LO" 14291025 "DTC_AIN_5V_PWR_FAIL_HI" 14291026 "DTC_AIN_5V_PWR_OOR_LO" 14291027 "DTC_AIN_5V_PWR_OOR_HI" 14291040 "DTC_AIN_LEM_HI_FAIL_LO" 14291041 "DTC_AIN_LEM_HI_FAIL_HI" 14291042 "DTC_AIN_LEM_HI_OOR_LO" 14291043 "DTC_AIN_LEM_HI_OOR_HI" 14291056 "DTC_AIN_LEM_LO_FAIL_LO" 14291057 "DTC_AIN_LEM_LO_FAIL_HI" 14291058 "DTC_AIN_LEM_LO_OOR_LO" 14291059 "DTC_AIN_LEM_LO_OOR_HI" 14291072 "DTC_AIN_BCT_AI_FAIL_LO" 14291073 "DTC_AIN_BCT_AI_FAIL_HI" 14291074 "DTC_AIN_BCT_AI_OOR_LO" 14291075 "DTC_AIN_BCT_AI_OOR_HI" 14291088 "DTC_AIN_WTR2_AI_FAIL_LO" 14291089 "DTC_AIN_WTR2_AI_FAIL_HI" 14291090 "DTC_AIN_WTR2_AI_OOR_LO" 14291091 "DTC_AIN_WTR2_AI_OOR_HI" 14291104 "DTC_AIN_WTR1_AI_FAIL_LO" 14291105 "DTC_AIN_WTR1_AI_FAIL_HI" 14291106 "DTC_AIN_WTR1_AI_OOR_LO" 14291107 "DTC_AIN_WTR1_AI_OOR_HI" 14291120 "DTC_AIN_AIA_FAIL_LO" 14291121 "DTC_AIN_AIA_FAIL_HI" 14291122 "DTC_AIN_AIA_OOR_LO" 14291123 "DTC_AIN_AIA_OOR_HI" 14291136 "DTC_AIN_PROX_AI_FAIL_LO" 14291137 "DTC_AIN_PROX_AI_FAIL_HI" 14291138 "DTC_AIN_PROX_AI_OOR_LO" 14291139 "DTC_AIN_PROX_AI_OOR_HI" 14291152 "DTC_AIN_TWV_FB_FAIL_LO" 14291153 "DTC_AIN_TWV_FB_FAIL_HI" 14291154 "DTC_AIN_TWV_FB_OOR_LO" 14291155 "DTC_AIN_TWV_FB_OOR_HI" 14291168 "DTC_AIN_5V_KA_FAIL_LO" 14291169 "DTC_AIN_5V_KA_FAIL_HI" 14291170 "DTC_AIN_5V_KA_OOR_LO" 14291171 "DTC_AIN_5V_KA_OOR_HI" 14291184 "DTC_AIN_CTR1_LSD_FAIL_LO" 14291185 "DTC_AIN_CTR1_LSD_FAIL_HI" 14291186 "DTC_AIN_CTR1_LSD_OOR_LO" 14291187 "DTC_AIN_CTR1_LSD_OOR_HI" 14291200 "DTC_AIN_CTR2_LSD_FAIL_LO" 14291201 "DTC_AIN_CTR2_LSD_FAIL_HI" 14291202 "DTC_AIN_CTR2_LSD_OOR_LO" 14291203 "DTC_AIN_CTR2_LSD_OOR_HI" 14291216 "DTC_AIN_CTR3_LSD_FAIL_LO" 14291217 "DTC_AIN_CTR3_LSD_FAIL_HI" 14291218 "DTC_AIN_CTR3_LSD_OOR_LO" 14291219 "DTC_AIN_CTR3_LSD_OOR_HI" 14291232 "DTC_AIN_CTR4_LSD_FAIL_LO" 14291233 "DTC_AIN_CTR4_LSD_FAIL_HI" 14291234 "DTC_AIN_CTR4_LSD_OOR_LO" 14291235 "DTC_AIN_CTR4_LSD_OOR_HI" 14291248 "DTC_AIN_CTR5_LSD_FAIL_LO" 14291249 "DTC_AIN_CTR5_LSD_FAIL_HI" 14291250 "DTC_AIN_CTR5_LSD_OOR_LO" 14291251 "DTC_AIN_CTR5_LSD_OOR_HI" 14291264 "DTC_AIN_CTR6_LSD_FAIL_LO" 14291265 "DTC_AIN_CTR6_LSD_FAIL_HI" 14291266 "DTC_AIN_CTR6_LSD_OOR_LO" 14291267 "DTC_AIN_CTR6_LSD_OOR_HI" 14291280 "DTC_AIN_CTR7_LSD_FAIL_LO" 14291281 "DTC_AIN_CTR7_LSD_FAIL_HI" 14291282 "DTC_AIN_CTR7_LSD_OOR_LO" 14291283 "DTC_AIN_CTR7_LSD_OOR_HI" 14291296 "DTC_AIN_CTR_PWR_CUR_FAIL_LO" 14291297 "DTC_AIN_CTR_PWR_CUR_FAIL_HI" 14291298 "DTC_AIN_CTR_PWR_CUR_OOR_LO" 14291299 "DTC_AIN_CTR_PWR_CUR_OOR_HI" 14291312 "DTC_AIN_CTR_HLD_CUR_FAIL_LO" 14291313 "DTC_AIN_CTR_HLD_CUR_FAIL_HI" 14291314 "DTC_AIN_CTR_HLD_CUR_OOR_LO" 14291315 "DTC_AIN_CTR_HLD_CUR_OOR_HI" 13431040 "DTC_CTR_FAULT_LATCH" 13431041 "DTC_CTR_FAULT_INVALID_HEARTBEAT" 13373440 "DTC_CTR1_LSD_FAILED_LO" 13373441 "DTC_CTR1_LSD_FAILED_HI" 13373442 "DTC_CTR1_HSD_FAILED_LO" 13373443 "DTC_CTR1_HSD_FAILED_HI" 13373444 "DTC_CTR1_PULL_IN_SHORT" 13373445 "DTC_CTR1_PULL_IN_OPEN" 13373446 "DTC_CTR1_COIL_INVALID" 13373447 "DTC_CTR1_COIL_OPEN" 13373448 "DTC_CTR1_CIRCUIT_FAILED" 13377536 "DTC_CTR2_LSD_FAILED_LO" 13377537 "DTC_CTR2_LSD_FAILED_HI" 13377538 "DTC_CTR2_HSD_FAILED_LO" 13377539 "DTC_CTR2_HSD_FAILED_HI" 13377540 "DTC_CTR2_PULL_IN_SHORT" 13377541 "DTC_CTR2_PULL_IN_OPEN" 13377542 "DTC_CTR2_COIL_INVALID" 13377543 "DTC_CTR2_COIL_OPEN" 13377544 "DTC_CTR2_CIRCUIT_FAILED" 13381632 "DTC_CTR3_LSD_FAILED_LO" 13381633 "DTC_CTR3_LSD_FAILED_HI" 13381634 "DTC_CTR3_HSD_FAILED_LO" 13381635 "DTC_CTR3_HSD_FAILED_HI" 13381636 "DTC_CTR3_PULL_IN_SHORT" 13381637 "DTC_CTR3_PULL_IN_OPEN" 13381638 "DTC_CTR3_COIL_INVALID" 13381639 "DTC_CTR3_COIL_OPEN" 13381640 "DTC_CTR3_CIRCUIT_FAILED" 13385728 "DTC_CTR4_LSD_FAILED_LO" 13385729 "DTC_CTR4_LSD_FAILED_HI" 13385730 "DTC_CTR4_HSD_FAILED_LO" 13385731 "DTC_CTR4_HSD_FAILED_HI" 13385732 "DTC_CTR4_PULL_IN_SHORT" 13385733 "DTC_CTR4_PULL_IN_OPEN" 13385734 "DTC_CTR4_COIL_INVALID" 13385735 "DTC_CTR4_COIL_OPEN" 13385736 "DTC_CTR4_CIRCUIT_FAILED" 13389824 "DTC_CTR5_LSD_FAILED_LO" 13389825 "DTC_CTR5_LSD_FAILED_HI" 13389826 "DTC_CTR5_HSD_FAILED_LO" 13389827 "DTC_CTR5_HSD_FAILED_HI" 13389828 "DTC_CTR5_PULL_IN_SHORT" 13389829 "DTC_CTR5_PULL_IN_OPEN" 13389830 "DTC_CTR5_COIL_INVALID" 13389831 "DTC_CTR5_COIL_OPEN" 13389832 "DTC_CTR5_CIRCUIT_FAILED" 13393920 "DTC_CTR6_LSD_FAILED_LO" 13393921 "DTC_CTR6_LSD_FAILED_HI" 13393922 "DTC_CTR6_HSD_FAILED_LO" 13393923 "DTC_CTR6_HSD_FAILED_HI" 13393924 "DTC_CTR6_PULL_IN_SHORT" 13393925 "DTC_CTR6_PULL_IN_OPEN" 13393926 "DTC_CTR6_COIL_INVALID" 13393927 "DTC_CTR6_COIL_OPEN" 13393928 "DTC_CTR6_CIRCUIT_FAILED" 13398016 "DTC_CTR7_LSD_FAILED_LO" 13398017 "DTC_CTR7_LSD_FAILED_HI" 13398018 "DTC_CTR7_HSD_FAILED_LO" 13398019 "DTC_CTR7_HSD_FAILED_HI" 13398020 "DTC_CTR7_PULL_IN_SHORT" 13398021 "DTC_CTR7_PULL_IN_OPEN" 13398022 "DTC_CTR7_COIL_INVALID" 13398023 "DTC_CTR7_COIL_OPEN" 13398024 "DTC_CTR7_CIRCUIT_FAILED" 14483456 "DTC_DRV_SW14V_PWR_FAILED_LO" 14483457 "DTC_DRV_SW14V_PWR_FAILED_HI" 14483472 "DTC_DRV_CHRGA_ENA_FAILED_LO" 14483473 "DTC_DRV_CHRGA_ENA_FAILED_HI" 14483488 "DTC_DRV_CHRGB_ENA_FAILED_LO" 14483489 "DTC_DRV_CHRGB_ENA_FAILED_HI" 14483504 "DTC_DRV_LSDA_FAILED_LO" 14483505 "DTC_DRV_LSDA_FAILED_HI" 14483520 "DTC_DRV_LSDB_FAILED_LO" 14483521 "DTC_DRV_LSDB_FAILED_HI" 14483536 "DTC_DRV_HSDA_FAILED_LO" 14483537 "DTC_DRV_HSDA_FAILED_HI" 14483552 "DTC_DRV_HSDB_FAILED_LO" 14483553 "DTC_DRV_HSDB_FAILED_HI" 14553088 "DTC_ICM_FGD1_FAIL_LO" 14553089 "DTC_ICM_FGD1_FAIL_HI" 14553090 "DTC_ICM_FGD1_OOR_LO" 14553091 "DTC_ICM_FGD1_OOR_HI" 14553104 "DTC_ICM_FGD2_FAIL_LO" 14553105 "DTC_ICM_FGD2_FAIL_HI" 14553106 "DTC_ICM_FGD2_OOR_LO" 14553107 "DTC_ICM_FGD2_OOR_HI" 14553120 "DTC_ICM_PILOT_FAIL_LO" 14553121 "DTC_ICM_PILOT_FAIL_HI" 14553122 "DTC_ICM_PILOT_OOR_LO" 14553123 "DTC_ICM_PILOT_OOR_HI" 14553136 "DTC_ICM_MOD_FLT_FAIL_LO" 14553137 "DTC_ICM_MOD_FLT_FAIL_HI" 14553138 "DTC_ICM_MOD_FLT_OOR_LO" 14553139 "DTC_ICM_MOD_FLT_OOR_HI" 14553152 "DTC_ICM_CLK_FAIL_LO" 14553153 "DTC_ICM_CLK_FAIL_HI" 14553154 "DTC_ICM_CLK_OOR_LO" 14553155 "DTC_ICM_CLK_OOR_HI" 14553168 "DTC_ICM_LSD_A_FAIL_LO" 14553169 "DTC_ICM_LSD_A_FAIL_HI" 14553170 "DTC_ICM_LSD_A_OOR_LO" 14553171 "DTC_ICM_LSD_A_OOR_HI" 14553184 "DTC_ICM_LSD_B_FAIL_LO" 14553185 "DTC_ICM_LSD_B_FAIL_HI" 14553186 "DTC_ICM_LSD_B_OOR_LO" 14553187 "DTC_ICM_LSD_B_OOR_HI" 14553200 "DTC_ICM_PWM_A_FAIL_LO" 14553201 "DTC_ICM_PWM_A_FAIL_HI" 14553202 "DTC_ICM_PWM_A_OOR_LO" 14553203 "DTC_ICM_PWM_A_OOR_HI" 14553216 "DTC_ICM_PWM_B_FAIL_LO" 14553217 "DTC_ICM_PWM_B_FAIL_HI" 14553218 "DTC_ICM_PWM_B_OOR_LO" 14553219 "DTC_ICM_PWM_B_OOR_HI" 14553232 "DTC_ICM_PWM_C_FAIL_LO" 14553233 "DTC_ICM_PWM_C_FAIL_HI" 14553234 "DTC_ICM_PWM_C_OOR_LO" 14553235 "DTC_ICM_PWM_C_OOR_HI" 14553248 "DTC_ICM_PWM_D_FAIL_LO" 14553249 "DTC_ICM_PWM_D_FAIL_HI" 14553250 "DTC_ICM_PWM_D_OOR_LO" 14553251 "DTC_ICM_PWM_D_OOR_HI" 14606336 "DTC_NVM_EE_0_COMM_WRITE_TO" 14606337 "DTC_NVM_EE_0_COMM_READ_TO" 14606338 "DTC_NVM_EE_0_WRITE_VERIFY" 14606339 "DTC_NVM_EE_0_READ_VERIFY" 14606340 "DTC_NVM_EE_0_READ_ERR" 14606341 "DTC_NVM_EE_0_WRITE_ERR" 14564800 "DTC_PWM_LSD_A_DC_MISMATCH" 14565344 "DTC_PWM_LSD_A_FREQ_MISMATCH" 14564801 "DTC_PWM_PWM_A_DC_MISMATCH" 14565345 "DTC_PWM_PWM_A_FREQ_MISMATCH" 14564802 "DTC_PWM_PWM_B_DC_MISMATCH" 14565346 "DTC_PWM_PWM_B_FREQ_MISMATCH" 14564803 "DTC_PWM_PWM_C_DC_MISMATCH" 14565347 "DTC_PWM_PWM_C_FREQ_MISMATCH" 14564804 "DTC_PWM_PWM_D_DC_MISMATCH" 14565348 "DTC_PWM_PWM_D_FREQ_MISMATCH" 14417920 "DTC_PWR_WAKEUP_CLK_FAILED" 14417921 "DTC_PWR_WAKEUP_CLK_OOR_LO" 14417922 "DTC_PWR_WAKEUP_CLK_OOR_HI" 14614570 "DTC_SDP_HPWR_OOR_HI" 14614571 "DTC_SDP_HPWR_OOR_LO" 14614572 "DTC_SDP_HPWR_COMM_TO" 14614573 "DTC_SDP_DEVICE_FAILURE";
VAL_ 1120 bcm_dtc_064 0 " - " 11276288 "DTC_VEPO" 11276289 "DTC_HSC_MISSING" 11460608 "DTC_NVM_SOC" 11460609 "DTC_NVM_HYST" 11460610 "DTC_NVM_KOT" 11460611 "DTC_NVM_PERIODIC_SHUTDOWN_TIME" 11460612 "DTC_NVM_WAKE" 11460613 "DTC_NVM_CALENDAR_LIFE" 11460614 "DTC_NVM_CYCLE_LIFE" 11460615 "DTC_NVM_DTC" 11460616 "DTC_NVM_APP_SCRATCHPAD" 11517962 "DTC_LOOPTIME_TASK_A" 11517963 "DTC_LOOPTIME_TASK_B" 11517964 "DTC_LOOPTIME_TASK_C" 11517965 "DTC_LOOPTIME_TASK_D" 11517966 "DTC_LOOPTIME_TASK_E" 11517967 "DTC_ILIM_MAX_DISCHARGE" 15728640 "DTC_EPO" 16171008 "DTC_CONT_OPEN" 16171009 "DTC_CONT_CLOSE" 16171010 "DTC_CONT_OPEN_CURRENT" 16171264 "DTC_CONT_CLOSE_ON_RESET" 16171265 "DTC_CONT_CLOSE_SIG_FAILED" 16171520 "DTC_PRECHARGE_TIMEOUT" 16171777 "DTC_CONT_NEG_WELD_AT_SU" 16171778 "DTC_CONT_POS_A_WELD_AT_SU" 16171779 "DTC_CONT_POS_B_WELD_AT_SU" 16172033 "DTC_CONT_NEG_WELD_AT_SD" 16172034 "DTC_CONT_POS_A_WELD_AT_SD" 16172036 "DTC_CONT_POS_B_WELD_AT_SD" 16172289 "DTC_CONT_NEG_OPEN" 16172290 "DTC_CONT_POS_A_OPEN" 16172291 "DTC_CONT_POS_B_OPEN" 16172545 "DTC_CONT_NEG_VDIF" 16172546 "DTC_CONT_POS_A_VDIF" 16172548 "DTC_CONT_POS_B_VDIF" 16174848 "DTC_HVIL" 16174849 "DTC_LVBAT_LO" 16174850 "DTC_LVBAT_HI" 16174851 "DTC_LVBAT_ERR" 16522240 "DTC_CSM_MISSING" 16522752 "DTC_CSM_VBAT" 16522753 "DTC_CSM_VPOS" 16522754 "DTC_CSM_VNEG" 16522755 "DTC_CSM_CPOS" 16522756 "DTC_CSM_CNEG" 16522757 "DTC_CSM_APOS" 16522758 "DTC_CSM_ANEG" 16522759 "DTC_CSM_FUSE_HI" 16522760 "DTC_CSM_FUSE_LO" 16521728 "DTC_CSM_ASIC" 16521729 "DTC_CSM_AILO" 16521730 "DTC_CSM_AIHI" 16520957 "DTC_LEAKAGE_DETECT_FAULT" 16522444 "DTC_REALTIMECLOCK_FAULT" 16520945 "DTC_CSM_LEAK_FAIL_CALC" 16520946 "DTC_CSM_LEAK_FAIL_HW" 16520947 "DTC_CSM_LEAK_EXT_SHORT" 16520948 "DTC_CSM_LEAK_MID_PACK_SHORT" 16520949 "DTC_CSM_LEAK_ERROR" 16520950 "DTC_CSM_LEAK_UNKNOWN" 16523008 "DTC_CSM_VER_MISMATCH" 16523009 "DTC_CSM_DTC_SET" 16523010 "DTC_CSM_CAL_FAULT" 16496320 "DTC_MBB_TOO_FEW" 16496321 "DTC_MBB_TOO_MANY" 16496352 "DTC_CELL_VMAX_ERR" 16496353 "DTC_CELL_VMIN_ERR" 16496354 "DTC_CELL_VMAX" 16496362 "DTC_CELL_VMAX_SEVERE" 16496355 "DTC_CELL_VMIN" 16496363 "DTC_CELL_VMIN_SEVERE" 16496356 "DTC_MOD_VOLTAGE_COMPARE" 16496336 "DTC_CELL_T_ERR" 16496337 "DTC_CELL_TMAX1" 16496338 "DTC_CELL_TMAX2" 16496339 "DTC_CELL_TMIN" 16497665 "DTC_MBB_01_MISSING" 16497666 "DTC_MBB_02_MISSING" 16497667 "DTC_MBB_03_MISSING" 16497668 "DTC_MBB_04_MISSING" 16497669 "DTC_MBB_05_MISSING" 16497670 "DTC_MBB_06_MISSING" 16497671 "DTC_MBB_07_MISSING" 16497672 "DTC_MBB_08_MISSING" 16497673 "DTC_MBB_09_MISSING" 16497680 "DTC_MBB_10_MISSING" 16497681 "DTC_MBB_11_MISSING" 16497682 "DTC_MBB_12_MISSING" 16497683 "DTC_MBB_13_MISSING" 16497684 "DTC_MBB_14_MISSING" 16497685 "DTC_MBB_15_MISSING" 16497686 "DTC_MBB_16_MISSING" 16497687 "DTC_MBB_17_MISSING" 16497688 "DTC_MBB_18_MISSING" 16497689 "DTC_MBB_19_MISSING" 16497696 "DTC_MBB_20_MISSING" 16497697 "DTC_MBB_21_MISSING" 16497698 "DTC_MBB_22_MISSING" 16497699 "DTC_MBB_23_MISSING" 16497700 "DTC_MBB_24_MISSING" 16498177 "DTC_MBB_01_VFAULT" 16498178 "DTC_MBB_02_VFAULT" 16498179 "DTC_MBB_03_VFAULT" 16498180 "DTC_MBB_04_VFAULT" 16498181 "DTC_MBB_05_VFAULT" 16498182 "DTC_MBB_06_VFAULT" 16498183 "DTC_MBB_07_VFAULT" 16498184 "DTC_MBB_08_VFAULT" 16498185 "DTC_MBB_09_VFAULT" 16498192 "DTC_MBB_10_VFAULT" 16498193 "DTC_MBB_11_VFAULT" 16498194 "DTC_MBB_12_VFAULT" 16498195 "DTC_MBB_13_VFAULT" 16498196 "DTC_MBB_14_VFAULT" 16498197 "DTC_MBB_15_VFAULT" 16498198 "DTC_MBB_16_VFAULT" 16498199 "DTC_MBB_17_VFAULT" 16498200 "DTC_MBB_18_VFAULT" 16498201 "DTC_MBB_19_VFAULT" 16498208 "DTC_MBB_20_VFAULT" 16498209 "DTC_MBB_21_VFAULT" 16498210 "DTC_MBB_22_VFAULT" 16498211 "DTC_MBB_23_VFAULT" 16498212 "DTC_MBB_24_VFAULT" 16497921 "DTC_MBB_01_TFAULT" 16497922 "DTC_MBB_02_TFAULT" 16497923 "DTC_MBB_03_TFAULT" 16497924 "DTC_MBB_04_TFAULT" 16497925 "DTC_MBB_05_TFAULT" 16497926 "DTC_MBB_06_TFAULT" 16497927 "DTC_MBB_07_TFAULT" 16497928 "DTC_MBB_08_TFAULT" 16497929 "DTC_MBB_09_TFAULT" 16497936 "DTC_MBB_10_TFAULT" 16497937 "DTC_MBB_11_TFAULT" 16497938 "DTC_MBB_12_TFAULT" 16497939 "DTC_MBB_13_TFAULT" 16497940 "DTC_MBB_14_TFAULT" 16497941 "DTC_MBB_15_TFAULT" 16497942 "DTC_MBB_16_TFAULT" 16497943 "DTC_MBB_17_TFAULT" 16497944 "DTC_MBB_18_TFAULT" 16497945 "DTC_MBB_19_TFAULT" 16497952 "DTC_MBB_20_TFAULT" 16497953 "DTC_MBB_21_TFAULT" 16497954 "DTC_MBB_22_TFAULT" 16497955 "DTC_MBB_23_TFAULT" 16497956 "DTC_MBB_24_TFAULT" 16498688 "DTC_BRUSA_MISSING" 16498689 "DTC_BRUSA_IDC" 16498690 "DTC_BRUSA_REQ_VS_CMD" 16560128 "DTC_IBAT_MISMATCH" 16576512 "DTC_DIS_MAX_I2T" 16576513 "DTC_CHG_MAX_I2T" 16576768 "DTC_DIS_WARNING_I2T" 16576769 "DTC_CHG_WARNING_I2T" 16523520 "DTC_LEM_A_OOR_HI" 16523521 "DTC_LEM_A_OOR_LO" 16523522 "DTC_LEM_A_FAULT" 16523776 "DTC_LEM_B_OOR_HI" 16523777 "DTC_LEM_B_OOR_LO" 16523778 "DTC_LEM_B_FAULT" 16506880 "DTC_VBAT_MISMATCH" 16506881 "DTC_VBAT_VMAX" 16506882 "DTC_VBAT_VMIN" 16506883 "DTC_PACK_FUSE_A" 16506884 "DTC_PACK_FUSE_B" 16252928 "DTC_KEY_OFF_TIME_ERROR" 16252929 "DTC_PERIODIC_OFF_TIME_ERROR" 14290944 "DTC_AIN_BPWR_FAIL_LO" 14290945 "DTC_AIN_BPWR_FAIL_HI" 14290946 "DTC_AIN_BPWR_OOR_LO" 14290947 "DTC_AIN_BPWR_OOR_HI" 14290960 "DTC_AIN_14V_FAIL_LO" 14290961 "DTC_AIN_14V_FAIL_HI" 14290962 "DTC_AIN_14V_OOR_LO" 14290963 "DTC_AIN_14V_OOR_HI" 14290976 "DTC_AIN_HPWR_FAIL_LO" 14290977 "DTC_AIN_HPWR_FAIL_HI" 14290978 "DTC_AIN_HPWR_OOR_LO" 14290979 "DTC_AIN_HPWR_OOR_HI" 14290992 "DTC_AIN_6V_FAIL_LO" 14290993 "DTC_AIN_6V_FAIL_HI" 14290994 "DTC_AIN_6V_OOR_LO" 14290995 "DTC_AIN_6V_OOR_HI" 14291008 "DTC_AIN_HVIL_FAIL_LO" 14291009 "DTC_AIN_HVIL_FAIL_HI" 14291010 "DTC_AIN_HVIL_OOR_LO" 14291011 "DTC_AIN_HVIL_OOR_HI" 14291024 "DTC_AIN_5V_PWR_FAIL_LO" 14291025 "DTC_AIN_5V_PWR_FAIL_HI" 14291026 "DTC_AIN_5V_PWR_OOR_LO" 14291027 "DTC_AIN_5V_PWR_OOR_HI" 14291040 "DTC_AIN_LEM_HI_FAIL_LO" 14291041 "DTC_AIN_LEM_HI_FAIL_HI" 14291042 "DTC_AIN_LEM_HI_OOR_LO" 14291043 "DTC_AIN_LEM_HI_OOR_HI" 14291056 "DTC_AIN_LEM_LO_FAIL_LO" 14291057 "DTC_AIN_LEM_LO_FAIL_HI" 14291058 "DTC_AIN_LEM_LO_OOR_LO" 14291059 "DTC_AIN_LEM_LO_OOR_HI" 14291072 "DTC_AIN_BCT_AI_FAIL_LO" 14291073 "DTC_AIN_BCT_AI_FAIL_HI" 14291074 "DTC_AIN_BCT_AI_OOR_LO" 14291075 "DTC_AIN_BCT_AI_OOR_HI" 14291088 "DTC_AIN_WTR2_AI_FAIL_LO" 14291089 "DTC_AIN_WTR2_AI_FAIL_HI" 14291090 "DTC_AIN_WTR2_AI_OOR_LO" 14291091 "DTC_AIN_WTR2_AI_OOR_HI" 14291104 "DTC_AIN_WTR1_AI_FAIL_LO" 14291105 "DTC_AIN_WTR1_AI_FAIL_HI" 14291106 "DTC_AIN_WTR1_AI_OOR_LO" 14291107 "DTC_AIN_WTR1_AI_OOR_HI" 14291120 "DTC_AIN_AIA_FAIL_LO" 14291121 "DTC_AIN_AIA_FAIL_HI" 14291122 "DTC_AIN_AIA_OOR_LO" 14291123 "DTC_AIN_AIA_OOR_HI" 14291136 "DTC_AIN_PROX_AI_FAIL_LO" 14291137 "DTC_AIN_PROX_AI_FAIL_HI" 14291138 "DTC_AIN_PROX_AI_OOR_LO" 14291139 "DTC_AIN_PROX_AI_OOR_HI" 14291152 "DTC_AIN_TWV_FB_FAIL_LO" 14291153 "DTC_AIN_TWV_FB_FAIL_HI" 14291154 "DTC_AIN_TWV_FB_OOR_LO" 14291155 "DTC_AIN_TWV_FB_OOR_HI" 14291168 "DTC_AIN_5V_KA_FAIL_LO" 14291169 "DTC_AIN_5V_KA_FAIL_HI" 14291170 "DTC_AIN_5V_KA_OOR_LO" 14291171 "DTC_AIN_5V_KA_OOR_HI" 14291184 "DTC_AIN_CTR1_LSD_FAIL_LO" 14291185 "DTC_AIN_CTR1_LSD_FAIL_HI" 14291186 "DTC_AIN_CTR1_LSD_OOR_LO" 14291187 "DTC_AIN_CTR1_LSD_OOR_HI" 14291200 "DTC_AIN_CTR2_LSD_FAIL_LO" 14291201 "DTC_AIN_CTR2_LSD_FAIL_HI" 14291202 "DTC_AIN_CTR2_LSD_OOR_LO" 14291203 "DTC_AIN_CTR2_LSD_OOR_HI" 14291216 "DTC_AIN_CTR3_LSD_FAIL_LO" 14291217 "DTC_AIN_CTR3_LSD_FAIL_HI" 14291218 "DTC_AIN_CTR3_LSD_OOR_LO" 14291219 "DTC_AIN_CTR3_LSD_OOR_HI" 14291232 "DTC_AIN_CTR4_LSD_FAIL_LO" 14291233 "DTC_AIN_CTR4_LSD_FAIL_HI" 14291234 "DTC_AIN_CTR4_LSD_OOR_LO" 14291235 "DTC_AIN_CTR4_LSD_OOR_HI" 14291248 "DTC_AIN_CTR5_LSD_FAIL_LO" 14291249 "DTC_AIN_CTR5_LSD_FAIL_HI" 14291250 "DTC_AIN_CTR5_LSD_OOR_LO" 14291251 "DTC_AIN_CTR5_LSD_OOR_HI" 14291264 "DTC_AIN_CTR6_LSD_FAIL_LO" 14291265 "DTC_AIN_CTR6_LSD_FAIL_HI" 14291266 "DTC_AIN_CTR6_LSD_OOR_LO" 14291267 "DTC_AIN_CTR6_LSD_OOR_HI" 14291280 "DTC_AIN_CTR7_LSD_FAIL_LO" 14291281 "DTC_AIN_CTR7_LSD_FAIL_HI" 14291282 "DTC_AIN_CTR7_LSD_OOR_LO" 14291283 "DTC_AIN_CTR7_LSD_OOR_HI" 14291296 "DTC_AIN_CTR_PWR_CUR_FAIL_LO" 14291297 "DTC_AIN_CTR_PWR_CUR_FAIL_HI" 14291298 "DTC_AIN_CTR_PWR_CUR_OOR_LO" 14291299 "DTC_AIN_CTR_PWR_CUR_OOR_HI" 14291312 "DTC_AIN_CTR_HLD_CUR_FAIL_LO" 14291313 "DTC_AIN_CTR_HLD_CUR_FAIL_HI" 14291314 "DTC_AIN_CTR_HLD_CUR_OOR_LO" 14291315 "DTC_AIN_CTR_HLD_CUR_OOR_HI" 13431040 "DTC_CTR_FAULT_LATCH" 13431041 "DTC_CTR_FAULT_INVALID_HEARTBEAT" 13373440 "DTC_CTR1_LSD_FAILED_LO" 13373441 "DTC_CTR1_LSD_FAILED_HI" 13373442 "DTC_CTR1_HSD_FAILED_LO" 13373443 "DTC_CTR1_HSD_FAILED_HI" 13373444 "DTC_CTR1_PULL_IN_SHORT" 13373445 "DTC_CTR1_PULL_IN_OPEN" 13373446 "DTC_CTR1_COIL_INVALID" 13373447 "DTC_CTR1_COIL_OPEN" 13373448 "DTC_CTR1_CIRCUIT_FAILED" 13377536 "DTC_CTR2_LSD_FAILED_LO" 13377537 "DTC_CTR2_LSD_FAILED_HI" 13377538 "DTC_CTR2_HSD_FAILED_LO" 13377539 "DTC_CTR2_HSD_FAILED_HI" 13377540 "DTC_CTR2_PULL_IN_SHORT" 13377541 "DTC_CTR2_PULL_IN_OPEN" 13377542 "DTC_CTR2_COIL_INVALID" 13377543 "DTC_CTR2_COIL_OPEN" 13377544 "DTC_CTR2_CIRCUIT_FAILED" 13381632 "DTC_CTR3_LSD_FAILED_LO" 13381633 "DTC_CTR3_LSD_FAILED_HI" 13381634 "DTC_CTR3_HSD_FAILED_LO" 13381635 "DTC_CTR3_HSD_FAILED_HI" 13381636 "DTC_CTR3_PULL_IN_SHORT" 13381637 "DTC_CTR3_PULL_IN_OPEN" 13381638 "DTC_CTR3_COIL_INVALID" 13381639 "DTC_CTR3_COIL_OPEN" 13381640 "DTC_CTR3_CIRCUIT_FAILED" 13385728 "DTC_CTR4_LSD_FAILED_LO" 13385729 "DTC_CTR4_LSD_FAILED_HI" 13385730 "DTC_CTR4_HSD_FAILED_LO" 13385731 "DTC_CTR4_HSD_FAILED_HI" 13385732 "DTC_CTR4_PULL_IN_SHORT" 13385733 "DTC_CTR4_PULL_IN_OPEN" 13385734 "DTC_CTR4_COIL_INVALID" 13385735 "DTC_CTR4_COIL_OPEN" 13385736 "DTC_CTR4_CIRCUIT_FAILED" 13389824 "DTC_CTR5_LSD_FAILED_LO" 13389825 "DTC_CTR5_LSD_FAILED_HI" 13389826 "DTC_CTR5_HSD_FAILED_LO" 13389827 "DTC_CTR5_HSD_FAILED_HI" 13389828 "DTC_CTR5_PULL_IN_SHORT" 13389829 "DTC_CTR5_PULL_IN_OPEN" 13389830 "DTC_CTR5_COIL_INVALID" 13389831 "DTC_CTR5_COIL_OPEN" 13389832 "DTC_CTR5_CIRCUIT_FAILED" 13393920 "DTC_CTR6_LSD_FAILED_LO" 13393921 "DTC_CTR6_LSD_FAILED_HI" 13393922 "DTC_CTR6_HSD_FAILED_LO" 13393923 "DTC_CTR6_HSD_FAILED_HI" 13393924 "DTC_CTR6_PULL_IN_SHORT" 13393925 "DTC_CTR6_PULL_IN_OPEN" 13393926 "DTC_CTR6_COIL_INVALID" 13393927 "DTC_CTR6_COIL_OPEN" 13393928 "DTC_CTR6_CIRCUIT_FAILED" 13398016 "DTC_CTR7_LSD_FAILED_LO" 13398017 "DTC_CTR7_LSD_FAILED_HI" 13398018 "DTC_CTR7_HSD_FAILED_LO" 13398019 "DTC_CTR7_HSD_FAILED_HI" 13398020 "DTC_CTR7_PULL_IN_SHORT" 13398021 "DTC_CTR7_PULL_IN_OPEN" 13398022 "DTC_CTR7_COIL_INVALID" 13398023 "DTC_CTR7_COIL_OPEN" 13398024 "DTC_CTR7_CIRCUIT_FAILED" 14483456 "DTC_DRV_SW14V_PWR_FAILED_LO" 14483457 "DTC_DRV_SW14V_PWR_FAILED_HI" 14483472 "DTC_DRV_CHRGA_ENA_FAILED_LO" 14483473 "DTC_DRV_CHRGA_ENA_FAILED_HI" 14483488 "DTC_DRV_CHRGB_ENA_FAILED_LO" 14483489 "DTC_DRV_CHRGB_ENA_FAILED_HI" 14483504 "DTC_DRV_LSDA_FAILED_LO" 14483505 "DTC_DRV_LSDA_FAILED_HI" 14483520 "DTC_DRV_LSDB_FAILED_LO" 14483521 "DTC_DRV_LSDB_FAILED_HI" 14483536 "DTC_DRV_HSDA_FAILED_LO" 14483537 "DTC_DRV_HSDA_FAILED_HI" 14483552 "DTC_DRV_HSDB_FAILED_LO" 14483553 "DTC_DRV_HSDB_FAILED_HI" 14553088 "DTC_ICM_FGD1_FAIL_LO" 14553089 "DTC_ICM_FGD1_FAIL_HI" 14553090 "DTC_ICM_FGD1_OOR_LO" 14553091 "DTC_ICM_FGD1_OOR_HI" 14553104 "DTC_ICM_FGD2_FAIL_LO" 14553105 "DTC_ICM_FGD2_FAIL_HI" 14553106 "DTC_ICM_FGD2_OOR_LO" 14553107 "DTC_ICM_FGD2_OOR_HI" 14553120 "DTC_ICM_PILOT_FAIL_LO" 14553121 "DTC_ICM_PILOT_FAIL_HI" 14553122 "DTC_ICM_PILOT_OOR_LO" 14553123 "DTC_ICM_PILOT_OOR_HI" 14553136 "DTC_ICM_MOD_FLT_FAIL_LO" 14553137 "DTC_ICM_MOD_FLT_FAIL_HI" 14553138 "DTC_ICM_MOD_FLT_OOR_LO" 14553139 "DTC_ICM_MOD_FLT_OOR_HI" 14553152 "DTC_ICM_CLK_FAIL_LO" 14553153 "DTC_ICM_CLK_FAIL_HI" 14553154 "DTC_ICM_CLK_OOR_LO" 14553155 "DTC_ICM_CLK_OOR_HI" 14553168 "DTC_ICM_LSD_A_FAIL_LO" 14553169 "DTC_ICM_LSD_A_FAIL_HI" 14553170 "DTC_ICM_LSD_A_OOR_LO" 14553171 "DTC_ICM_LSD_A_OOR_HI" 14553184 "DTC_ICM_LSD_B_FAIL_LO" 14553185 "DTC_ICM_LSD_B_FAIL_HI" 14553186 "DTC_ICM_LSD_B_OOR_LO" 14553187 "DTC_ICM_LSD_B_OOR_HI" 14553200 "DTC_ICM_PWM_A_FAIL_LO" 14553201 "DTC_ICM_PWM_A_FAIL_HI" 14553202 "DTC_ICM_PWM_A_OOR_LO" 14553203 "DTC_ICM_PWM_A_OOR_HI" 14553216 "DTC_ICM_PWM_B_FAIL_LO" 14553217 "DTC_ICM_PWM_B_FAIL_HI" 14553218 "DTC_ICM_PWM_B_OOR_LO" 14553219 "DTC_ICM_PWM_B_OOR_HI" 14553232 "DTC_ICM_PWM_C_FAIL_LO" 14553233 "DTC_ICM_PWM_C_FAIL_HI" 14553234 "DTC_ICM_PWM_C_OOR_LO" 14553235 "DTC_ICM_PWM_C_OOR_HI" 14553248 "DTC_ICM_PWM_D_FAIL_LO" 14553249 "DTC_ICM_PWM_D_FAIL_HI" 14553250 "DTC_ICM_PWM_D_OOR_LO" 14553251 "DTC_ICM_PWM_D_OOR_HI" 14606336 "DTC_NVM_EE_0_COMM_WRITE_TO" 14606337 "DTC_NVM_EE_0_COMM_READ_TO" 14606338 "DTC_NVM_EE_0_WRITE_VERIFY" 14606339 "DTC_NVM_EE_0_READ_VERIFY" 14606340 "DTC_NVM_EE_0_READ_ERR" 14606341 "DTC_NVM_EE_0_WRITE_ERR" 14564800 "DTC_PWM_LSD_A_DC_MISMATCH" 14565344 "DTC_PWM_LSD_A_FREQ_MISMATCH" 14564801 "DTC_PWM_PWM_A_DC_MISMATCH" 14565345 "DTC_PWM_PWM_A_FREQ_MISMATCH" 14564802 "DTC_PWM_PWM_B_DC_MISMATCH" 14565346 "DTC_PWM_PWM_B_FREQ_MISMATCH" 14564803 "DTC_PWM_PWM_C_DC_MISMATCH" 14565347 "DTC_PWM_PWM_C_FREQ_MISMATCH" 14564804 "DTC_PWM_PWM_D_DC_MISMATCH" 14565348 "DTC_PWM_PWM_D_FREQ_MISMATCH" 14417920 "DTC_PWR_WAKEUP_CLK_FAILED" 14417921 "DTC_PWR_WAKEUP_CLK_OOR_LO" 14417922 "DTC_PWR_WAKEUP_CLK_OOR_HI" 14614570 "DTC_SDP_HPWR_OOR_HI" 14614571 "DTC_SDP_HPWR_OOR_LO" 14614572 "DTC_SDP_HPWR_COMM_TO" 14614573 "DTC_SDP_DEVICE_FAILURE";
VAL_ 1120 bcm_dtc_065 0 " - " 11276288 "DTC_VEPO" 11276289 "DTC_HSC_MISSING" 11460608 "DTC_NVM_SOC" 11460609 "DTC_NVM_HYST" 11460610 "DTC_NVM_KOT" 11460611 "DTC_NVM_PERIODIC_SHUTDOWN_TIME" 11460612 "DTC_NVM_WAKE" 11460613 "DTC_NVM_CALENDAR_LIFE" 11460614 "DTC_NVM_CYCLE_LIFE" 11460615 "DTC_NVM_DTC" 11460616 "DTC_NVM_APP_SCRATCHPAD" 11517962 "DTC_LOOPTIME_TASK_A" 11517963 "DTC_LOOPTIME_TASK_B" 11517964 "DTC_LOOPTIME_TASK_C" 11517965 "DTC_LOOPTIME_TASK_D" 11517966 "DTC_LOOPTIME_TASK_E" 11517967 "DTC_ILIM_MAX_DISCHARGE" 15728640 "DTC_EPO" 16171008 "DTC_CONT_OPEN" 16171009 "DTC_CONT_CLOSE" 16171010 "DTC_CONT_OPEN_CURRENT" 16171264 "DTC_CONT_CLOSE_ON_RESET" 16171265 "DTC_CONT_CLOSE_SIG_FAILED" 16171520 "DTC_PRECHARGE_TIMEOUT" 16171777 "DTC_CONT_NEG_WELD_AT_SU" 16171778 "DTC_CONT_POS_A_WELD_AT_SU" 16171779 "DTC_CONT_POS_B_WELD_AT_SU" 16172033 "DTC_CONT_NEG_WELD_AT_SD" 16172034 "DTC_CONT_POS_A_WELD_AT_SD" 16172036 "DTC_CONT_POS_B_WELD_AT_SD" 16172289 "DTC_CONT_NEG_OPEN" 16172290 "DTC_CONT_POS_A_OPEN" 16172291 "DTC_CONT_POS_B_OPEN" 16172545 "DTC_CONT_NEG_VDIF" 16172546 "DTC_CONT_POS_A_VDIF" 16172548 "DTC_CONT_POS_B_VDIF" 16174848 "DTC_HVIL" 16174849 "DTC_LVBAT_LO" 16174850 "DTC_LVBAT_HI" 16174851 "DTC_LVBAT_ERR" 16522240 "DTC_CSM_MISSING" 16522752 "DTC_CSM_VBAT" 16522753 "DTC_CSM_VPOS" 16522754 "DTC_CSM_VNEG" 16522755 "DTC_CSM_CPOS" 16522756 "DTC_CSM_CNEG" 16522757 "DTC_CSM_APOS" 16522758 "DTC_CSM_ANEG" 16522759 "DTC_CSM_FUSE_HI" 16522760 "DTC_CSM_FUSE_LO" 16521728 "DTC_CSM_ASIC" 16521729 "DTC_CSM_AILO" 16521730 "DTC_CSM_AIHI" 16520957 "DTC_LEAKAGE_DETECT_FAULT" 16522444 "DTC_REALTIMECLOCK_FAULT" 16520945 "DTC_CSM_LEAK_FAIL_CALC" 16520946 "DTC_CSM_LEAK_FAIL_HW" 16520947 "DTC_CSM_LEAK_EXT_SHORT" 16520948 "DTC_CSM_LEAK_MID_PACK_SHORT" 16520949 "DTC_CSM_LEAK_ERROR" 16520950 "DTC_CSM_LEAK_UNKNOWN" 16523008 "DTC_CSM_VER_MISMATCH" 16523009 "DTC_CSM_DTC_SET" 16523010 "DTC_CSM_CAL_FAULT" 16496320 "DTC_MBB_TOO_FEW" 16496321 "DTC_MBB_TOO_MANY" 16496352 "DTC_CELL_VMAX_ERR" 16496353 "DTC_CELL_VMIN_ERR" 16496354 "DTC_CELL_VMAX" 16496362 "DTC_CELL_VMAX_SEVERE" 16496355 "DTC_CELL_VMIN" 16496363 "DTC_CELL_VMIN_SEVERE" 16496356 "DTC_MOD_VOLTAGE_COMPARE" 16496336 "DTC_CELL_T_ERR" 16496337 "DTC_CELL_TMAX1" 16496338 "DTC_CELL_TMAX2" 16496339 "DTC_CELL_TMIN" 16497665 "DTC_MBB_01_MISSING" 16497666 "DTC_MBB_02_MISSING" 16497667 "DTC_MBB_03_MISSING" 16497668 "DTC_MBB_04_MISSING" 16497669 "DTC_MBB_05_MISSING" 16497670 "DTC_MBB_06_MISSING" 16497671 "DTC_MBB_07_MISSING" 16497672 "DTC_MBB_08_MISSING" 16497673 "DTC_MBB_09_MISSING" 16497680 "DTC_MBB_10_MISSING" 16497681 "DTC_MBB_11_MISSING" 16497682 "DTC_MBB_12_MISSING" 16497683 "DTC_MBB_13_MISSING" 16497684 "DTC_MBB_14_MISSING" 16497685 "DTC_MBB_15_MISSING" 16497686 "DTC_MBB_16_MISSING" 16497687 "DTC_MBB_17_MISSING" 16497688 "DTC_MBB_18_MISSING" 16497689 "DTC_MBB_19_MISSING" 16497696 "DTC_MBB_20_MISSING" 16497697 "DTC_MBB_21_MISSING" 16497698 "DTC_MBB_22_MISSING" 16497699 "DTC_MBB_23_MISSING" 16497700 "DTC_MBB_24_MISSING" 16498177 "DTC_MBB_01_VFAULT" 16498178 "DTC_MBB_02_VFAULT" 16498179 "DTC_MBB_03_VFAULT" 16498180 "DTC_MBB_04_VFAULT" 16498181 "DTC_MBB_05_VFAULT" 16498182 "DTC_MBB_06_VFAULT" 16498183 "DTC_MBB_07_VFAULT" 16498184 "DTC_MBB_08_VFAULT" 16498185 "DTC_MBB_09_VFAULT" 16498192 "DTC_MBB_10_VFAULT" 16498193 "DTC_MBB_11_VFAULT" 16498194 "DTC_MBB_12_VFAULT" 16498195 "DTC_MBB_13_VFAULT" 16498196 "DTC_MBB_14_VFAULT" 16498197 "DTC_MBB_15_VFAULT" 16498198 "DTC_MBB_16_VFAULT" 16498199 "DTC_MBB_17_VFAULT" 16498200 "DTC_MBB_18_VFAULT" 16498201 "DTC_MBB_19_VFAULT" 16498208 "DTC_MBB_20_VFAULT" 16498209 "DTC_MBB_21_VFAULT" 16498210 "DTC_MBB_22_VFAULT" 16498211 "DTC_MBB_23_VFAULT" 16498212 "DTC_MBB_24_VFAULT" 16497921 "DTC_MBB_01_TFAULT" 16497922 "DTC_MBB_02_TFAULT" 16497923 "DTC_MBB_03_TFAULT" 16497924 "DTC_MBB_04_TFAULT" 16497925 "DTC_MBB_05_TFAULT" 16497926 "DTC_MBB_06_TFAULT" 16497927 "DTC_MBB_07_TFAULT" 16497928 "DTC_MBB_08_TFAULT" 16497929 "DTC_MBB_09_TFAULT" 16497936 "DTC_MBB_10_TFAULT" 16497937 "DTC_MBB_11_TFAULT" 16497938 "DTC_MBB_12_TFAULT" 16497939 "DTC_MBB_13_TFAULT" 16497940 "DTC_MBB_14_TFAULT" 16497941 "DTC_MBB_15_TFAULT" 16497942 "DTC_MBB_16_TFAULT" 16497943 "DTC_MBB_17_TFAULT" 16497944 "DTC_MBB_18_TFAULT" 16497945 "DTC_MBB_19_TFAULT" 16497952 "DTC_MBB_20_TFAULT" 16497953 "DTC_MBB_21_TFAULT" 16497954 "DTC_MBB_22_TFAULT" 16497955 "DTC_MBB_23_TFAULT" 16497956 "DTC_MBB_24_TFAULT" 16498688 "DTC_BRUSA_MISSING" 16498689 "DTC_BRUSA_IDC" 16498690 "DTC_BRUSA_REQ_VS_CMD" 16560128 "DTC_IBAT_MISMATCH" 16576512 "DTC_DIS_MAX_I2T" 16576513 "DTC_CHG_MAX_I2T" 16576768 "DTC_DIS_WARNING_I2T" 16576769 "DTC_CHG_WARNING_I2T" 16523520 "DTC_LEM_A_OOR_HI" 16523521 "DTC_LEM_A_OOR_LO" 16523522 "DTC_LEM_A_FAULT" 16523776 "DTC_LEM_B_OOR_HI" 16523777 "DTC_LEM_B_OOR_LO" 16523778 "DTC_LEM_B_FAULT" 16506880 "DTC_VBAT_MISMATCH" 16506881 "DTC_VBAT_VMAX" 16506882 "DTC_VBAT_VMIN" 16506883 "DTC_PACK_FUSE_A" 16506884 "DTC_PACK_FUSE_B" 16252928 "DTC_KEY_OFF_TIME_ERROR" 16252929 "DTC_PERIODIC_OFF_TIME_ERROR" 14290944 "DTC_AIN_BPWR_FAIL_LO" 14290945 "DTC_AIN_BPWR_FAIL_HI" 14290946 "DTC_AIN_BPWR_OOR_LO" 14290947 "DTC_AIN_BPWR_OOR_HI" 14290960 "DTC_AIN_14V_FAIL_LO" 14290961 "DTC_AIN_14V_FAIL_HI" 14290962 "DTC_AIN_14V_OOR_LO" 14290963 "DTC_AIN_14V_OOR_HI" 14290976 "DTC_AIN_HPWR_FAIL_LO" 14290977 "DTC_AIN_HPWR_FAIL_HI" 14290978 "DTC_AIN_HPWR_OOR_LO" 14290979 "DTC_AIN_HPWR_OOR_HI" 14290992 "DTC_AIN_6V_FAIL_LO" 14290993 "DTC_AIN_6V_FAIL_HI" 14290994 "DTC_AIN_6V_OOR_LO" 14290995 "DTC_AIN_6V_OOR_HI" 14291008 "DTC_AIN_HVIL_FAIL_LO" 14291009 "DTC_AIN_HVIL_FAIL_HI" 14291010 "DTC_AIN_HVIL_OOR_LO" 14291011 "DTC_AIN_HVIL_OOR_HI" 14291024 "DTC_AIN_5V_PWR_FAIL_LO" 14291025 "DTC_AIN_5V_PWR_FAIL_HI" 14291026 "DTC_AIN_5V_PWR_OOR_LO" 14291027 "DTC_AIN_5V_PWR_OOR_HI" 14291040 "DTC_AIN_LEM_HI_FAIL_LO" 14291041 "DTC_AIN_LEM_HI_FAIL_HI" 14291042 "DTC_AIN_LEM_HI_OOR_LO" 14291043 "DTC_AIN_LEM_HI_OOR_HI" 14291056 "DTC_AIN_LEM_LO_FAIL_LO" 14291057 "DTC_AIN_LEM_LO_FAIL_HI" 14291058 "DTC_AIN_LEM_LO_OOR_LO" 14291059 "DTC_AIN_LEM_LO_OOR_HI" 14291072 "DTC_AIN_BCT_AI_FAIL_LO" 14291073 "DTC_AIN_BCT_AI_FAIL_HI" 14291074 "DTC_AIN_BCT_AI_OOR_LO" 14291075 "DTC_AIN_BCT_AI_OOR_HI" 14291088 "DTC_AIN_WTR2_AI_FAIL_LO" 14291089 "DTC_AIN_WTR2_AI_FAIL_HI" 14291090 "DTC_AIN_WTR2_AI_OOR_LO" 14291091 "DTC_AIN_WTR2_AI_OOR_HI" 14291104 "DTC_AIN_WTR1_AI_FAIL_LO" 14291105 "DTC_AIN_WTR1_AI_FAIL_HI" 14291106 "DTC_AIN_WTR1_AI_OOR_LO" 14291107 "DTC_AIN_WTR1_AI_OOR_HI" 14291120 "DTC_AIN_AIA_FAIL_LO" 14291121 "DTC_AIN_AIA_FAIL_HI" 14291122 "DTC_AIN_AIA_OOR_LO" 14291123 "DTC_AIN_AIA_OOR_HI" 14291136 "DTC_AIN_PROX_AI_FAIL_LO" 14291137 "DTC_AIN_PROX_AI_FAIL_HI" 14291138 "DTC_AIN_PROX_AI_OOR_LO" 14291139 "DTC_AIN_PROX_AI_OOR_HI" 14291152 "DTC_AIN_TWV_FB_FAIL_LO" 14291153 "DTC_AIN_TWV_FB_FAIL_HI" 14291154 "DTC_AIN_TWV_FB_OOR_LO" 14291155 "DTC_AIN_TWV_FB_OOR_HI" 14291168 "DTC_AIN_5V_KA_FAIL_LO" 14291169 "DTC_AIN_5V_KA_FAIL_HI" 14291170 "DTC_AIN_5V_KA_OOR_LO" 14291171 "DTC_AIN_5V_KA_OOR_HI" 14291184 "DTC_AIN_CTR1_LSD_FAIL_LO" 14291185 "DTC_AIN_CTR1_LSD_FAIL_HI" 14291186 "DTC_AIN_CTR1_LSD_OOR_LO" 14291187 "DTC_AIN_CTR1_LSD_OOR_HI" 14291200 "DTC_AIN_CTR2_LSD_FAIL_LO" 14291201 "DTC_AIN_CTR2_LSD_FAIL_HI" 14291202 "DTC_AIN_CTR2_LSD_OOR_LO" 14291203 "DTC_AIN_CTR2_LSD_OOR_HI" 14291216 "DTC_AIN_CTR3_LSD_FAIL_LO" 14291217 "DTC_AIN_CTR3_LSD_FAIL_HI" 14291218 "DTC_AIN_CTR3_LSD_OOR_LO" 14291219 "DTC_AIN_CTR3_LSD_OOR_HI" 14291232 "DTC_AIN_CTR4_LSD_FAIL_LO" 14291233 "DTC_AIN_CTR4_LSD_FAIL_HI" 14291234 "DTC_AIN_CTR4_LSD_OOR_LO" 14291235 "DTC_AIN_CTR4_LSD_OOR_HI" 14291248 "DTC_AIN_CTR5_LSD_FAIL_LO" 14291249 "DTC_AIN_CTR5_LSD_FAIL_HI" 14291250 "DTC_AIN_CTR5_LSD_OOR_LO" 14291251 "DTC_AIN_CTR5_LSD_OOR_HI" 14291264 "DTC_AIN_CTR6_LSD_FAIL_LO" 14291265 "DTC_AIN_CTR6_LSD_FAIL_HI" 14291266 "DTC_AIN_CTR6_LSD_OOR_LO" 14291267 "DTC_AIN_CTR6_LSD_OOR_HI" 14291280 "DTC_AIN_CTR7_LSD_FAIL_LO" 14291281 "DTC_AIN_CTR7_LSD_FAIL_HI" 14291282 "DTC_AIN_CTR7_LSD_OOR_LO" 14291283 "DTC_AIN_CTR7_LSD_OOR_HI" 14291296 "DTC_AIN_CTR_PWR_CUR_FAIL_LO" 14291297 "DTC_AIN_CTR_PWR_CUR_FAIL_HI" 14291298 "DTC_AIN_CTR_PWR_CUR_OOR_LO" 14291299 "DTC_AIN_CTR_PWR_CUR_OOR_HI" 14291312 "DTC_AIN_CTR_HLD_CUR_FAIL_LO" 14291313 "DTC_AIN_CTR_HLD_CUR_FAIL_HI" 14291314 "DTC_AIN_CTR_HLD_CUR_OOR_LO" 14291315 "DTC_AIN_CTR_HLD_CUR_OOR_HI" 13431040 "DTC_CTR_FAULT_LATCH" 13431041 "DTC_CTR_FAULT_INVALID_HEARTBEAT" 13373440 "DTC_CTR1_LSD_FAILED_LO" 13373441 "DTC_CTR1_LSD_FAILED_HI" 13373442 "DTC_CTR1_HSD_FAILED_LO" 13373443 "DTC_CTR1_HSD_FAILED_HI" 13373444 "DTC_CTR1_PULL_IN_SHORT" 13373445 "DTC_CTR1_PULL_IN_OPEN" 13373446 "DTC_CTR1_COIL_INVALID" 13373447 "DTC_CTR1_COIL_OPEN" 13373448 "DTC_CTR1_CIRCUIT_FAILED" 13377536 "DTC_CTR2_LSD_FAILED_LO" 13377537 "DTC_CTR2_LSD_FAILED_HI" 13377538 "DTC_CTR2_HSD_FAILED_LO" 13377539 "DTC_CTR2_HSD_FAILED_HI" 13377540 "DTC_CTR2_PULL_IN_SHORT" 13377541 "DTC_CTR2_PULL_IN_OPEN" 13377542 "DTC_CTR2_COIL_INVALID" 13377543 "DTC_CTR2_COIL_OPEN" 13377544 "DTC_CTR2_CIRCUIT_FAILED" 13381632 "DTC_CTR3_LSD_FAILED_LO" 13381633 "DTC_CTR3_LSD_FAILED_HI" 13381634 "DTC_CTR3_HSD_FAILED_LO" 13381635 "DTC_CTR3_HSD_FAILED_HI" 13381636 "DTC_CTR3_PULL_IN_SHORT" 13381637 "DTC_CTR3_PULL_IN_OPEN" 13381638 "DTC_CTR3_COIL_INVALID" 13381639 "DTC_CTR3_COIL_OPEN" 13381640 "DTC_CTR3_CIRCUIT_FAILED" 13385728 "DTC_CTR4_LSD_FAILED_LO" 13385729 "DTC_CTR4_LSD_FAILED_HI" 13385730 "DTC_CTR4_HSD_FAILED_LO" 13385731 "DTC_CTR4_HSD_FAILED_HI" 13385732 "DTC_CTR4_PULL_IN_SHORT" 13385733 "DTC_CTR4_PULL_IN_OPEN" 13385734 "DTC_CTR4_COIL_INVALID" 13385735 "DTC_CTR4_COIL_OPEN" 13385736 "DTC_CTR4_CIRCUIT_FAILED" 13389824 "DTC_CTR5_LSD_FAILED_LO" 13389825 "DTC_CTR5_LSD_FAILED_HI" 13389826 "DTC_CTR5_HSD_FAILED_LO" 13389827 "DTC_CTR5_HSD_FAILED_HI" 13389828 "DTC_CTR5_PULL_IN_SHORT" 13389829 "DTC_CTR5_PULL_IN_OPEN" 13389830 "DTC_CTR5_COIL_INVALID" 13389831 "DTC_CTR5_COIL_OPEN" 13389832 "DTC_CTR5_CIRCUIT_FAILED" 13393920 "DTC_CTR6_LSD_FAILED_LO" 13393921 "DTC_CTR6_LSD_FAILED_HI" 13393922 "DTC_CTR6_HSD_FAILED_LO" 13393923 "DTC_CTR6_HSD_FAILED_HI" 13393924 "DTC_CTR6_PULL_IN_SHORT" 13393925 "DTC_CTR6_PULL_IN_OPEN" 13393926 "DTC_CTR6_COIL_INVALID" 13393927 "DTC_CTR6_COIL_OPEN" 13393928 "DTC_CTR6_CIRCUIT_FAILED" 13398016 "DTC_CTR7_LSD_FAILED_LO" 13398017 "DTC_CTR7_LSD_FAILED_HI" 13398018 "DTC_CTR7_HSD_FAILED_LO" 13398019 "DTC_CTR7_HSD_FAILED_HI" 13398020 "DTC_CTR7_PULL_IN_SHORT" 13398021 "DTC_CTR7_PULL_IN_OPEN" 13398022 "DTC_CTR7_COIL_INVALID" 13398023 "DTC_CTR7_COIL_OPEN" 13398024 "DTC_CTR7_CIRCUIT_FAILED" 14483456 "DTC_DRV_SW14V_PWR_FAILED_LO" 14483457 "DTC_DRV_SW14V_PWR_FAILED_HI" 14483472 "DTC_DRV_CHRGA_ENA_FAILED_LO" 14483473 "DTC_DRV_CHRGA_ENA_FAILED_HI" 14483488 "DTC_DRV_CHRGB_ENA_FAILED_LO" 14483489 "DTC_DRV_CHRGB_ENA_FAILED_HI" 14483504 "DTC_DRV_LSDA_FAILED_LO" 14483505 "DTC_DRV_LSDA_FAILED_HI" 14483520 "DTC_DRV_LSDB_FAILED_LO" 14483521 "DTC_DRV_LSDB_FAILED_HI" 14483536 "DTC_DRV_HSDA_FAILED_LO" 14483537 "DTC_DRV_HSDA_FAILED_HI" 14483552 "DTC_DRV_HSDB_FAILED_LO" 14483553 "DTC_DRV_HSDB_FAILED_HI" 14553088 "DTC_ICM_FGD1_FAIL_LO" 14553089 "DTC_ICM_FGD1_FAIL_HI" 14553090 "DTC_ICM_FGD1_OOR_LO" 14553091 "DTC_ICM_FGD1_OOR_HI" 14553104 "DTC_ICM_FGD2_FAIL_LO" 14553105 "DTC_ICM_FGD2_FAIL_HI" 14553106 "DTC_ICM_FGD2_OOR_LO" 14553107 "DTC_ICM_FGD2_OOR_HI" 14553120 "DTC_ICM_PILOT_FAIL_LO" 14553121 "DTC_ICM_PILOT_FAIL_HI" 14553122 "DTC_ICM_PILOT_OOR_LO" 14553123 "DTC_ICM_PILOT_OOR_HI" 14553136 "DTC_ICM_MOD_FLT_FAIL_LO" 14553137 "DTC_ICM_MOD_FLT_FAIL_HI" 14553138 "DTC_ICM_MOD_FLT_OOR_LO" 14553139 "DTC_ICM_MOD_FLT_OOR_HI" 14553152 "DTC_ICM_CLK_FAIL_LO" 14553153 "DTC_ICM_CLK_FAIL_HI" 14553154 "DTC_ICM_CLK_OOR_LO" 14553155 "DTC_ICM_CLK_OOR_HI" 14553168 "DTC_ICM_LSD_A_FAIL_LO" 14553169 "DTC_ICM_LSD_A_FAIL_HI" 14553170 "DTC_ICM_LSD_A_OOR_LO" 14553171 "DTC_ICM_LSD_A_OOR_HI" 14553184 "DTC_ICM_LSD_B_FAIL_LO" 14553185 "DTC_ICM_LSD_B_FAIL_HI" 14553186 "DTC_ICM_LSD_B_OOR_LO" 14553187 "DTC_ICM_LSD_B_OOR_HI" 14553200 "DTC_ICM_PWM_A_FAIL_LO" 14553201 "DTC_ICM_PWM_A_FAIL_HI" 14553202 "DTC_ICM_PWM_A_OOR_LO" 14553203 "DTC_ICM_PWM_A_OOR_HI" 14553216 "DTC_ICM_PWM_B_FAIL_LO" 14553217 "DTC_ICM_PWM_B_FAIL_HI" 14553218 "DTC_ICM_PWM_B_OOR_LO" 14553219 "DTC_ICM_PWM_B_OOR_HI" 14553232 "DTC_ICM_PWM_C_FAIL_LO" 14553233 "DTC_ICM_PWM_C_FAIL_HI" 14553234 "DTC_ICM_PWM_C_OOR_LO" 14553235 "DTC_ICM_PWM_C_OOR_HI" 14553248 "DTC_ICM_PWM_D_FAIL_LO" 14553249 "DTC_ICM_PWM_D_FAIL_HI" 14553250 "DTC_ICM_PWM_D_OOR_LO" 14553251 "DTC_ICM_PWM_D_OOR_HI" 14606336 "DTC_NVM_EE_0_COMM_WRITE_TO" 14606337 "DTC_NVM_EE_0_COMM_READ_TO" 14606338 "DTC_NVM_EE_0_WRITE_VERIFY" 14606339 "DTC_NVM_EE_0_READ_VERIFY" 14606340 "DTC_NVM_EE_0_READ_ERR" 14606341 "DTC_NVM_EE_0_WRITE_ERR" 14564800 "DTC_PWM_LSD_A_DC_MISMATCH" 14565344 "DTC_PWM_LSD_A_FREQ_MISMATCH" 14564801 "DTC_PWM_PWM_A_DC_MISMATCH" 14565345 "DTC_PWM_PWM_A_FREQ_MISMATCH" 14564802 "DTC_PWM_PWM_B_DC_MISMATCH" 14565346 "DTC_PWM_PWM_B_FREQ_MISMATCH" 14564803 "DTC_PWM_PWM_C_DC_MISMATCH" 14565347 "DTC_PWM_PWM_C_FREQ_MISMATCH" 14564804 "DTC_PWM_PWM_D_DC_MISMATCH" 14565348 "DTC_PWM_PWM_D_FREQ_MISMATCH" 14417920 "DTC_PWR_WAKEUP_CLK_FAILED" 14417921 "DTC_PWR_WAKEUP_CLK_OOR_LO" 14417922 "DTC_PWR_WAKEUP_CLK_OOR_HI" 14614570 "DTC_SDP_HPWR_OOR_HI" 14614571 "DTC_SDP_HPWR_OOR_LO" 14614572 "DTC_SDP_HPWR_COMM_TO" 14614573 "DTC_SDP_DEVICE_FAILURE";
VAL_ 1120 bcm_dtc_066 0 " - " 11276288 "DTC_VEPO" 11276289 "DTC_HSC_MISSING" 11460608 "DTC_NVM_SOC" 11460609 "DTC_NVM_HYST" 11460610 "DTC_NVM_KOT" 11460611 "DTC_NVM_PERIODIC_SHUTDOWN_TIME" 11460612 "DTC_NVM_WAKE" 11460613 "DTC_NVM_CALENDAR_LIFE" 11460614 "DTC_NVM_CYCLE_LIFE" 11460615 "DTC_NVM_DTC" 11460616 "DTC_NVM_APP_SCRATCHPAD" 11517962 "DTC_LOOPTIME_TASK_A" 11517963 "DTC_LOOPTIME_TASK_B" 11517964 "DTC_LOOPTIME_TASK_C" 11517965 "DTC_LOOPTIME_TASK_D" 11517966 "DTC_LOOPTIME_TASK_E" 11517967 "DTC_ILIM_MAX_DISCHARGE" 15728640 "DTC_EPO" 16171008 "DTC_CONT_OPEN" 16171009 "DTC_CONT_CLOSE" 16171010 "DTC_CONT_OPEN_CURRENT" 16171264 "DTC_CONT_CLOSE_ON_RESET" 16171265 "DTC_CONT_CLOSE_SIG_FAILED" 16171520 "DTC_PRECHARGE_TIMEOUT" 16171777 "DTC_CONT_NEG_WELD_AT_SU" 16171778 "DTC_CONT_POS_A_WELD_AT_SU" 16171779 "DTC_CONT_POS_B_WELD_AT_SU" 16172033 "DTC_CONT_NEG_WELD_AT_SD" 16172034 "DTC_CONT_POS_A_WELD_AT_SD" 16172036 "DTC_CONT_POS_B_WELD_AT_SD" 16172289 "DTC_CONT_NEG_OPEN" 16172290 "DTC_CONT_POS_A_OPEN" 16172291 "DTC_CONT_POS_B_OPEN" 16172545 "DTC_CONT_NEG_VDIF" 16172546 "DTC_CONT_POS_A_VDIF" 16172548 "DTC_CONT_POS_B_VDIF" 16174848 "DTC_HVIL" 16174849 "DTC_LVBAT_LO" 16174850 "DTC_LVBAT_HI" 16174851 "DTC_LVBAT_ERR" 16522240 "DTC_CSM_MISSING" 16522752 "DTC_CSM_VBAT" 16522753 "DTC_CSM_VPOS" 16522754 "DTC_CSM_VNEG" 16522755 "DTC_CSM_CPOS" 16522756 "DTC_CSM_CNEG" 16522757 "DTC_CSM_APOS" 16522758 "DTC_CSM_ANEG" 16522759 "DTC_CSM_FUSE_HI" 16522760 "DTC_CSM_FUSE_LO" 16521728 "DTC_CSM_ASIC" 16521729 "DTC_CSM_AILO" 16521730 "DTC_CSM_AIHI" 16520957 "DTC_LEAKAGE_DETECT_FAULT" 16522444 "DTC_REALTIMECLOCK_FAULT" 16520945 "DTC_CSM_LEAK_FAIL_CALC" 16520946 "DTC_CSM_LEAK_FAIL_HW" 16520947 "DTC_CSM_LEAK_EXT_SHORT" 16520948 "DTC_CSM_LEAK_MID_PACK_SHORT" 16520949 "DTC_CSM_LEAK_ERROR" 16520950 "DTC_CSM_LEAK_UNKNOWN" 16523008 "DTC_CSM_VER_MISMATCH" 16523009 "DTC_CSM_DTC_SET" 16523010 "DTC_CSM_CAL_FAULT" 16496320 "DTC_MBB_TOO_FEW" 16496321 "DTC_MBB_TOO_MANY" 16496352 "DTC_CELL_VMAX_ERR" 16496353 "DTC_CELL_VMIN_ERR" 16496354 "DTC_CELL_VMAX" 16496362 "DTC_CELL_VMAX_SEVERE" 16496355 "DTC_CELL_VMIN" 16496363 "DTC_CELL_VMIN_SEVERE" 16496356 "DTC_MOD_VOLTAGE_COMPARE" 16496336 "DTC_CELL_T_ERR" 16496337 "DTC_CELL_TMAX1" 16496338 "DTC_CELL_TMAX2" 16496339 "DTC_CELL_TMIN" 16497665 "DTC_MBB_01_MISSING" 16497666 "DTC_MBB_02_MISSING" 16497667 "DTC_MBB_03_MISSING" 16497668 "DTC_MBB_04_MISSING" 16497669 "DTC_MBB_05_MISSING" 16497670 "DTC_MBB_06_MISSING" 16497671 "DTC_MBB_07_MISSING" 16497672 "DTC_MBB_08_MISSING" 16497673 "DTC_MBB_09_MISSING" 16497680 "DTC_MBB_10_MISSING" 16497681 "DTC_MBB_11_MISSING" 16497682 "DTC_MBB_12_MISSING" 16497683 "DTC_MBB_13_MISSING" 16497684 "DTC_MBB_14_MISSING" 16497685 "DTC_MBB_15_MISSING" 16497686 "DTC_MBB_16_MISSING" 16497687 "DTC_MBB_17_MISSING" 16497688 "DTC_MBB_18_MISSING" 16497689 "DTC_MBB_19_MISSING" 16497696 "DTC_MBB_20_MISSING" 16497697 "DTC_MBB_21_MISSING" 16497698 "DTC_MBB_22_MISSING" 16497699 "DTC_MBB_23_MISSING" 16497700 "DTC_MBB_24_MISSING" 16498177 "DTC_MBB_01_VFAULT" 16498178 "DTC_MBB_02_VFAULT" 16498179 "DTC_MBB_03_VFAULT" 16498180 "DTC_MBB_04_VFAULT" 16498181 "DTC_MBB_05_VFAULT" 16498182 "DTC_MBB_06_VFAULT" 16498183 "DTC_MBB_07_VFAULT" 16498184 "DTC_MBB_08_VFAULT" 16498185 "DTC_MBB_09_VFAULT" 16498192 "DTC_MBB_10_VFAULT" 16498193 "DTC_MBB_11_VFAULT" 16498194 "DTC_MBB_12_VFAULT" 16498195 "DTC_MBB_13_VFAULT" 16498196 "DTC_MBB_14_VFAULT" 16498197 "DTC_MBB_15_VFAULT" 16498198 "DTC_MBB_16_VFAULT" 16498199 "DTC_MBB_17_VFAULT" 16498200 "DTC_MBB_18_VFAULT" 16498201 "DTC_MBB_19_VFAULT" 16498208 "DTC_MBB_20_VFAULT" 16498209 "DTC_MBB_21_VFAULT" 16498210 "DTC_MBB_22_VFAULT" 16498211 "DTC_MBB_23_VFAULT" 16498212 "DTC_MBB_24_VFAULT" 16497921 "DTC_MBB_01_TFAULT" 16497922 "DTC_MBB_02_TFAULT" 16497923 "DTC_MBB_03_TFAULT" 16497924 "DTC_MBB_04_TFAULT" 16497925 "DTC_MBB_05_TFAULT" 16497926 "DTC_MBB_06_TFAULT" 16497927 "DTC_MBB_07_TFAULT" 16497928 "DTC_MBB_08_TFAULT" 16497929 "DTC_MBB_09_TFAULT" 16497936 "DTC_MBB_10_TFAULT" 16497937 "DTC_MBB_11_TFAULT" 16497938 "DTC_MBB_12_TFAULT" 16497939 "DTC_MBB_13_TFAULT" 16497940 "DTC_MBB_14_TFAULT" 16497941 "DTC_MBB_15_TFAULT" 16497942 "DTC_MBB_16_TFAULT" 16497943 "DTC_MBB_17_TFAULT" 16497944 "DTC_MBB_18_TFAULT" 16497945 "DTC_MBB_19_TFAULT" 16497952 "DTC_MBB_20_TFAULT" 16497953 "DTC_MBB_21_TFAULT" 16497954 "DTC_MBB_22_TFAULT" 16497955 "DTC_MBB_23_TFAULT" 16497956 "DTC_MBB_24_TFAULT" 16498688 "DTC_BRUSA_MISSING" 16498689 "DTC_BRUSA_IDC" 16498690 "DTC_BRUSA_REQ_VS_CMD" 16560128 "DTC_IBAT_MISMATCH" 16576512 "DTC_DIS_MAX_I2T" 16576513 "DTC_CHG_MAX_I2T" 16576768 "DTC_DIS_WARNING_I2T" 16576769 "DTC_CHG_WARNING_I2T" 16523520 "DTC_LEM_A_OOR_HI" 16523521 "DTC_LEM_A_OOR_LO" 16523522 "DTC_LEM_A_FAULT" 16523776 "DTC_LEM_B_OOR_HI" 16523777 "DTC_LEM_B_OOR_LO" 16523778 "DTC_LEM_B_FAULT" 16506880 "DTC_VBAT_MISMATCH" 16506881 "DTC_VBAT_VMAX" 16506882 "DTC_VBAT_VMIN" 16506883 "DTC_PACK_FUSE_A" 16506884 "DTC_PACK_FUSE_B" 16252928 "DTC_KEY_OFF_TIME_ERROR" 16252929 "DTC_PERIODIC_OFF_TIME_ERROR" 14290944 "DTC_AIN_BPWR_FAIL_LO" 14290945 "DTC_AIN_BPWR_FAIL_HI" 14290946 "DTC_AIN_BPWR_OOR_LO" 14290947 "DTC_AIN_BPWR_OOR_HI" 14290960 "DTC_AIN_14V_FAIL_LO" 14290961 "DTC_AIN_14V_FAIL_HI" 14290962 "DTC_AIN_14V_OOR_LO" 14290963 "DTC_AIN_14V_OOR_HI" 14290976 "DTC_AIN_HPWR_FAIL_LO" 14290977 "DTC_AIN_HPWR_FAIL_HI" 14290978 "DTC_AIN_HPWR_OOR_LO" 14290979 "DTC_AIN_HPWR_OOR_HI" 14290992 "DTC_AIN_6V_FAIL_LO" 14290993 "DTC_AIN_6V_FAIL_HI" 14290994 "DTC_AIN_6V_OOR_LO" 14290995 "DTC_AIN_6V_OOR_HI" 14291008 "DTC_AIN_HVIL_FAIL_LO" 14291009 "DTC_AIN_HVIL_FAIL_HI" 14291010 "DTC_AIN_HVIL_OOR_LO" 14291011 "DTC_AIN_HVIL_OOR_HI" 14291024 "DTC_AIN_5V_PWR_FAIL_LO" 14291025 "DTC_AIN_5V_PWR_FAIL_HI" 14291026 "DTC_AIN_5V_PWR_OOR_LO" 14291027 "DTC_AIN_5V_PWR_OOR_HI" 14291040 "DTC_AIN_LEM_HI_FAIL_LO" 14291041 "DTC_AIN_LEM_HI_FAIL_HI" 14291042 "DTC_AIN_LEM_HI_OOR_LO" 14291043 "DTC_AIN_LEM_HI_OOR_HI" 14291056 "DTC_AIN_LEM_LO_FAIL_LO" 14291057 "DTC_AIN_LEM_LO_FAIL_HI" 14291058 "DTC_AIN_LEM_LO_OOR_LO" 14291059 "DTC_AIN_LEM_LO_OOR_HI" 14291072 "DTC_AIN_BCT_AI_FAIL_LO" 14291073 "DTC_AIN_BCT_AI_FAIL_HI" 14291074 "DTC_AIN_BCT_AI_OOR_LO" 14291075 "DTC_AIN_BCT_AI_OOR_HI" 14291088 "DTC_AIN_WTR2_AI_FAIL_LO" 14291089 "DTC_AIN_WTR2_AI_FAIL_HI" 14291090 "DTC_AIN_WTR2_AI_OOR_LO" 14291091 "DTC_AIN_WTR2_AI_OOR_HI" 14291104 "DTC_AIN_WTR1_AI_FAIL_LO" 14291105 "DTC_AIN_WTR1_AI_FAIL_HI" 14291106 "DTC_AIN_WTR1_AI_OOR_LO" 14291107 "DTC_AIN_WTR1_AI_OOR_HI" 14291120 "DTC_AIN_AIA_FAIL_LO" 14291121 "DTC_AIN_AIA_FAIL_HI" 14291122 "DTC_AIN_AIA_OOR_LO" 14291123 "DTC_AIN_AIA_OOR_HI" 14291136 "DTC_AIN_PROX_AI_FAIL_LO" 14291137 "DTC_AIN_PROX_AI_FAIL_HI" 14291138 "DTC_AIN_PROX_AI_OOR_LO" 14291139 "DTC_AIN_PROX_AI_OOR_HI" 14291152 "DTC_AIN_TWV_FB_FAIL_LO" 14291153 "DTC_AIN_TWV_FB_FAIL_HI" 14291154 "DTC_AIN_TWV_FB_OOR_LO" 14291155 "DTC_AIN_TWV_FB_OOR_HI" 14291168 "DTC_AIN_5V_KA_FAIL_LO" 14291169 "DTC_AIN_5V_KA_FAIL_HI" 14291170 "DTC_AIN_5V_KA_OOR_LO" 14291171 "DTC_AIN_5V_KA_OOR_HI" 14291184 "DTC_AIN_CTR1_LSD_FAIL_LO" 14291185 "DTC_AIN_CTR1_LSD_FAIL_HI" 14291186 "DTC_AIN_CTR1_LSD_OOR_LO" 14291187 "DTC_AIN_CTR1_LSD_OOR_HI" 14291200 "DTC_AIN_CTR2_LSD_FAIL_LO" 14291201 "DTC_AIN_CTR2_LSD_FAIL_HI" 14291202 "DTC_AIN_CTR2_LSD_OOR_LO" 14291203 "DTC_AIN_CTR2_LSD_OOR_HI" 14291216 "DTC_AIN_CTR3_LSD_FAIL_LO" 14291217 "DTC_AIN_CTR3_LSD_FAIL_HI" 14291218 "DTC_AIN_CTR3_LSD_OOR_LO" 14291219 "DTC_AIN_CTR3_LSD_OOR_HI" 14291232 "DTC_AIN_CTR4_LSD_FAIL_LO" 14291233 "DTC_AIN_CTR4_LSD_FAIL_HI" 14291234 "DTC_AIN_CTR4_LSD_OOR_LO" 14291235 "DTC_AIN_CTR4_LSD_OOR_HI" 14291248 "DTC_AIN_CTR5_LSD_FAIL_LO" 14291249 "DTC_AIN_CTR5_LSD_FAIL_HI" 14291250 "DTC_AIN_CTR5_LSD_OOR_LO" 14291251 "DTC_AIN_CTR5_LSD_OOR_HI" 14291264 "DTC_AIN_CTR6_LSD_FAIL_LO" 14291265 "DTC_AIN_CTR6_LSD_FAIL_HI" 14291266 "DTC_AIN_CTR6_LSD_OOR_LO" 14291267 "DTC_AIN_CTR6_LSD_OOR_HI" 14291280 "DTC_AIN_CTR7_LSD_FAIL_LO" 14291281 "DTC_AIN_CTR7_LSD_FAIL_HI" 14291282 "DTC_AIN_CTR7_LSD_OOR_LO" 14291283 "DTC_AIN_CTR7_LSD_OOR_HI" 14291296 "DTC_AIN_CTR_PWR_CUR_FAIL_LO" 14291297 "DTC_AIN_CTR_PWR_CUR_FAIL_HI" 14291298 "DTC_AIN_CTR_PWR_CUR_OOR_LO" 14291299 "DTC_AIN_CTR_PWR_CUR_OOR_HI" 14291312 "DTC_AIN_CTR_HLD_CUR_FAIL_LO" 14291313 "DTC_AIN_CTR_HLD_CUR_FAIL_HI" 14291314 "DTC_AIN_CTR_HLD_CUR_OOR_LO" 14291315 "DTC_AIN_CTR_HLD_CUR_OOR_HI" 13431040 "DTC_CTR_FAULT_LATCH" 13431041 "DTC_CTR_FAULT_INVALID_HEARTBEAT" 13373440 "DTC_CTR1_LSD_FAILED_LO" 13373441 "DTC_CTR1_LSD_FAILED_HI" 13373442 "DTC_CTR1_HSD_FAILED_LO" 13373443 "DTC_CTR1_HSD_FAILED_HI" 13373444 "DTC_CTR1_PULL_IN_SHORT" 13373445 "DTC_CTR1_PULL_IN_OPEN" 13373446 "DTC_CTR1_COIL_INVALID" 13373447 "DTC_CTR1_COIL_OPEN" 13373448 "DTC_CTR1_CIRCUIT_FAILED" 13377536 "DTC_CTR2_LSD_FAILED_LO" 13377537 "DTC_CTR2_LSD_FAILED_HI" 13377538 "DTC_CTR2_HSD_FAILED_LO" 13377539 "DTC_CTR2_HSD_FAILED_HI" 13377540 "DTC_CTR2_PULL_IN_SHORT" 13377541 "DTC_CTR2_PULL_IN_OPEN" 13377542 "DTC_CTR2_COIL_INVALID" 13377543 "DTC_CTR2_COIL_OPEN" 13377544 "DTC_CTR2_CIRCUIT_FAILED" 13381632 "DTC_CTR3_LSD_FAILED_LO" 13381633 "DTC_CTR3_LSD_FAILED_HI" 13381634 "DTC_CTR3_HSD_FAILED_LO" 13381635 "DTC_CTR3_HSD_FAILED_HI" 13381636 "DTC_CTR3_PULL_IN_SHORT" 13381637 "DTC_CTR3_PULL_IN_OPEN" 13381638 "DTC_CTR3_COIL_INVALID" 13381639 "DTC_CTR3_COIL_OPEN" 13381640 "DTC_CTR3_CIRCUIT_FAILED" 13385728 "DTC_CTR4_LSD_FAILED_LO" 13385729 "DTC_CTR4_LSD_FAILED_HI" 13385730 "DTC_CTR4_HSD_FAILED_LO" 13385731 "DTC_CTR4_HSD_FAILED_HI" 13385732 "DTC_CTR4_PULL_IN_SHORT" 13385733 "DTC_CTR4_PULL_IN_OPEN" 13385734 "DTC_CTR4_COIL_INVALID" 13385735 "DTC_CTR4_COIL_OPEN" 13385736 "DTC_CTR4_CIRCUIT_FAILED" 13389824 "DTC_CTR5_LSD_FAILED_LO" 13389825 "DTC_CTR5_LSD_FAILED_HI" 13389826 "DTC_CTR5_HSD_FAILED_LO" 13389827 "DTC_CTR5_HSD_FAILED_HI" 13389828 "DTC_CTR5_PULL_IN_SHORT" 13389829 "DTC_CTR5_PULL_IN_OPEN" 13389830 "DTC_CTR5_COIL_INVALID" 13389831 "DTC_CTR5_COIL_OPEN" 13389832 "DTC_CTR5_CIRCUIT_FAILED" 13393920 "DTC_CTR6_LSD_FAILED_LO" 13393921 "DTC_CTR6_LSD_FAILED_HI" 13393922 "DTC_CTR6_HSD_FAILED_LO" 13393923 "DTC_CTR6_HSD_FAILED_HI" 13393924 "DTC_CTR6_PULL_IN_SHORT" 13393925 "DTC_CTR6_PULL_IN_OPEN" 13393926 "DTC_CTR6_COIL_INVALID" 13393927 "DTC_CTR6_COIL_OPEN" 13393928 "DTC_CTR6_CIRCUIT_FAILED" 13398016 "DTC_CTR7_LSD_FAILED_LO" 13398017 "DTC_CTR7_LSD_FAILED_HI" 13398018 "DTC_CTR7_HSD_FAILED_LO" 13398019 "DTC_CTR7_HSD_FAILED_HI" 13398020 "DTC_CTR7_PULL_IN_SHORT" 13398021 "DTC_CTR7_PULL_IN_OPEN" 13398022 "DTC_CTR7_COIL_INVALID" 13398023 "DTC_CTR7_COIL_OPEN" 13398024 "DTC_CTR7_CIRCUIT_FAILED" 14483456 "DTC_DRV_SW14V_PWR_FAILED_LO" 14483457 "DTC_DRV_SW14V_PWR_FAILED_HI" 14483472 "DTC_DRV_CHRGA_ENA_FAILED_LO" 14483473 "DTC_DRV_CHRGA_ENA_FAILED_HI" 14483488 "DTC_DRV_CHRGB_ENA_FAILED_LO" 14483489 "DTC_DRV_CHRGB_ENA_FAILED_HI" 14483504 "DTC_DRV_LSDA_FAILED_LO" 14483505 "DTC_DRV_LSDA_FAILED_HI" 14483520 "DTC_DRV_LSDB_FAILED_LO" 14483521 "DTC_DRV_LSDB_FAILED_HI" 14483536 "DTC_DRV_HSDA_FAILED_LO" 14483537 "DTC_DRV_HSDA_FAILED_HI" 14483552 "DTC_DRV_HSDB_FAILED_LO" 14483553 "DTC_DRV_HSDB_FAILED_HI" 14553088 "DTC_ICM_FGD1_FAIL_LO" 14553089 "DTC_ICM_FGD1_FAIL_HI" 14553090 "DTC_ICM_FGD1_OOR_LO" 14553091 "DTC_ICM_FGD1_OOR_HI" 14553104 "DTC_ICM_FGD2_FAIL_LO" 14553105 "DTC_ICM_FGD2_FAIL_HI" 14553106 "DTC_ICM_FGD2_OOR_LO" 14553107 "DTC_ICM_FGD2_OOR_HI" 14553120 "DTC_ICM_PILOT_FAIL_LO" 14553121 "DTC_ICM_PILOT_FAIL_HI" 14553122 "DTC_ICM_PILOT_OOR_LO" 14553123 "DTC_ICM_PILOT_OOR_HI" 14553136 "DTC_ICM_MOD_FLT_FAIL_LO" 14553137 "DTC_ICM_MOD_FLT_FAIL_HI" 14553138 "DTC_ICM_MOD_FLT_OOR_LO" 14553139 "DTC_ICM_MOD_FLT_OOR_HI" 14553152 "DTC_ICM_CLK_FAIL_LO" 14553153 "DTC_ICM_CLK_FAIL_HI" 14553154 "DTC_ICM_CLK_OOR_LO" 14553155 "DTC_ICM_CLK_OOR_HI" 14553168 "DTC_ICM_LSD_A_FAIL_LO" 14553169 "DTC_ICM_LSD_A_FAIL_HI" 14553170 "DTC_ICM_LSD_A_OOR_LO" 14553171 "DTC_ICM_LSD_A_OOR_HI" 14553184 "DTC_ICM_LSD_B_FAIL_LO" 14553185 "DTC_ICM_LSD_B_FAIL_HI" 14553186 "DTC_ICM_LSD_B_OOR_LO" 14553187 "DTC_ICM_LSD_B_OOR_HI" 14553200 "DTC_ICM_PWM_A_FAIL_LO" 14553201 "DTC_ICM_PWM_A_FAIL_HI" 14553202 "DTC_ICM_PWM_A_OOR_LO" 14553203 "DTC_ICM_PWM_A_OOR_HI" 14553216 "DTC_ICM_PWM_B_FAIL_LO" 14553217 "DTC_ICM_PWM_B_FAIL_HI" 14553218 "DTC_ICM_PWM_B_OOR_LO" 14553219 "DTC_ICM_PWM_B_OOR_HI" 14553232 "DTC_ICM_PWM_C_FAIL_LO" 14553233 "DTC_ICM_PWM_C_FAIL_HI" 14553234 "DTC_ICM_PWM_C_OOR_LO" 14553235 "DTC_ICM_PWM_C_OOR_HI" 14553248 "DTC_ICM_PWM_D_FAIL_LO" 14553249 "DTC_ICM_PWM_D_FAIL_HI" 14553250 "DTC_ICM_PWM_D_OOR_LO" 14553251 "DTC_ICM_PWM_D_OOR_HI" 14606336 "DTC_NVM_EE_0_COMM_WRITE_TO" 14606337 "DTC_NVM_EE_0_COMM_READ_TO" 14606338 "DTC_NVM_EE_0_WRITE_VERIFY" 14606339 "DTC_NVM_EE_0_READ_VERIFY" 14606340 "DTC_NVM_EE_0_READ_ERR" 14606341 "DTC_NVM_EE_0_WRITE_ERR" 14564800 "DTC_PWM_LSD_A_DC_MISMATCH" 14565344 "DTC_PWM_LSD_A_FREQ_MISMATCH" 14564801 "DTC_PWM_PWM_A_DC_MISMATCH" 14565345 "DTC_PWM_PWM_A_FREQ_MISMATCH" 14564802 "DTC_PWM_PWM_B_DC_MISMATCH" 14565346 "DTC_PWM_PWM_B_FREQ_MISMATCH" 14564803 "DTC_PWM_PWM_C_DC_MISMATCH" 14565347 "DTC_PWM_PWM_C_FREQ_MISMATCH" 14564804 "DTC_PWM_PWM_D_DC_MISMATCH" 14565348 "DTC_PWM_PWM_D_FREQ_MISMATCH" 14417920 "DTC_PWR_WAKEUP_CLK_FAILED" 14417921 "DTC_PWR_WAKEUP_CLK_OOR_LO" 14417922 "DTC_PWR_WAKEUP_CLK_OOR_HI" 14614570 "DTC_SDP_HPWR_OOR_HI" 14614571 "DTC_SDP_HPWR_OOR_LO" 14614572 "DTC_SDP_HPWR_COMM_TO" 14614573 "DTC_SDP_DEVICE_FAILURE";
VAL_ 1120 bcm_dtc_067 0 " - " 11276288 "DTC_VEPO" 11276289 "DTC_HSC_MISSING" 11460608 "DTC_NVM_SOC" 11460609 "DTC_NVM_HYST" 11460610 "DTC_NVM_KOT" 11460611 "DTC_NVM_PERIODIC_SHUTDOWN_TIME" 11460612 "DTC_NVM_WAKE" 11460613 "DTC_NVM_CALENDAR_LIFE" 11460614 "DTC_NVM_CYCLE_LIFE" 11460615 "DTC_NVM_DTC" 11460616 "DTC_NVM_APP_SCRATCHPAD" 11517962 "DTC_LOOPTIME_TASK_A" 11517963 "DTC_LOOPTIME_TASK_B" 11517964 "DTC_LOOPTIME_TASK_C" 11517965 "DTC_LOOPTIME_TASK_D" 11517966 "DTC_LOOPTIME_TASK_E" 11517967 "DTC_ILIM_MAX_DISCHARGE" 15728640 "DTC_EPO" 16171008 "DTC_CONT_OPEN" 16171009 "DTC_CONT_CLOSE" 16171010 "DTC_CONT_OPEN_CURRENT" 16171264 "DTC_CONT_CLOSE_ON_RESET" 16171265 "DTC_CONT_CLOSE_SIG_FAILED" 16171520 "DTC_PRECHARGE_TIMEOUT" 16171777 "DTC_CONT_NEG_WELD_AT_SU" 16171778 "DTC_CONT_POS_A_WELD_AT_SU" 16171779 "DTC_CONT_POS_B_WELD_AT_SU" 16172033 "DTC_CONT_NEG_WELD_AT_SD" 16172034 "DTC_CONT_POS_A_WELD_AT_SD" 16172036 "DTC_CONT_POS_B_WELD_AT_SD" 16172289 "DTC_CONT_NEG_OPEN" 16172290 "DTC_CONT_POS_A_OPEN" 16172291 "DTC_CONT_POS_B_OPEN" 16172545 "DTC_CONT_NEG_VDIF" 16172546 "DTC_CONT_POS_A_VDIF" 16172548 "DTC_CONT_POS_B_VDIF" 16174848 "DTC_HVIL" 16174849 "DTC_LVBAT_LO" 16174850 "DTC_LVBAT_HI" 16174851 "DTC_LVBAT_ERR" 16522240 "DTC_CSM_MISSING" 16522752 "DTC_CSM_VBAT" 16522753 "DTC_CSM_VPOS" 16522754 "DTC_CSM_VNEG" 16522755 "DTC_CSM_CPOS" 16522756 "DTC_CSM_CNEG" 16522757 "DTC_CSM_APOS" 16522758 "DTC_CSM_ANEG" 16522759 "DTC_CSM_FUSE_HI" 16522760 "DTC_CSM_FUSE_LO" 16521728 "DTC_CSM_ASIC" 16521729 "DTC_CSM_AILO" 16521730 "DTC_CSM_AIHI" 16520957 "DTC_LEAKAGE_DETECT_FAULT" 16522444 "DTC_REALTIMECLOCK_FAULT" 16520945 "DTC_CSM_LEAK_FAIL_CALC" 16520946 "DTC_CSM_LEAK_FAIL_HW" 16520947 "DTC_CSM_LEAK_EXT_SHORT" 16520948 "DTC_CSM_LEAK_MID_PACK_SHORT" 16520949 "DTC_CSM_LEAK_ERROR" 16520950 "DTC_CSM_LEAK_UNKNOWN" 16523008 "DTC_CSM_VER_MISMATCH" 16523009 "DTC_CSM_DTC_SET" 16523010 "DTC_CSM_CAL_FAULT" 16496320 "DTC_MBB_TOO_FEW" 16496321 "DTC_MBB_TOO_MANY" 16496352 "DTC_CELL_VMAX_ERR" 16496353 "DTC_CELL_VMIN_ERR" 16496354 "DTC_CELL_VMAX" 16496362 "DTC_CELL_VMAX_SEVERE" 16496355 "DTC_CELL_VMIN" 16496363 "DTC_CELL_VMIN_SEVERE" 16496356 "DTC_MOD_VOLTAGE_COMPARE" 16496336 "DTC_CELL_T_ERR" 16496337 "DTC_CELL_TMAX1" 16496338 "DTC_CELL_TMAX2" 16496339 "DTC_CELL_TMIN" 16497665 "DTC_MBB_01_MISSING" 16497666 "DTC_MBB_02_MISSING" 16497667 "DTC_MBB_03_MISSING" 16497668 "DTC_MBB_04_MISSING" 16497669 "DTC_MBB_05_MISSING" 16497670 "DTC_MBB_06_MISSING" 16497671 "DTC_MBB_07_MISSING" 16497672 "DTC_MBB_08_MISSING" 16497673 "DTC_MBB_09_MISSING" 16497680 "DTC_MBB_10_MISSING" 16497681 "DTC_MBB_11_MISSING" 16497682 "DTC_MBB_12_MISSING" 16497683 "DTC_MBB_13_MISSING" 16497684 "DTC_MBB_14_MISSING" 16497685 "DTC_MBB_15_MISSING" 16497686 "DTC_MBB_16_MISSING" 16497687 "DTC_MBB_17_MISSING" 16497688 "DTC_MBB_18_MISSING" 16497689 "DTC_MBB_19_MISSING" 16497696 "DTC_MBB_20_MISSING" 16497697 "DTC_MBB_21_MISSING" 16497698 "DTC_MBB_22_MISSING" 16497699 "DTC_MBB_23_MISSING" 16497700 "DTC_MBB_24_MISSING" 16498177 "DTC_MBB_01_VFAULT" 16498178 "DTC_MBB_02_VFAULT" 16498179 "DTC_MBB_03_VFAULT" 16498180 "DTC_MBB_04_VFAULT" 16498181 "DTC_MBB_05_VFAULT" 16498182 "DTC_MBB_06_VFAULT" 16498183 "DTC_MBB_07_VFAULT" 16498184 "DTC_MBB_08_VFAULT" 16498185 "DTC_MBB_09_VFAULT" 16498192 "DTC_MBB_10_VFAULT" 16498193 "DTC_MBB_11_VFAULT" 16498194 "DTC_MBB_12_VFAULT" 16498195 "DTC_MBB_13_VFAULT" 16498196 "DTC_MBB_14_VFAULT" 16498197 "DTC_MBB_15_VFAULT" 16498198 "DTC_MBB_16_VFAULT" 16498199 "DTC_MBB_17_VFAULT" 16498200 "DTC_MBB_18_VFAULT" 16498201 "DTC_MBB_19_VFAULT" 16498208 "DTC_MBB_20_VFAULT" 16498209 "DTC_MBB_21_VFAULT" 16498210 "DTC_MBB_22_VFAULT" 16498211 "DTC_MBB_23_VFAULT" 16498212 "DTC_MBB_24_VFAULT" 16497921 "DTC_MBB_01_TFAULT" 16497922 "DTC_MBB_02_TFAULT" 16497923 "DTC_MBB_03_TFAULT" 16497924 "DTC_MBB_04_TFAULT" 16497925 "DTC_MBB_05_TFAULT" 16497926 "DTC_MBB_06_TFAULT" 16497927 "DTC_MBB_07_TFAULT" 16497928 "DTC_MBB_08_TFAULT" 16497929 "DTC_MBB_09_TFAULT" 16497936 "DTC_MBB_10_TFAULT" 16497937 "DTC_MBB_11_TFAULT" 16497938 "DTC_MBB_12_TFAULT" 16497939 "DTC_MBB_13_TFAULT" 16497940 "DTC_MBB_14_TFAULT" 16497941 "DTC_MBB_15_TFAULT" 16497942 "DTC_MBB_16_TFAULT" 16497943 "DTC_MBB_17_TFAULT" 16497944 "DTC_MBB_18_TFAULT" 16497945 "DTC_MBB_19_TFAULT" 16497952 "DTC_MBB_20_TFAULT" 16497953 "DTC_MBB_21_TFAULT" 16497954 "DTC_MBB_22_TFAULT" 16497955 "DTC_MBB_23_TFAULT" 16497956 "DTC_MBB_24_TFAULT" 16498688 "DTC_BRUSA_MISSING" 16498689 "DTC_BRUSA_IDC" 16498690 "DTC_BRUSA_REQ_VS_CMD" 16560128 "DTC_IBAT_MISMATCH" 16576512 "DTC_DIS_MAX_I2T" 16576513 "DTC_CHG_MAX_I2T" 16576768 "DTC_DIS_WARNING_I2T" 16576769 "DTC_CHG_WARNING_I2T" 16523520 "DTC_LEM_A_OOR_HI" 16523521 "DTC_LEM_A_OOR_LO" 16523522 "DTC_LEM_A_FAULT" 16523776 "DTC_LEM_B_OOR_HI" 16523777 "DTC_LEM_B_OOR_LO" 16523778 "DTC_LEM_B_FAULT" 16506880 "DTC_VBAT_MISMATCH" 16506881 "DTC_VBAT_VMAX" 16506882 "DTC_VBAT_VMIN" 16506883 "DTC_PACK_FUSE_A" 16506884 "DTC_PACK_FUSE_B" 16252928 "DTC_KEY_OFF_TIME_ERROR" 16252929 "DTC_PERIODIC_OFF_TIME_ERROR" 14290944 "DTC_AIN_BPWR_FAIL_LO" 14290945 "DTC_AIN_BPWR_FAIL_HI" 14290946 "DTC_AIN_BPWR_OOR_LO" 14290947 "DTC_AIN_BPWR_OOR_HI" 14290960 "DTC_AIN_14V_FAIL_LO" 14290961 "DTC_AIN_14V_FAIL_HI" 14290962 "DTC_AIN_14V_OOR_LO" 14290963 "DTC_AIN_14V_OOR_HI" 14290976 "DTC_AIN_HPWR_FAIL_LO" 14290977 "DTC_AIN_HPWR_FAIL_HI" 14290978 "DTC_AIN_HPWR_OOR_LO" 14290979 "DTC_AIN_HPWR_OOR_HI" 14290992 "DTC_AIN_6V_FAIL_LO" 14290993 "DTC_AIN_6V_FAIL_HI" 14290994 "DTC_AIN_6V_OOR_LO" 14290995 "DTC_AIN_6V_OOR_HI" 14291008 "DTC_AIN_HVIL_FAIL_LO" 14291009 "DTC_AIN_HVIL_FAIL_HI" 14291010 "DTC_AIN_HVIL_OOR_LO" 14291011 "DTC_AIN_HVIL_OOR_HI" 14291024 "DTC_AIN_5V_PWR_FAIL_LO" 14291025 "DTC_AIN_5V_PWR_FAIL_HI" 14291026 "DTC_AIN_5V_PWR_OOR_LO" 14291027 "DTC_AIN_5V_PWR_OOR_HI" 14291040 "DTC_AIN_LEM_HI_FAIL_LO" 14291041 "DTC_AIN_LEM_HI_FAIL_HI" 14291042 "DTC_AIN_LEM_HI_OOR_LO" 14291043 "DTC_AIN_LEM_HI_OOR_HI" 14291056 "DTC_AIN_LEM_LO_FAIL_LO" 14291057 "DTC_AIN_LEM_LO_FAIL_HI" 14291058 "DTC_AIN_LEM_LO_OOR_LO" 14291059 "DTC_AIN_LEM_LO_OOR_HI" 14291072 "DTC_AIN_BCT_AI_FAIL_LO" 14291073 "DTC_AIN_BCT_AI_FAIL_HI" 14291074 "DTC_AIN_BCT_AI_OOR_LO" 14291075 "DTC_AIN_BCT_AI_OOR_HI" 14291088 "DTC_AIN_WTR2_AI_FAIL_LO" 14291089 "DTC_AIN_WTR2_AI_FAIL_HI" 14291090 "DTC_AIN_WTR2_AI_OOR_LO" 14291091 "DTC_AIN_WTR2_AI_OOR_HI" 14291104 "DTC_AIN_WTR1_AI_FAIL_LO" 14291105 "DTC_AIN_WTR1_AI_FAIL_HI" 14291106 "DTC_AIN_WTR1_AI_OOR_LO" 14291107 "DTC_AIN_WTR1_AI_OOR_HI" 14291120 "DTC_AIN_AIA_FAIL_LO" 14291121 "DTC_AIN_AIA_FAIL_HI" 14291122 "DTC_AIN_AIA_OOR_LO" 14291123 "DTC_AIN_AIA_OOR_HI" 14291136 "DTC_AIN_PROX_AI_FAIL_LO" 14291137 "DTC_AIN_PROX_AI_FAIL_HI" 14291138 "DTC_AIN_PROX_AI_OOR_LO" 14291139 "DTC_AIN_PROX_AI_OOR_HI" 14291152 "DTC_AIN_TWV_FB_FAIL_LO" 14291153 "DTC_AIN_TWV_FB_FAIL_HI" 14291154 "DTC_AIN_TWV_FB_OOR_LO" 14291155 "DTC_AIN_TWV_FB_OOR_HI" 14291168 "DTC_AIN_5V_KA_FAIL_LO" 14291169 "DTC_AIN_5V_KA_FAIL_HI" 14291170 "DTC_AIN_5V_KA_OOR_LO" 14291171 "DTC_AIN_5V_KA_OOR_HI" 14291184 "DTC_AIN_CTR1_LSD_FAIL_LO" 14291185 "DTC_AIN_CTR1_LSD_FAIL_HI" 14291186 "DTC_AIN_CTR1_LSD_OOR_LO" 14291187 "DTC_AIN_CTR1_LSD_OOR_HI" 14291200 "DTC_AIN_CTR2_LSD_FAIL_LO" 14291201 "DTC_AIN_CTR2_LSD_FAIL_HI" 14291202 "DTC_AIN_CTR2_LSD_OOR_LO" 14291203 "DTC_AIN_CTR2_LSD_OOR_HI" 14291216 "DTC_AIN_CTR3_LSD_FAIL_LO" 14291217 "DTC_AIN_CTR3_LSD_FAIL_HI" 14291218 "DTC_AIN_CTR3_LSD_OOR_LO" 14291219 "DTC_AIN_CTR3_LSD_OOR_HI" 14291232 "DTC_AIN_CTR4_LSD_FAIL_LO" 14291233 "DTC_AIN_CTR4_LSD_FAIL_HI" 14291234 "DTC_AIN_CTR4_LSD_OOR_LO" 14291235 "DTC_AIN_CTR4_LSD_OOR_HI" 14291248 "DTC_AIN_CTR5_LSD_FAIL_LO" 14291249 "DTC_AIN_CTR5_LSD_FAIL_HI" 14291250 "DTC_AIN_CTR5_LSD_OOR_LO" 14291251 "DTC_AIN_CTR5_LSD_OOR_HI" 14291264 "DTC_AIN_CTR6_LSD_FAIL_LO" 14291265 "DTC_AIN_CTR6_LSD_FAIL_HI" 14291266 "DTC_AIN_CTR6_LSD_OOR_LO" 14291267 "DTC_AIN_CTR6_LSD_OOR_HI" 14291280 "DTC_AIN_CTR7_LSD_FAIL_LO" 14291281 "DTC_AIN_CTR7_LSD_FAIL_HI" 14291282 "DTC_AIN_CTR7_LSD_OOR_LO" 14291283 "DTC_AIN_CTR7_LSD_OOR_HI" 14291296 "DTC_AIN_CTR_PWR_CUR_FAIL_LO" 14291297 "DTC_AIN_CTR_PWR_CUR_FAIL_HI" 14291298 "DTC_AIN_CTR_PWR_CUR_OOR_LO" 14291299 "DTC_AIN_CTR_PWR_CUR_OOR_HI" 14291312 "DTC_AIN_CTR_HLD_CUR_FAIL_LO" 14291313 "DTC_AIN_CTR_HLD_CUR_FAIL_HI" 14291314 "DTC_AIN_CTR_HLD_CUR_OOR_LO" 14291315 "DTC_AIN_CTR_HLD_CUR_OOR_HI" 13431040 "DTC_CTR_FAULT_LATCH" 13431041 "DTC_CTR_FAULT_INVALID_HEARTBEAT" 13373440 "DTC_CTR1_LSD_FAILED_LO" 13373441 "DTC_CTR1_LSD_FAILED_HI" 13373442 "DTC_CTR1_HSD_FAILED_LO" 13373443 "DTC_CTR1_HSD_FAILED_HI" 13373444 "DTC_CTR1_PULL_IN_SHORT" 13373445 "DTC_CTR1_PULL_IN_OPEN" 13373446 "DTC_CTR1_COIL_INVALID" 13373447 "DTC_CTR1_COIL_OPEN" 13373448 "DTC_CTR1_CIRCUIT_FAILED" 13377536 "DTC_CTR2_LSD_FAILED_LO" 13377537 "DTC_CTR2_LSD_FAILED_HI" 13377538 "DTC_CTR2_HSD_FAILED_LO" 13377539 "DTC_CTR2_HSD_FAILED_HI" 13377540 "DTC_CTR2_PULL_IN_SHORT" 13377541 "DTC_CTR2_PULL_IN_OPEN" 13377542 "DTC_CTR2_COIL_INVALID" 13377543 "DTC_CTR2_COIL_OPEN" 13377544 "DTC_CTR2_CIRCUIT_FAILED" 13381632 "DTC_CTR3_LSD_FAILED_LO" 13381633 "DTC_CTR3_LSD_FAILED_HI" 13381634 "DTC_CTR3_HSD_FAILED_LO" 13381635 "DTC_CTR3_HSD_FAILED_HI" 13381636 "DTC_CTR3_PULL_IN_SHORT" 13381637 "DTC_CTR3_PULL_IN_OPEN" 13381638 "DTC_CTR3_COIL_INVALID" 13381639 "DTC_CTR3_COIL_OPEN" 13381640 "DTC_CTR3_CIRCUIT_FAILED" 13385728 "DTC_CTR4_LSD_FAILED_LO" 13385729 "DTC_CTR4_LSD_FAILED_HI" 13385730 "DTC_CTR4_HSD_FAILED_LO" 13385731 "DTC_CTR4_HSD_FAILED_HI" 13385732 "DTC_CTR4_PULL_IN_SHORT" 13385733 "DTC_CTR4_PULL_IN_OPEN" 13385734 "DTC_CTR4_COIL_INVALID" 13385735 "DTC_CTR4_COIL_OPEN" 13385736 "DTC_CTR4_CIRCUIT_FAILED" 13389824 "DTC_CTR5_LSD_FAILED_LO" 13389825 "DTC_CTR5_LSD_FAILED_HI" 13389826 "DTC_CTR5_HSD_FAILED_LO" 13389827 "DTC_CTR5_HSD_FAILED_HI" 13389828 "DTC_CTR5_PULL_IN_SHORT" 13389829 "DTC_CTR5_PULL_IN_OPEN" 13389830 "DTC_CTR5_COIL_INVALID" 13389831 "DTC_CTR5_COIL_OPEN" 13389832 "DTC_CTR5_CIRCUIT_FAILED" 13393920 "DTC_CTR6_LSD_FAILED_LO" 13393921 "DTC_CTR6_LSD_FAILED_HI" 13393922 "DTC_CTR6_HSD_FAILED_LO" 13393923 "DTC_CTR6_HSD_FAILED_HI" 13393924 "DTC_CTR6_PULL_IN_SHORT" 13393925 "DTC_CTR6_PULL_IN_OPEN" 13393926 "DTC_CTR6_COIL_INVALID" 13393927 "DTC_CTR6_COIL_OPEN" 13393928 "DTC_CTR6_CIRCUIT_FAILED" 13398016 "DTC_CTR7_LSD_FAILED_LO" 13398017 "DTC_CTR7_LSD_FAILED_HI" 13398018 "DTC_CTR7_HSD_FAILED_LO" 13398019 "DTC_CTR7_HSD_FAILED_HI" 13398020 "DTC_CTR7_PULL_IN_SHORT" 13398021 "DTC_CTR7_PULL_IN_OPEN" 13398022 "DTC_CTR7_COIL_INVALID" 13398023 "DTC_CTR7_COIL_OPEN" 13398024 "DTC_CTR7_CIRCUIT_FAILED" 14483456 "DTC_DRV_SW14V_PWR_FAILED_LO" 14483457 "DTC_DRV_SW14V_PWR_FAILED_HI" 14483472 "DTC_DRV_CHRGA_ENA_FAILED_LO" 14483473 "DTC_DRV_CHRGA_ENA_FAILED_HI" 14483488 "DTC_DRV_CHRGB_ENA_FAILED_LO" 14483489 "DTC_DRV_CHRGB_ENA_FAILED_HI" 14483504 "DTC_DRV_LSDA_FAILED_LO" 14483505 "DTC_DRV_LSDA_FAILED_HI" 14483520 "DTC_DRV_LSDB_FAILED_LO" 14483521 "DTC_DRV_LSDB_FAILED_HI" 14483536 "DTC_DRV_HSDA_FAILED_LO" 14483537 "DTC_DRV_HSDA_FAILED_HI" 14483552 "DTC_DRV_HSDB_FAILED_LO" 14483553 "DTC_DRV_HSDB_FAILED_HI" 14553088 "DTC_ICM_FGD1_FAIL_LO" 14553089 "DTC_ICM_FGD1_FAIL_HI" 14553090 "DTC_ICM_FGD1_OOR_LO" 14553091 "DTC_ICM_FGD1_OOR_HI" 14553104 "DTC_ICM_FGD2_FAIL_LO" 14553105 "DTC_ICM_FGD2_FAIL_HI" 14553106 "DTC_ICM_FGD2_OOR_LO" 14553107 "DTC_ICM_FGD2_OOR_HI" 14553120 "DTC_ICM_PILOT_FAIL_LO" 14553121 "DTC_ICM_PILOT_FAIL_HI" 14553122 "DTC_ICM_PILOT_OOR_LO" 14553123 "DTC_ICM_PILOT_OOR_HI" 14553136 "DTC_ICM_MOD_FLT_FAIL_LO" 14553137 "DTC_ICM_MOD_FLT_FAIL_HI" 14553138 "DTC_ICM_MOD_FLT_OOR_LO" 14553139 "DTC_ICM_MOD_FLT_OOR_HI" 14553152 "DTC_ICM_CLK_FAIL_LO" 14553153 "DTC_ICM_CLK_FAIL_HI" 14553154 "DTC_ICM_CLK_OOR_LO" 14553155 "DTC_ICM_CLK_OOR_HI" 14553168 "DTC_ICM_LSD_A_FAIL_LO" 14553169 "DTC_ICM_LSD_A_FAIL_HI" 14553170 "DTC_ICM_LSD_A_OOR_LO" 14553171 "DTC_ICM_LSD_A_OOR_HI" 14553184 "DTC_ICM_LSD_B_FAIL_LO" 14553185 "DTC_ICM_LSD_B_FAIL_HI" 14553186 "DTC_ICM_LSD_B_OOR_LO" 14553187 "DTC_ICM_LSD_B_OOR_HI" 14553200 "DTC_ICM_PWM_A_FAIL_LO" 14553201 "DTC_ICM_PWM_A_FAIL_HI" 14553202 "DTC_ICM_PWM_A_OOR_LO" 14553203 "DTC_ICM_PWM_A_OOR_HI" 14553216 "DTC_ICM_PWM_B_FAIL_LO" 14553217 "DTC_ICM_PWM_B_FAIL_HI" 14553218 "DTC_ICM_PWM_B_OOR_LO" 14553219 "DTC_ICM_PWM_B_OOR_HI" 14553232 "DTC_ICM_PWM_C_FAIL_LO" 14553233 "DTC_ICM_PWM_C_FAIL_HI" 14553234 "DTC_ICM_PWM_C_OOR_LO" 14553235 "DTC_ICM_PWM_C_OOR_HI" 14553248 "DTC_ICM_PWM_D_FAIL_LO" 14553249 "DTC_ICM_PWM_D_FAIL_HI" 14553250 "DTC_ICM_PWM_D_OOR_LO" 14553251 "DTC_ICM_PWM_D_OOR_HI" 14606336 "DTC_NVM_EE_0_COMM_WRITE_TO" 14606337 "DTC_NVM_EE_0_COMM_READ_TO" 14606338 "DTC_NVM_EE_0_WRITE_VERIFY" 14606339 "DTC_NVM_EE_0_READ_VERIFY" 14606340 "DTC_NVM_EE_0_READ_ERR" 14606341 "DTC_NVM_EE_0_WRITE_ERR" 14564800 "DTC_PWM_LSD_A_DC_MISMATCH" 14565344 "DTC_PWM_LSD_A_FREQ_MISMATCH" 14564801 "DTC_PWM_PWM_A_DC_MISMATCH" 14565345 "DTC_PWM_PWM_A_FREQ_MISMATCH" 14564802 "DTC_PWM_PWM_B_DC_MISMATCH" 14565346 "DTC_PWM_PWM_B_FREQ_MISMATCH" 14564803 "DTC_PWM_PWM_C_DC_MISMATCH" 14565347 "DTC_PWM_PWM_C_FREQ_MISMATCH" 14564804 "DTC_PWM_PWM_D_DC_MISMATCH" 14565348 "DTC_PWM_PWM_D_FREQ_MISMATCH" 14417920 "DTC_PWR_WAKEUP_CLK_FAILED" 14417921 "DTC_PWR_WAKEUP_CLK_OOR_LO" 14417922 "DTC_PWR_WAKEUP_CLK_OOR_HI" 14614570 "DTC_SDP_HPWR_OOR_HI" 14614571 "DTC_SDP_HPWR_OOR_LO" 14614572 "DTC_SDP_HPWR_COMM_TO" 14614573 "DTC_SDP_DEVICE_FAILURE";
VAL_ 1120 bcm_dtc_068 0 " - " 11276288 "DTC_VEPO" 11276289 "DTC_HSC_MISSING" 11460608 "DTC_NVM_SOC" 11460609 "DTC_NVM_HYST" 11460610 "DTC_NVM_KOT" 11460611 "DTC_NVM_PERIODIC_SHUTDOWN_TIME" 11460612 "DTC_NVM_WAKE" 11460613 "DTC_NVM_CALENDAR_LIFE" 11460614 "DTC_NVM_CYCLE_LIFE" 11460615 "DTC_NVM_DTC" 11460616 "DTC_NVM_APP_SCRATCHPAD" 11517962 "DTC_LOOPTIME_TASK_A" 11517963 "DTC_LOOPTIME_TASK_B" 11517964 "DTC_LOOPTIME_TASK_C" 11517965 "DTC_LOOPTIME_TASK_D" 11517966 "DTC_LOOPTIME_TASK_E" 11517967 "DTC_ILIM_MAX_DISCHARGE" 15728640 "DTC_EPO" 16171008 "DTC_CONT_OPEN" 16171009 "DTC_CONT_CLOSE" 16171010 "DTC_CONT_OPEN_CURRENT" 16171264 "DTC_CONT_CLOSE_ON_RESET" 16171265 "DTC_CONT_CLOSE_SIG_FAILED" 16171520 "DTC_PRECHARGE_TIMEOUT" 16171777 "DTC_CONT_NEG_WELD_AT_SU" 16171778 "DTC_CONT_POS_A_WELD_AT_SU" 16171779 "DTC_CONT_POS_B_WELD_AT_SU" 16172033 "DTC_CONT_NEG_WELD_AT_SD" 16172034 "DTC_CONT_POS_A_WELD_AT_SD" 16172036 "DTC_CONT_POS_B_WELD_AT_SD" 16172289 "DTC_CONT_NEG_OPEN" 16172290 "DTC_CONT_POS_A_OPEN" 16172291 "DTC_CONT_POS_B_OPEN" 16172545 "DTC_CONT_NEG_VDIF" 16172546 "DTC_CONT_POS_A_VDIF" 16172548 "DTC_CONT_POS_B_VDIF" 16174848 "DTC_HVIL" 16174849 "DTC_LVBAT_LO" 16174850 "DTC_LVBAT_HI" 16174851 "DTC_LVBAT_ERR" 16522240 "DTC_CSM_MISSING" 16522752 "DTC_CSM_VBAT" 16522753 "DTC_CSM_VPOS" 16522754 "DTC_CSM_VNEG" 16522755 "DTC_CSM_CPOS" 16522756 "DTC_CSM_CNEG" 16522757 "DTC_CSM_APOS" 16522758 "DTC_CSM_ANEG" 16522759 "DTC_CSM_FUSE_HI" 16522760 "DTC_CSM_FUSE_LO" 16521728 "DTC_CSM_ASIC" 16521729 "DTC_CSM_AILO" 16521730 "DTC_CSM_AIHI" 16520957 "DTC_LEAKAGE_DETECT_FAULT" 16522444 "DTC_REALTIMECLOCK_FAULT" 16520945 "DTC_CSM_LEAK_FAIL_CALC" 16520946 "DTC_CSM_LEAK_FAIL_HW" 16520947 "DTC_CSM_LEAK_EXT_SHORT" 16520948 "DTC_CSM_LEAK_MID_PACK_SHORT" 16520949 "DTC_CSM_LEAK_ERROR" 16520950 "DTC_CSM_LEAK_UNKNOWN" 16523008 "DTC_CSM_VER_MISMATCH" 16523009 "DTC_CSM_DTC_SET" 16523010 "DTC_CSM_CAL_FAULT" 16496320 "DTC_MBB_TOO_FEW" 16496321 "DTC_MBB_TOO_MANY" 16496352 "DTC_CELL_VMAX_ERR" 16496353 "DTC_CELL_VMIN_ERR" 16496354 "DTC_CELL_VMAX" 16496362 "DTC_CELL_VMAX_SEVERE" 16496355 "DTC_CELL_VMIN" 16496363 "DTC_CELL_VMIN_SEVERE" 16496356 "DTC_MOD_VOLTAGE_COMPARE" 16496336 "DTC_CELL_T_ERR" 16496337 "DTC_CELL_TMAX1" 16496338 "DTC_CELL_TMAX2" 16496339 "DTC_CELL_TMIN" 16497665 "DTC_MBB_01_MISSING" 16497666 "DTC_MBB_02_MISSING" 16497667 "DTC_MBB_03_MISSING" 16497668 "DTC_MBB_04_MISSING" 16497669 "DTC_MBB_05_MISSING" 16497670 "DTC_MBB_06_MISSING" 16497671 "DTC_MBB_07_MISSING" 16497672 "DTC_MBB_08_MISSING" 16497673 "DTC_MBB_09_MISSING" 16497680 "DTC_MBB_10_MISSING" 16497681 "DTC_MBB_11_MISSING" 16497682 "DTC_MBB_12_MISSING" 16497683 "DTC_MBB_13_MISSING" 16497684 "DTC_MBB_14_MISSING" 16497685 "DTC_MBB_15_MISSING" 16497686 "DTC_MBB_16_MISSING" 16497687 "DTC_MBB_17_MISSING" 16497688 "DTC_MBB_18_MISSING" 16497689 "DTC_MBB_19_MISSING" 16497696 "DTC_MBB_20_MISSING" 16497697 "DTC_MBB_21_MISSING" 16497698 "DTC_MBB_22_MISSING" 16497699 "DTC_MBB_23_MISSING" 16497700 "DTC_MBB_24_MISSING" 16498177 "DTC_MBB_01_VFAULT" 16498178 "DTC_MBB_02_VFAULT" 16498179 "DTC_MBB_03_VFAULT" 16498180 "DTC_MBB_04_VFAULT" 16498181 "DTC_MBB_05_VFAULT" 16498182 "DTC_MBB_06_VFAULT" 16498183 "DTC_MBB_07_VFAULT" 16498184 "DTC_MBB_08_VFAULT" 16498185 "DTC_MBB_09_VFAULT" 16498192 "DTC_MBB_10_VFAULT" 16498193 "DTC_MBB_11_VFAULT" 16498194 "DTC_MBB_12_VFAULT" 16498195 "DTC_MBB_13_VFAULT" 16498196 "DTC_MBB_14_VFAULT" 16498197 "DTC_MBB_15_VFAULT" 16498198 "DTC_MBB_16_VFAULT" 16498199 "DTC_MBB_17_VFAULT" 16498200 "DTC_MBB_18_VFAULT" 16498201 "DTC_MBB_19_VFAULT" 16498208 "DTC_MBB_20_VFAULT" 16498209 "DTC_MBB_21_VFAULT" 16498210 "DTC_MBB_22_VFAULT" 16498211 "DTC_MBB_23_VFAULT" 16498212 "DTC_MBB_24_VFAULT" 16497921 "DTC_MBB_01_TFAULT" 16497922 "DTC_MBB_02_TFAULT" 16497923 "DTC_MBB_03_TFAULT" 16497924 "DTC_MBB_04_TFAULT" 16497925 "DTC_MBB_05_TFAULT" 16497926 "DTC_MBB_06_TFAULT" 16497927 "DTC_MBB_07_TFAULT" 16497928 "DTC_MBB_08_TFAULT" 16497929 "DTC_MBB_09_TFAULT" 16497936 "DTC_MBB_10_TFAULT" 16497937 "DTC_MBB_11_TFAULT" 16497938 "DTC_MBB_12_TFAULT" 16497939 "DTC_MBB_13_TFAULT" 16497940 "DTC_MBB_14_TFAULT" 16497941 "DTC_MBB_15_TFAULT" 16497942 "DTC_MBB_16_TFAULT" 16497943 "DTC_MBB_17_TFAULT" 16497944 "DTC_MBB_18_TFAULT" 16497945 "DTC_MBB_19_TFAULT" 16497952 "DTC_MBB_20_TFAULT" 16497953 "DTC_MBB_21_TFAULT" 16497954 "DTC_MBB_22_TFAULT" 16497955 "DTC_MBB_23_TFAULT" 16497956 "DTC_MBB_24_TFAULT" 16498688 "DTC_BRUSA_MISSING" 16498689 "DTC_BRUSA_IDC" 16498690 "DTC_BRUSA_REQ_VS_CMD" 16560128 "DTC_IBAT_MISMATCH" 16576512 "DTC_DIS_MAX_I2T" 16576513 "DTC_CHG_MAX_I2T" 16576768 "DTC_DIS_WARNING_I2T" 16576769 "DTC_CHG_WARNING_I2T" 16523520 "DTC_LEM_A_OOR_HI" 16523521 "DTC_LEM_A_OOR_LO" 16523522 "DTC_LEM_A_FAULT" 16523776 "DTC_LEM_B_OOR_HI" 16523777 "DTC_LEM_B_OOR_LO" 16523778 "DTC_LEM_B_FAULT" 16506880 "DTC_VBAT_MISMATCH" 16506881 "DTC_VBAT_VMAX" 16506882 "DTC_VBAT_VMIN" 16506883 "DTC_PACK_FUSE_A" 16506884 "DTC_PACK_FUSE_B" 16252928 "DTC_KEY_OFF_TIME_ERROR" 16252929 "DTC_PERIODIC_OFF_TIME_ERROR" 14290944 "DTC_AIN_BPWR_FAIL_LO" 14290945 "DTC_AIN_BPWR_FAIL_HI" 14290946 "DTC_AIN_BPWR_OOR_LO" 14290947 "DTC_AIN_BPWR_OOR_HI" 14290960 "DTC_AIN_14V_FAIL_LO" 14290961 "DTC_AIN_14V_FAIL_HI" 14290962 "DTC_AIN_14V_OOR_LO" 14290963 "DTC_AIN_14V_OOR_HI" 14290976 "DTC_AIN_HPWR_FAIL_LO" 14290977 "DTC_AIN_HPWR_FAIL_HI" 14290978 "DTC_AIN_HPWR_OOR_LO" 14290979 "DTC_AIN_HPWR_OOR_HI" 14290992 "DTC_AIN_6V_FAIL_LO" 14290993 "DTC_AIN_6V_FAIL_HI" 14290994 "DTC_AIN_6V_OOR_LO" 14290995 "DTC_AIN_6V_OOR_HI" 14291008 "DTC_AIN_HVIL_FAIL_LO" 14291009 "DTC_AIN_HVIL_FAIL_HI" 14291010 "DTC_AIN_HVIL_OOR_LO" 14291011 "DTC_AIN_HVIL_OOR_HI" 14291024 "DTC_AIN_5V_PWR_FAIL_LO" 14291025 "DTC_AIN_5V_PWR_FAIL_HI" 14291026 "DTC_AIN_5V_PWR_OOR_LO" 14291027 "DTC_AIN_5V_PWR_OOR_HI" 14291040 "DTC_AIN_LEM_HI_FAIL_LO" 14291041 "DTC_AIN_LEM_HI_FAIL_HI" 14291042 "DTC_AIN_LEM_HI_OOR_LO" 14291043 "DTC_AIN_LEM_HI_OOR_HI" 14291056 "DTC_AIN_LEM_LO_FAIL_LO" 14291057 "DTC_AIN_LEM_LO_FAIL_HI" 14291058 "DTC_AIN_LEM_LO_OOR_LO" 14291059 "DTC_AIN_LEM_LO_OOR_HI" 14291072 "DTC_AIN_BCT_AI_FAIL_LO" 14291073 "DTC_AIN_BCT_AI_FAIL_HI" 14291074 "DTC_AIN_BCT_AI_OOR_LO" 14291075 "DTC_AIN_BCT_AI_OOR_HI" 14291088 "DTC_AIN_WTR2_AI_FAIL_LO" 14291089 "DTC_AIN_WTR2_AI_FAIL_HI" 14291090 "DTC_AIN_WTR2_AI_OOR_LO" 14291091 "DTC_AIN_WTR2_AI_OOR_HI" 14291104 "DTC_AIN_WTR1_AI_FAIL_LO" 14291105 "DTC_AIN_WTR1_AI_FAIL_HI" 14291106 "DTC_AIN_WTR1_AI_OOR_LO" 14291107 "DTC_AIN_WTR1_AI_OOR_HI" 14291120 "DTC_AIN_AIA_FAIL_LO" 14291121 "DTC_AIN_AIA_FAIL_HI" 14291122 "DTC_AIN_AIA_OOR_LO" 14291123 "DTC_AIN_AIA_OOR_HI" 14291136 "DTC_AIN_PROX_AI_FAIL_LO" 14291137 "DTC_AIN_PROX_AI_FAIL_HI" 14291138 "DTC_AIN_PROX_AI_OOR_LO" 14291139 "DTC_AIN_PROX_AI_OOR_HI" 14291152 "DTC_AIN_TWV_FB_FAIL_LO" 14291153 "DTC_AIN_TWV_FB_FAIL_HI" 14291154 "DTC_AIN_TWV_FB_OOR_LO" 14291155 "DTC_AIN_TWV_FB_OOR_HI" 14291168 "DTC_AIN_5V_KA_FAIL_LO" 14291169 "DTC_AIN_5V_KA_FAIL_HI" 14291170 "DTC_AIN_5V_KA_OOR_LO" 14291171 "DTC_AIN_5V_KA_OOR_HI" 14291184 "DTC_AIN_CTR1_LSD_FAIL_LO" 14291185 "DTC_AIN_CTR1_LSD_FAIL_HI" 14291186 "DTC_AIN_CTR1_LSD_OOR_LO" 14291187 "DTC_AIN_CTR1_LSD_OOR_HI" 14291200 "DTC_AIN_CTR2_LSD_FAIL_LO" 14291201 "DTC_AIN_CTR2_LSD_FAIL_HI" 14291202 "DTC_AIN_CTR2_LSD_OOR_LO" 14291203 "DTC_AIN_CTR2_LSD_OOR_HI" 14291216 "DTC_AIN_CTR3_LSD_FAIL_LO" 14291217 "DTC_AIN_CTR3_LSD_FAIL_HI" 14291218 "DTC_AIN_CTR3_LSD_OOR_LO" 14291219 "DTC_AIN_CTR3_LSD_OOR_HI" 14291232 "DTC_AIN_CTR4_LSD_FAIL_LO" 14291233 "DTC_AIN_CTR4_LSD_FAIL_HI" 14291234 "DTC_AIN_CTR4_LSD_OOR_LO" 14291235 "DTC_AIN_CTR4_LSD_OOR_HI" 14291248 "DTC_AIN_CTR5_LSD_FAIL_LO" 14291249 "DTC_AIN_CTR5_LSD_FAIL_HI" 14291250 "DTC_AIN_CTR5_LSD_OOR_LO" 14291251 "DTC_AIN_CTR5_LSD_OOR_HI" 14291264 "DTC_AIN_CTR6_LSD_FAIL_LO" 14291265 "DTC_AIN_CTR6_LSD_FAIL_HI" 14291266 "DTC_AIN_CTR6_LSD_OOR_LO" 14291267 "DTC_AIN_CTR6_LSD_OOR_HI" 14291280 "DTC_AIN_CTR7_LSD_FAIL_LO" 14291281 "DTC_AIN_CTR7_LSD_FAIL_HI" 14291282 "DTC_AIN_CTR7_LSD_OOR_LO" 14291283 "DTC_AIN_CTR7_LSD_OOR_HI" 14291296 "DTC_AIN_CTR_PWR_CUR_FAIL_LO" 14291297 "DTC_AIN_CTR_PWR_CUR_FAIL_HI" 14291298 "DTC_AIN_CTR_PWR_CUR_OOR_LO" 14291299 "DTC_AIN_CTR_PWR_CUR_OOR_HI" 14291312 "DTC_AIN_CTR_HLD_CUR_FAIL_LO" 14291313 "DTC_AIN_CTR_HLD_CUR_FAIL_HI" 14291314 "DTC_AIN_CTR_HLD_CUR_OOR_LO" 14291315 "DTC_AIN_CTR_HLD_CUR_OOR_HI" 13431040 "DTC_CTR_FAULT_LATCH" 13431041 "DTC_CTR_FAULT_INVALID_HEARTBEAT" 13373440 "DTC_CTR1_LSD_FAILED_LO" 13373441 "DTC_CTR1_LSD_FAILED_HI" 13373442 "DTC_CTR1_HSD_FAILED_LO" 13373443 "DTC_CTR1_HSD_FAILED_HI" 13373444 "DTC_CTR1_PULL_IN_SHORT" 13373445 "DTC_CTR1_PULL_IN_OPEN" 13373446 "DTC_CTR1_COIL_INVALID" 13373447 "DTC_CTR1_COIL_OPEN" 13373448 "DTC_CTR1_CIRCUIT_FAILED" 13377536 "DTC_CTR2_LSD_FAILED_LO" 13377537 "DTC_CTR2_LSD_FAILED_HI" 13377538 "DTC_CTR2_HSD_FAILED_LO" 13377539 "DTC_CTR2_HSD_FAILED_HI" 13377540 "DTC_CTR2_PULL_IN_SHORT" 13377541 "DTC_CTR2_PULL_IN_OPEN" 13377542 "DTC_CTR2_COIL_INVALID" 13377543 "DTC_CTR2_COIL_OPEN" 13377544 "DTC_CTR2_CIRCUIT_FAILED" 13381632 "DTC_CTR3_LSD_FAILED_LO" 13381633 "DTC_CTR3_LSD_FAILED_HI" 13381634 "DTC_CTR3_HSD_FAILED_LO" 13381635 "DTC_CTR3_HSD_FAILED_HI" 13381636 "DTC_CTR3_PULL_IN_SHORT" 13381637 "DTC_CTR3_PULL_IN_OPEN" 13381638 "DTC_CTR3_COIL_INVALID" 13381639 "DTC_CTR3_COIL_OPEN" 13381640 "DTC_CTR3_CIRCUIT_FAILED" 13385728 "DTC_CTR4_LSD_FAILED_LO" 13385729 "DTC_CTR4_LSD_FAILED_HI" 13385730 "DTC_CTR4_HSD_FAILED_LO" 13385731 "DTC_CTR4_HSD_FAILED_HI" 13385732 "DTC_CTR4_PULL_IN_SHORT" 13385733 "DTC_CTR4_PULL_IN_OPEN" 13385734 "DTC_CTR4_COIL_INVALID" 13385735 "DTC_CTR4_COIL_OPEN" 13385736 "DTC_CTR4_CIRCUIT_FAILED" 13389824 "DTC_CTR5_LSD_FAILED_LO" 13389825 "DTC_CTR5_LSD_FAILED_HI" 13389826 "DTC_CTR5_HSD_FAILED_LO" 13389827 "DTC_CTR5_HSD_FAILED_HI" 13389828 "DTC_CTR5_PULL_IN_SHORT" 13389829 "DTC_CTR5_PULL_IN_OPEN" 13389830 "DTC_CTR5_COIL_INVALID" 13389831 "DTC_CTR5_COIL_OPEN" 13389832 "DTC_CTR5_CIRCUIT_FAILED" 13393920 "DTC_CTR6_LSD_FAILED_LO" 13393921 "DTC_CTR6_LSD_FAILED_HI" 13393922 "DTC_CTR6_HSD_FAILED_LO" 13393923 "DTC_CTR6_HSD_FAILED_HI" 13393924 "DTC_CTR6_PULL_IN_SHORT" 13393925 "DTC_CTR6_PULL_IN_OPEN" 13393926 "DTC_CTR6_COIL_INVALID" 13393927 "DTC_CTR6_COIL_OPEN" 13393928 "DTC_CTR6_CIRCUIT_FAILED" 13398016 "DTC_CTR7_LSD_FAILED_LO" 13398017 "DTC_CTR7_LSD_FAILED_HI" 13398018 "DTC_CTR7_HSD_FAILED_LO" 13398019 "DTC_CTR7_HSD_FAILED_HI" 13398020 "DTC_CTR7_PULL_IN_SHORT" 13398021 "DTC_CTR7_PULL_IN_OPEN" 13398022 "DTC_CTR7_COIL_INVALID" 13398023 "DTC_CTR7_COIL_OPEN" 13398024 "DTC_CTR7_CIRCUIT_FAILED" 14483456 "DTC_DRV_SW14V_PWR_FAILED_LO" 14483457 "DTC_DRV_SW14V_PWR_FAILED_HI" 14483472 "DTC_DRV_CHRGA_ENA_FAILED_LO" 14483473 "DTC_DRV_CHRGA_ENA_FAILED_HI" 14483488 "DTC_DRV_CHRGB_ENA_FAILED_LO" 14483489 "DTC_DRV_CHRGB_ENA_FAILED_HI" 14483504 "DTC_DRV_LSDA_FAILED_LO" 14483505 "DTC_DRV_LSDA_FAILED_HI" 14483520 "DTC_DRV_LSDB_FAILED_LO" 14483521 "DTC_DRV_LSDB_FAILED_HI" 14483536 "DTC_DRV_HSDA_FAILED_LO" 14483537 "DTC_DRV_HSDA_FAILED_HI" 14483552 "DTC_DRV_HSDB_FAILED_LO" 14483553 "DTC_DRV_HSDB_FAILED_HI" 14553088 "DTC_ICM_FGD1_FAIL_LO" 14553089 "DTC_ICM_FGD1_FAIL_HI" 14553090 "DTC_ICM_FGD1_OOR_LO" 14553091 "DTC_ICM_FGD1_OOR_HI" 14553104 "DTC_ICM_FGD2_FAIL_LO" 14553105 "DTC_ICM_FGD2_FAIL_HI" 14553106 "DTC_ICM_FGD2_OOR_LO" 14553107 "DTC_ICM_FGD2_OOR_HI" 14553120 "DTC_ICM_PILOT_FAIL_LO" 14553121 "DTC_ICM_PILOT_FAIL_HI" 14553122 "DTC_ICM_PILOT_OOR_LO" 14553123 "DTC_ICM_PILOT_OOR_HI" 14553136 "DTC_ICM_MOD_FLT_FAIL_LO" 14553137 "DTC_ICM_MOD_FLT_FAIL_HI" 14553138 "DTC_ICM_MOD_FLT_OOR_LO" 14553139 "DTC_ICM_MOD_FLT_OOR_HI" 14553152 "DTC_ICM_CLK_FAIL_LO" 14553153 "DTC_ICM_CLK_FAIL_HI" 14553154 "DTC_ICM_CLK_OOR_LO" 14553155 "DTC_ICM_CLK_OOR_HI" 14553168 "DTC_ICM_LSD_A_FAIL_LO" 14553169 "DTC_ICM_LSD_A_FAIL_HI" 14553170 "DTC_ICM_LSD_A_OOR_LO" 14553171 "DTC_ICM_LSD_A_OOR_HI" 14553184 "DTC_ICM_LSD_B_FAIL_LO" 14553185 "DTC_ICM_LSD_B_FAIL_HI" 14553186 "DTC_ICM_LSD_B_OOR_LO" 14553187 "DTC_ICM_LSD_B_OOR_HI" 14553200 "DTC_ICM_PWM_A_FAIL_LO" 14553201 "DTC_ICM_PWM_A_FAIL_HI" 14553202 "DTC_ICM_PWM_A_OOR_LO" 14553203 "DTC_ICM_PWM_A_OOR_HI" 14553216 "DTC_ICM_PWM_B_FAIL_LO" 14553217 "DTC_ICM_PWM_B_FAIL_HI" 14553218 "DTC_ICM_PWM_B_OOR_LO" 14553219 "DTC_ICM_PWM_B_OOR_HI" 14553232 "DTC_ICM_PWM_C_FAIL_LO" 14553233 "DTC_ICM_PWM_C_FAIL_HI" 14553234 "DTC_ICM_PWM_C_OOR_LO" 14553235 "DTC_ICM_PWM_C_OOR_HI" 14553248 "DTC_ICM_PWM_D_FAIL_LO" 14553249 "DTC_ICM_PWM_D_FAIL_HI" 14553250 "DTC_ICM_PWM_D_OOR_LO" 14553251 "DTC_ICM_PWM_D_OOR_HI" 14606336 "DTC_NVM_EE_0_COMM_WRITE_TO" 14606337 "DTC_NVM_EE_0_COMM_READ_TO" 14606338 "DTC_NVM_EE_0_WRITE_VERIFY" 14606339 "DTC_NVM_EE_0_READ_VERIFY" 14606340 "DTC_NVM_EE_0_READ_ERR" 14606341 "DTC_NVM_EE_0_WRITE_ERR" 14564800 "DTC_PWM_LSD_A_DC_MISMATCH" 14565344 "DTC_PWM_LSD_A_FREQ_MISMATCH" 14564801 "DTC_PWM_PWM_A_DC_MISMATCH" 14565345 "DTC_PWM_PWM_A_FREQ_MISMATCH" 14564802 "DTC_PWM_PWM_B_DC_MISMATCH" 14565346 "DTC_PWM_PWM_B_FREQ_MISMATCH" 14564803 "DTC_PWM_PWM_C_DC_MISMATCH" 14565347 "DTC_PWM_PWM_C_FREQ_MISMATCH" 14564804 "DTC_PWM_PWM_D_DC_MISMATCH" 14565348 "DTC_PWM_PWM_D_FREQ_MISMATCH" 14417920 "DTC_PWR_WAKEUP_CLK_FAILED" 14417921 "DTC_PWR_WAKEUP_CLK_OOR_LO" 14417922 "DTC_PWR_WAKEUP_CLK_OOR_HI" 14614570 "DTC_SDP_HPWR_OOR_HI" 14614571 "DTC_SDP_HPWR_OOR_LO" 14614572 "DTC_SDP_HPWR_COMM_TO" 14614573 "DTC_SDP_DEVICE_FAILURE";
VAL_ 1120 bcm_dtc_069 0 " - " 11276288 "DTC_VEPO" 11276289 "DTC_HSC_MISSING" 11460608 "DTC_NVM_SOC" 11460609 "DTC_NVM_HYST" 11460610 "DTC_NVM_KOT" 11460611 "DTC_NVM_PERIODIC_SHUTDOWN_TIME" 11460612 "DTC_NVM_WAKE" 11460613 "DTC_NVM_CALENDAR_LIFE" 11460614 "DTC_NVM_CYCLE_LIFE" 11460615 "DTC_NVM_DTC" 11460616 "DTC_NVM_APP_SCRATCHPAD" 11517962 "DTC_LOOPTIME_TASK_A" 11517963 "DTC_LOOPTIME_TASK_B" 11517964 "DTC_LOOPTIME_TASK_C" 11517965 "DTC_LOOPTIME_TASK_D" 11517966 "DTC_LOOPTIME_TASK_E" 11517967 "DTC_ILIM_MAX_DISCHARGE" 15728640 "DTC_EPO" 16171008 "DTC_CONT_OPEN" 16171009 "DTC_CONT_CLOSE" 16171010 "DTC_CONT_OPEN_CURRENT" 16171264 "DTC_CONT_CLOSE_ON_RESET" 16171265 "DTC_CONT_CLOSE_SIG_FAILED" 16171520 "DTC_PRECHARGE_TIMEOUT" 16171777 "DTC_CONT_NEG_WELD_AT_SU" 16171778 "DTC_CONT_POS_A_WELD_AT_SU" 16171779 "DTC_CONT_POS_B_WELD_AT_SU" 16172033 "DTC_CONT_NEG_WELD_AT_SD" 16172034 "DTC_CONT_POS_A_WELD_AT_SD" 16172036 "DTC_CONT_POS_B_WELD_AT_SD" 16172289 "DTC_CONT_NEG_OPEN" 16172290 "DTC_CONT_POS_A_OPEN" 16172291 "DTC_CONT_POS_B_OPEN" 16172545 "DTC_CONT_NEG_VDIF" 16172546 "DTC_CONT_POS_A_VDIF" 16172548 "DTC_CONT_POS_B_VDIF" 16174848 "DTC_HVIL" 16174849 "DTC_LVBAT_LO" 16174850 "DTC_LVBAT_HI" 16174851 "DTC_LVBAT_ERR" 16522240 "DTC_CSM_MISSING" 16522752 "DTC_CSM_VBAT" 16522753 "DTC_CSM_VPOS" 16522754 "DTC_CSM_VNEG" 16522755 "DTC_CSM_CPOS" 16522756 "DTC_CSM_CNEG" 16522757 "DTC_CSM_APOS" 16522758 "DTC_CSM_ANEG" 16522759 "DTC_CSM_FUSE_HI" 16522760 "DTC_CSM_FUSE_LO" 16521728 "DTC_CSM_ASIC" 16521729 "DTC_CSM_AILO" 16521730 "DTC_CSM_AIHI" 16520957 "DTC_LEAKAGE_DETECT_FAULT" 16522444 "DTC_REALTIMECLOCK_FAULT" 16520945 "DTC_CSM_LEAK_FAIL_CALC" 16520946 "DTC_CSM_LEAK_FAIL_HW" 16520947 "DTC_CSM_LEAK_EXT_SHORT" 16520948 "DTC_CSM_LEAK_MID_PACK_SHORT" 16520949 "DTC_CSM_LEAK_ERROR" 16520950 "DTC_CSM_LEAK_UNKNOWN" 16523008 "DTC_CSM_VER_MISMATCH" 16523009 "DTC_CSM_DTC_SET" 16523010 "DTC_CSM_CAL_FAULT" 16496320 "DTC_MBB_TOO_FEW" 16496321 "DTC_MBB_TOO_MANY" 16496352 "DTC_CELL_VMAX_ERR" 16496353 "DTC_CELL_VMIN_ERR" 16496354 "DTC_CELL_VMAX" 16496362 "DTC_CELL_VMAX_SEVERE" 16496355 "DTC_CELL_VMIN" 16496363 "DTC_CELL_VMIN_SEVERE" 16496356 "DTC_MOD_VOLTAGE_COMPARE" 16496336 "DTC_CELL_T_ERR" 16496337 "DTC_CELL_TMAX1" 16496338 "DTC_CELL_TMAX2" 16496339 "DTC_CELL_TMIN" 16497665 "DTC_MBB_01_MISSING" 16497666 "DTC_MBB_02_MISSING" 16497667 "DTC_MBB_03_MISSING" 16497668 "DTC_MBB_04_MISSING" 16497669 "DTC_MBB_05_MISSING" 16497670 "DTC_MBB_06_MISSING" 16497671 "DTC_MBB_07_MISSING" 16497672 "DTC_MBB_08_MISSING" 16497673 "DTC_MBB_09_MISSING" 16497680 "DTC_MBB_10_MISSING" 16497681 "DTC_MBB_11_MISSING" 16497682 "DTC_MBB_12_MISSING" 16497683 "DTC_MBB_13_MISSING" 16497684 "DTC_MBB_14_MISSING" 16497685 "DTC_MBB_15_MISSING" 16497686 "DTC_MBB_16_MISSING" 16497687 "DTC_MBB_17_MISSING" 16497688 "DTC_MBB_18_MISSING" 16497689 "DTC_MBB_19_MISSING" 16497696 "DTC_MBB_20_MISSING" 16497697 "DTC_MBB_21_MISSING" 16497698 "DTC_MBB_22_MISSING" 16497699 "DTC_MBB_23_MISSING" 16497700 "DTC_MBB_24_MISSING" 16498177 "DTC_MBB_01_VFAULT" 16498178 "DTC_MBB_02_VFAULT" 16498179 "DTC_MBB_03_VFAULT" 16498180 "DTC_MBB_04_VFAULT" 16498181 "DTC_MBB_05_VFAULT" 16498182 "DTC_MBB_06_VFAULT" 16498183 "DTC_MBB_07_VFAULT" 16498184 "DTC_MBB_08_VFAULT" 16498185 "DTC_MBB_09_VFAULT" 16498192 "DTC_MBB_10_VFAULT" 16498193 "DTC_MBB_11_VFAULT" 16498194 "DTC_MBB_12_VFAULT" 16498195 "DTC_MBB_13_VFAULT" 16498196 "DTC_MBB_14_VFAULT" 16498197 "DTC_MBB_15_VFAULT" 16498198 "DTC_MBB_16_VFAULT" 16498199 "DTC_MBB_17_VFAULT" 16498200 "DTC_MBB_18_VFAULT" 16498201 "DTC_MBB_19_VFAULT" 16498208 "DTC_MBB_20_VFAULT" 16498209 "DTC_MBB_21_VFAULT" 16498210 "DTC_MBB_22_VFAULT" 16498211 "DTC_MBB_23_VFAULT" 16498212 "DTC_MBB_24_VFAULT" 16497921 "DTC_MBB_01_TFAULT" 16497922 "DTC_MBB_02_TFAULT" 16497923 "DTC_MBB_03_TFAULT" 16497924 "DTC_MBB_04_TFAULT" 16497925 "DTC_MBB_05_TFAULT" 16497926 "DTC_MBB_06_TFAULT" 16497927 "DTC_MBB_07_TFAULT" 16497928 "DTC_MBB_08_TFAULT" 16497929 "DTC_MBB_09_TFAULT" 16497936 "DTC_MBB_10_TFAULT" 16497937 "DTC_MBB_11_TFAULT" 16497938 "DTC_MBB_12_TFAULT" 16497939 "DTC_MBB_13_TFAULT" 16497940 "DTC_MBB_14_TFAULT" 16497941 "DTC_MBB_15_TFAULT" 16497942 "DTC_MBB_16_TFAULT" 16497943 "DTC_MBB_17_TFAULT" 16497944 "DTC_MBB_18_TFAULT" 16497945 "DTC_MBB_19_TFAULT" 16497952 "DTC_MBB_20_TFAULT" 16497953 "DTC_MBB_21_TFAULT" 16497954 "DTC_MBB_22_TFAULT" 16497955 "DTC_MBB_23_TFAULT" 16497956 "DTC_MBB_24_TFAULT" 16498688 "DTC_BRUSA_MISSING" 16498689 "DTC_BRUSA_IDC" 16498690 "DTC_BRUSA_REQ_VS_CMD" 16560128 "DTC_IBAT_MISMATCH" 16576512 "DTC_DIS_MAX_I2T" 16576513 "DTC_CHG_MAX_I2T" 16576768 "DTC_DIS_WARNING_I2T" 16576769 "DTC_CHG_WARNING_I2T" 16523520 "DTC_LEM_A_OOR_HI" 16523521 "DTC_LEM_A_OOR_LO" 16523522 "DTC_LEM_A_FAULT" 16523776 "DTC_LEM_B_OOR_HI" 16523777 "DTC_LEM_B_OOR_LO" 16523778 "DTC_LEM_B_FAULT" 16506880 "DTC_VBAT_MISMATCH" 16506881 "DTC_VBAT_VMAX" 16506882 "DTC_VBAT_VMIN" 16506883 "DTC_PACK_FUSE_A" 16506884 "DTC_PACK_FUSE_B" 16252928 "DTC_KEY_OFF_TIME_ERROR" 16252929 "DTC_PERIODIC_OFF_TIME_ERROR" 14290944 "DTC_AIN_BPWR_FAIL_LO" 14290945 "DTC_AIN_BPWR_FAIL_HI" 14290946 "DTC_AIN_BPWR_OOR_LO" 14290947 "DTC_AIN_BPWR_OOR_HI" 14290960 "DTC_AIN_14V_FAIL_LO" 14290961 "DTC_AIN_14V_FAIL_HI" 14290962 "DTC_AIN_14V_OOR_LO" 14290963 "DTC_AIN_14V_OOR_HI" 14290976 "DTC_AIN_HPWR_FAIL_LO" 14290977 "DTC_AIN_HPWR_FAIL_HI" 14290978 "DTC_AIN_HPWR_OOR_LO" 14290979 "DTC_AIN_HPWR_OOR_HI" 14290992 "DTC_AIN_6V_FAIL_LO" 14290993 "DTC_AIN_6V_FAIL_HI" 14290994 "DTC_AIN_6V_OOR_LO" 14290995 "DTC_AIN_6V_OOR_HI" 14291008 "DTC_AIN_HVIL_FAIL_LO" 14291009 "DTC_AIN_HVIL_FAIL_HI" 14291010 "DTC_AIN_HVIL_OOR_LO" 14291011 "DTC_AIN_HVIL_OOR_HI" 14291024 "DTC_AIN_5V_PWR_FAIL_LO" 14291025 "DTC_AIN_5V_PWR_FAIL_HI" 14291026 "DTC_AIN_5V_PWR_OOR_LO" 14291027 "DTC_AIN_5V_PWR_OOR_HI" 14291040 "DTC_AIN_LEM_HI_FAIL_LO" 14291041 "DTC_AIN_LEM_HI_FAIL_HI" 14291042 "DTC_AIN_LEM_HI_OOR_LO" 14291043 "DTC_AIN_LEM_HI_OOR_HI" 14291056 "DTC_AIN_LEM_LO_FAIL_LO" 14291057 "DTC_AIN_LEM_LO_FAIL_HI" 14291058 "DTC_AIN_LEM_LO_OOR_LO" 14291059 "DTC_AIN_LEM_LO_OOR_HI" 14291072 "DTC_AIN_BCT_AI_FAIL_LO" 14291073 "DTC_AIN_BCT_AI_FAIL_HI" 14291074 "DTC_AIN_BCT_AI_OOR_LO" 14291075 "DTC_AIN_BCT_AI_OOR_HI" 14291088 "DTC_AIN_WTR2_AI_FAIL_LO" 14291089 "DTC_AIN_WTR2_AI_FAIL_HI" 14291090 "DTC_AIN_WTR2_AI_OOR_LO" 14291091 "DTC_AIN_WTR2_AI_OOR_HI" 14291104 "DTC_AIN_WTR1_AI_FAIL_LO" 14291105 "DTC_AIN_WTR1_AI_FAIL_HI" 14291106 "DTC_AIN_WTR1_AI_OOR_LO" 14291107 "DTC_AIN_WTR1_AI_OOR_HI" 14291120 "DTC_AIN_AIA_FAIL_LO" 14291121 "DTC_AIN_AIA_FAIL_HI" 14291122 "DTC_AIN_AIA_OOR_LO" 14291123 "DTC_AIN_AIA_OOR_HI" 14291136 "DTC_AIN_PROX_AI_FAIL_LO" 14291137 "DTC_AIN_PROX_AI_FAIL_HI" 14291138 "DTC_AIN_PROX_AI_OOR_LO" 14291139 "DTC_AIN_PROX_AI_OOR_HI" 14291152 "DTC_AIN_TWV_FB_FAIL_LO" 14291153 "DTC_AIN_TWV_FB_FAIL_HI" 14291154 "DTC_AIN_TWV_FB_OOR_LO" 14291155 "DTC_AIN_TWV_FB_OOR_HI" 14291168 "DTC_AIN_5V_KA_FAIL_LO" 14291169 "DTC_AIN_5V_KA_FAIL_HI" 14291170 "DTC_AIN_5V_KA_OOR_LO" 14291171 "DTC_AIN_5V_KA_OOR_HI" 14291184 "DTC_AIN_CTR1_LSD_FAIL_LO" 14291185 "DTC_AIN_CTR1_LSD_FAIL_HI" 14291186 "DTC_AIN_CTR1_LSD_OOR_LO" 14291187 "DTC_AIN_CTR1_LSD_OOR_HI" 14291200 "DTC_AIN_CTR2_LSD_FAIL_LO" 14291201 "DTC_AIN_CTR2_LSD_FAIL_HI" 14291202 "DTC_AIN_CTR2_LSD_OOR_LO" 14291203 "DTC_AIN_CTR2_LSD_OOR_HI" 14291216 "DTC_AIN_CTR3_LSD_FAIL_LO" 14291217 "DTC_AIN_CTR3_LSD_FAIL_HI" 14291218 "DTC_AIN_CTR3_LSD_OOR_LO" 14291219 "DTC_AIN_CTR3_LSD_OOR_HI" 14291232 "DTC_AIN_CTR4_LSD_FAIL_LO" 14291233 "DTC_AIN_CTR4_LSD_FAIL_HI" 14291234 "DTC_AIN_CTR4_LSD_OOR_LO" 14291235 "DTC_AIN_CTR4_LSD_OOR_HI" 14291248 "DTC_AIN_CTR5_LSD_FAIL_LO" 14291249 "DTC_AIN_CTR5_LSD_FAIL_HI" 14291250 "DTC_AIN_CTR5_LSD_OOR_LO" 14291251 "DTC_AIN_CTR5_LSD_OOR_HI" 14291264 "DTC_AIN_CTR6_LSD_FAIL_LO" 14291265 "DTC_AIN_CTR6_LSD_FAIL_HI" 14291266 "DTC_AIN_CTR6_LSD_OOR_LO" 14291267 "DTC_AIN_CTR6_LSD_OOR_HI" 14291280 "DTC_AIN_CTR7_LSD_FAIL_LO" 14291281 "DTC_AIN_CTR7_LSD_FAIL_HI" 14291282 "DTC_AIN_CTR7_LSD_OOR_LO" 14291283 "DTC_AIN_CTR7_LSD_OOR_HI" 14291296 "DTC_AIN_CTR_PWR_CUR_FAIL_LO" 14291297 "DTC_AIN_CTR_PWR_CUR_FAIL_HI" 14291298 "DTC_AIN_CTR_PWR_CUR_OOR_LO" 14291299 "DTC_AIN_CTR_PWR_CUR_OOR_HI" 14291312 "DTC_AIN_CTR_HLD_CUR_FAIL_LO" 14291313 "DTC_AIN_CTR_HLD_CUR_FAIL_HI" 14291314 "DTC_AIN_CTR_HLD_CUR_OOR_LO" 14291315 "DTC_AIN_CTR_HLD_CUR_OOR_HI" 13431040 "DTC_CTR_FAULT_LATCH" 13431041 "DTC_CTR_FAULT_INVALID_HEARTBEAT" 13373440 "DTC_CTR1_LSD_FAILED_LO" 13373441 "DTC_CTR1_LSD_FAILED_HI" 13373442 "DTC_CTR1_HSD_FAILED_LO" 13373443 "DTC_CTR1_HSD_FAILED_HI" 13373444 "DTC_CTR1_PULL_IN_SHORT" 13373445 "DTC_CTR1_PULL_IN_OPEN" 13373446 "DTC_CTR1_COIL_INVALID" 13373447 "DTC_CTR1_COIL_OPEN" 13373448 "DTC_CTR1_CIRCUIT_FAILED" 13377536 "DTC_CTR2_LSD_FAILED_LO" 13377537 "DTC_CTR2_LSD_FAILED_HI" 13377538 "DTC_CTR2_HSD_FAILED_LO" 13377539 "DTC_CTR2_HSD_FAILED_HI" 13377540 "DTC_CTR2_PULL_IN_SHORT" 13377541 "DTC_CTR2_PULL_IN_OPEN" 13377542 "DTC_CTR2_COIL_INVALID" 13377543 "DTC_CTR2_COIL_OPEN" 13377544 "DTC_CTR2_CIRCUIT_FAILED" 13381632 "DTC_CTR3_LSD_FAILED_LO" 13381633 "DTC_CTR3_LSD_FAILED_HI" 13381634 "DTC_CTR3_HSD_FAILED_LO" 13381635 "DTC_CTR3_HSD_FAILED_HI" 13381636 "DTC_CTR3_PULL_IN_SHORT" 13381637 "DTC_CTR3_PULL_IN_OPEN" 13381638 "DTC_CTR3_COIL_INVALID" 13381639 "DTC_CTR3_COIL_OPEN" 13381640 "DTC_CTR3_CIRCUIT_FAILED" 13385728 "DTC_CTR4_LSD_FAILED_LO" 13385729 "DTC_CTR4_LSD_FAILED_HI" 13385730 "DTC_CTR4_HSD_FAILED_LO" 13385731 "DTC_CTR4_HSD_FAILED_HI" 13385732 "DTC_CTR4_PULL_IN_SHORT" 13385733 "DTC_CTR4_PULL_IN_OPEN" 13385734 "DTC_CTR4_COIL_INVALID" 13385735 "DTC_CTR4_COIL_OPEN" 13385736 "DTC_CTR4_CIRCUIT_FAILED" 13389824 "DTC_CTR5_LSD_FAILED_LO" 13389825 "DTC_CTR5_LSD_FAILED_HI" 13389826 "DTC_CTR5_HSD_FAILED_LO" 13389827 "DTC_CTR5_HSD_FAILED_HI" 13389828 "DTC_CTR5_PULL_IN_SHORT" 13389829 "DTC_CTR5_PULL_IN_OPEN" 13389830 "DTC_CTR5_COIL_INVALID" 13389831 "DTC_CTR5_COIL_OPEN" 13389832 "DTC_CTR5_CIRCUIT_FAILED" 13393920 "DTC_CTR6_LSD_FAILED_LO" 13393921 "DTC_CTR6_LSD_FAILED_HI" 13393922 "DTC_CTR6_HSD_FAILED_LO" 13393923 "DTC_CTR6_HSD_FAILED_HI" 13393924 "DTC_CTR6_PULL_IN_SHORT" 13393925 "DTC_CTR6_PULL_IN_OPEN" 13393926 "DTC_CTR6_COIL_INVALID" 13393927 "DTC_CTR6_COIL_OPEN" 13393928 "DTC_CTR6_CIRCUIT_FAILED" 13398016 "DTC_CTR7_LSD_FAILED_LO" 13398017 "DTC_CTR7_LSD_FAILED_HI" 13398018 "DTC_CTR7_HSD_FAILED_LO" 13398019 "DTC_CTR7_HSD_FAILED_HI" 13398020 "DTC_CTR7_PULL_IN_SHORT" 13398021 "DTC_CTR7_PULL_IN_OPEN" 13398022 "DTC_CTR7_COIL_INVALID" 13398023 "DTC_CTR7_COIL_OPEN" 13398024 "DTC_CTR7_CIRCUIT_FAILED" 14483456 "DTC_DRV_SW14V_PWR_FAILED_LO" 14483457 "DTC_DRV_SW14V_PWR_FAILED_HI" 14483472 "DTC_DRV_CHRGA_ENA_FAILED_LO" 14483473 "DTC_DRV_CHRGA_ENA_FAILED_HI" 14483488 "DTC_DRV_CHRGB_ENA_FAILED_LO" 14483489 "DTC_DRV_CHRGB_ENA_FAILED_HI" 14483504 "DTC_DRV_LSDA_FAILED_LO" 14483505 "DTC_DRV_LSDA_FAILED_HI" 14483520 "DTC_DRV_LSDB_FAILED_LO" 14483521 "DTC_DRV_LSDB_FAILED_HI" 14483536 "DTC_DRV_HSDA_FAILED_LO" 14483537 "DTC_DRV_HSDA_FAILED_HI" 14483552 "DTC_DRV_HSDB_FAILED_LO" 14483553 "DTC_DRV_HSDB_FAILED_HI" 14553088 "DTC_ICM_FGD1_FAIL_LO" 14553089 "DTC_ICM_FGD1_FAIL_HI" 14553090 "DTC_ICM_FGD1_OOR_LO" 14553091 "DTC_ICM_FGD1_OOR_HI" 14553104 "DTC_ICM_FGD2_FAIL_LO" 14553105 "DTC_ICM_FGD2_FAIL_HI" 14553106 "DTC_ICM_FGD2_OOR_LO" 14553107 "DTC_ICM_FGD2_OOR_HI" 14553120 "DTC_ICM_PILOT_FAIL_LO" 14553121 "DTC_ICM_PILOT_FAIL_HI" 14553122 "DTC_ICM_PILOT_OOR_LO" 14553123 "DTC_ICM_PILOT_OOR_HI" 14553136 "DTC_ICM_MOD_FLT_FAIL_LO" 14553137 "DTC_ICM_MOD_FLT_FAIL_HI" 14553138 "DTC_ICM_MOD_FLT_OOR_LO" 14553139 "DTC_ICM_MOD_FLT_OOR_HI" 14553152 "DTC_ICM_CLK_FAIL_LO" 14553153 "DTC_ICM_CLK_FAIL_HI" 14553154 "DTC_ICM_CLK_OOR_LO" 14553155 "DTC_ICM_CLK_OOR_HI" 14553168 "DTC_ICM_LSD_A_FAIL_LO" 14553169 "DTC_ICM_LSD_A_FAIL_HI" 14553170 "DTC_ICM_LSD_A_OOR_LO" 14553171 "DTC_ICM_LSD_A_OOR_HI" 14553184 "DTC_ICM_LSD_B_FAIL_LO" 14553185 "DTC_ICM_LSD_B_FAIL_HI" 14553186 "DTC_ICM_LSD_B_OOR_LO" 14553187 "DTC_ICM_LSD_B_OOR_HI" 14553200 "DTC_ICM_PWM_A_FAIL_LO" 14553201 "DTC_ICM_PWM_A_FAIL_HI" 14553202 "DTC_ICM_PWM_A_OOR_LO" 14553203 "DTC_ICM_PWM_A_OOR_HI" 14553216 "DTC_ICM_PWM_B_FAIL_LO" 14553217 "DTC_ICM_PWM_B_FAIL_HI" 14553218 "DTC_ICM_PWM_B_OOR_LO" 14553219 "DTC_ICM_PWM_B_OOR_HI" 14553232 "DTC_ICM_PWM_C_FAIL_LO" 14553233 "DTC_ICM_PWM_C_FAIL_HI" 14553234 "DTC_ICM_PWM_C_OOR_LO" 14553235 "DTC_ICM_PWM_C_OOR_HI" 14553248 "DTC_ICM_PWM_D_FAIL_LO" 14553249 "DTC_ICM_PWM_D_FAIL_HI" 14553250 "DTC_ICM_PWM_D_OOR_LO" 14553251 "DTC_ICM_PWM_D_OOR_HI" 14606336 "DTC_NVM_EE_0_COMM_WRITE_TO" 14606337 "DTC_NVM_EE_0_COMM_READ_TO" 14606338 "DTC_NVM_EE_0_WRITE_VERIFY" 14606339 "DTC_NVM_EE_0_READ_VERIFY" 14606340 "DTC_NVM_EE_0_READ_ERR" 14606341 "DTC_NVM_EE_0_WRITE_ERR" 14564800 "DTC_PWM_LSD_A_DC_MISMATCH" 14565344 "DTC_PWM_LSD_A_FREQ_MISMATCH" 14564801 "DTC_PWM_PWM_A_DC_MISMATCH" 14565345 "DTC_PWM_PWM_A_FREQ_MISMATCH" 14564802 "DTC_PWM_PWM_B_DC_MISMATCH" 14565346 "DTC_PWM_PWM_B_FREQ_MISMATCH" 14564803 "DTC_PWM_PWM_C_DC_MISMATCH" 14565347 "DTC_PWM_PWM_C_FREQ_MISMATCH" 14564804 "DTC_PWM_PWM_D_DC_MISMATCH" 14565348 "DTC_PWM_PWM_D_FREQ_MISMATCH" 14417920 "DTC_PWR_WAKEUP_CLK_FAILED" 14417921 "DTC_PWR_WAKEUP_CLK_OOR_LO" 14417922 "DTC_PWR_WAKEUP_CLK_OOR_HI" 14614570 "DTC_SDP_HPWR_OOR_HI" 14614571 "DTC_SDP_HPWR_OOR_LO" 14614572 "DTC_SDP_HPWR_COMM_TO" 14614573 "DTC_SDP_DEVICE_FAILURE";
VAL_ 1120 bcm_dtc_070 0 " - " 11276288 "DTC_VEPO" 11276289 "DTC_HSC_MISSING" 11460608 "DTC_NVM_SOC" 11460609 "DTC_NVM_HYST" 11460610 "DTC_NVM_KOT" 11460611 "DTC_NVM_PERIODIC_SHUTDOWN_TIME" 11460612 "DTC_NVM_WAKE" 11460613 "DTC_NVM_CALENDAR_LIFE" 11460614 "DTC_NVM_CYCLE_LIFE" 11460615 "DTC_NVM_DTC" 11460616 "DTC_NVM_APP_SCRATCHPAD" 11517962 "DTC_LOOPTIME_TASK_A" 11517963 "DTC_LOOPTIME_TASK_B" 11517964 "DTC_LOOPTIME_TASK_C" 11517965 "DTC_LOOPTIME_TASK_D" 11517966 "DTC_LOOPTIME_TASK_E" 11517967 "DTC_ILIM_MAX_DISCHARGE" 15728640 "DTC_EPO" 16171008 "DTC_CONT_OPEN" 16171009 "DTC_CONT_CLOSE" 16171010 "DTC_CONT_OPEN_CURRENT" 16171264 "DTC_CONT_CLOSE_ON_RESET" 16171265 "DTC_CONT_CLOSE_SIG_FAILED" 16171520 "DTC_PRECHARGE_TIMEOUT" 16171777 "DTC_CONT_NEG_WELD_AT_SU" 16171778 "DTC_CONT_POS_A_WELD_AT_SU" 16171779 "DTC_CONT_POS_B_WELD_AT_SU" 16172033 "DTC_CONT_NEG_WELD_AT_SD" 16172034 "DTC_CONT_POS_A_WELD_AT_SD" 16172036 "DTC_CONT_POS_B_WELD_AT_SD" 16172289 "DTC_CONT_NEG_OPEN" 16172290 "DTC_CONT_POS_A_OPEN" 16172291 "DTC_CONT_POS_B_OPEN" 16172545 "DTC_CONT_NEG_VDIF" 16172546 "DTC_CONT_POS_A_VDIF" 16172548 "DTC_CONT_POS_B_VDIF" 16174848 "DTC_HVIL" 16174849 "DTC_LVBAT_LO" 16174850 "DTC_LVBAT_HI" 16174851 "DTC_LVBAT_ERR" 16522240 "DTC_CSM_MISSING" 16522752 "DTC_CSM_VBAT" 16522753 "DTC_CSM_VPOS" 16522754 "DTC_CSM_VNEG" 16522755 "DTC_CSM_CPOS" 16522756 "DTC_CSM_CNEG" 16522757 "DTC_CSM_APOS" 16522758 "DTC_CSM_ANEG" 16522759 "DTC_CSM_FUSE_HI" 16522760 "DTC_CSM_FUSE_LO" 16521728 "DTC_CSM_ASIC" 16521729 "DTC_CSM_AILO" 16521730 "DTC_CSM_AIHI" 16520957 "DTC_LEAKAGE_DETECT_FAULT" 16522444 "DTC_REALTIMECLOCK_FAULT" 16520945 "DTC_CSM_LEAK_FAIL_CALC" 16520946 "DTC_CSM_LEAK_FAIL_HW" 16520947 "DTC_CSM_LEAK_EXT_SHORT" 16520948 "DTC_CSM_LEAK_MID_PACK_SHORT" 16520949 "DTC_CSM_LEAK_ERROR" 16520950 "DTC_CSM_LEAK_UNKNOWN" 16523008 "DTC_CSM_VER_MISMATCH" 16523009 "DTC_CSM_DTC_SET" 16523010 "DTC_CSM_CAL_FAULT" 16496320 "DTC_MBB_TOO_FEW" 16496321 "DTC_MBB_TOO_MANY" 16496352 "DTC_CELL_VMAX_ERR" 16496353 "DTC_CELL_VMIN_ERR" 16496354 "DTC_CELL_VMAX" 16496362 "DTC_CELL_VMAX_SEVERE" 16496355 "DTC_CELL_VMIN" 16496363 "DTC_CELL_VMIN_SEVERE" 16496356 "DTC_MOD_VOLTAGE_COMPARE" 16496336 "DTC_CELL_T_ERR" 16496337 "DTC_CELL_TMAX1" 16496338 "DTC_CELL_TMAX2" 16496339 "DTC_CELL_TMIN" 16497665 "DTC_MBB_01_MISSING" 16497666 "DTC_MBB_02_MISSING" 16497667 "DTC_MBB_03_MISSING" 16497668 "DTC_MBB_04_MISSING" 16497669 "DTC_MBB_05_MISSING" 16497670 "DTC_MBB_06_MISSING" 16497671 "DTC_MBB_07_MISSING" 16497672 "DTC_MBB_08_MISSING" 16497673 "DTC_MBB_09_MISSING" 16497680 "DTC_MBB_10_MISSING" 16497681 "DTC_MBB_11_MISSING" 16497682 "DTC_MBB_12_MISSING" 16497683 "DTC_MBB_13_MISSING" 16497684 "DTC_MBB_14_MISSING" 16497685 "DTC_MBB_15_MISSING" 16497686 "DTC_MBB_16_MISSING" 16497687 "DTC_MBB_17_MISSING" 16497688 "DTC_MBB_18_MISSING" 16497689 "DTC_MBB_19_MISSING" 16497696 "DTC_MBB_20_MISSING" 16497697 "DTC_MBB_21_MISSING" 16497698 "DTC_MBB_22_MISSING" 16497699 "DTC_MBB_23_MISSING" 16497700 "DTC_MBB_24_MISSING" 16498177 "DTC_MBB_01_VFAULT" 16498178 "DTC_MBB_02_VFAULT" 16498179 "DTC_MBB_03_VFAULT" 16498180 "DTC_MBB_04_VFAULT" 16498181 "DTC_MBB_05_VFAULT" 16498182 "DTC_MBB_06_VFAULT" 16498183 "DTC_MBB_07_VFAULT" 16498184 "DTC_MBB_08_VFAULT" 16498185 "DTC_MBB_09_VFAULT" 16498192 "DTC_MBB_10_VFAULT" 16498193 "DTC_MBB_11_VFAULT" 16498194 "DTC_MBB_12_VFAULT" 16498195 "DTC_MBB_13_VFAULT" 16498196 "DTC_MBB_14_VFAULT" 16498197 "DTC_MBB_15_VFAULT" 16498198 "DTC_MBB_16_VFAULT" 16498199 "DTC_MBB_17_VFAULT" 16498200 "DTC_MBB_18_VFAULT" 16498201 "DTC_MBB_19_VFAULT" 16498208 "DTC_MBB_20_VFAULT" 16498209 "DTC_MBB_21_VFAULT" 16498210 "DTC_MBB_22_VFAULT" 16498211 "DTC_MBB_23_VFAULT" 16498212 "DTC_MBB_24_VFAULT" 16497921 "DTC_MBB_01_TFAULT" 16497922 "DTC_MBB_02_TFAULT" 16497923 "DTC_MBB_03_TFAULT" 16497924 "DTC_MBB_04_TFAULT" 16497925 "DTC_MBB_05_TFAULT" 16497926 "DTC_MBB_06_TFAULT" 16497927 "DTC_MBB_07_TFAULT" 16497928 "DTC_MBB_08_TFAULT" 16497929 "DTC_MBB_09_TFAULT" 16497936 "DTC_MBB_10_TFAULT" 16497937 "DTC_MBB_11_TFAULT" 16497938 "DTC_MBB_12_TFAULT" 16497939 "DTC_MBB_13_TFAULT" 16497940 "DTC_MBB_14_TFAULT" 16497941 "DTC_MBB_15_TFAULT" 16497942 "DTC_MBB_16_TFAULT" 16497943 "DTC_MBB_17_TFAULT" 16497944 "DTC_MBB_18_TFAULT" 16497945 "DTC_MBB_19_TFAULT" 16497952 "DTC_MBB_20_TFAULT" 16497953 "DTC_MBB_21_TFAULT" 16497954 "DTC_MBB_22_TFAULT" 16497955 "DTC_MBB_23_TFAULT" 16497956 "DTC_MBB_24_TFAULT" 16498688 "DTC_BRUSA_MISSING" 16498689 "DTC_BRUSA_IDC" 16498690 "DTC_BRUSA_REQ_VS_CMD" 16560128 "DTC_IBAT_MISMATCH" 16576512 "DTC_DIS_MAX_I2T" 16576513 "DTC_CHG_MAX_I2T" 16576768 "DTC_DIS_WARNING_I2T" 16576769 "DTC_CHG_WARNING_I2T" 16523520 "DTC_LEM_A_OOR_HI" 16523521 "DTC_LEM_A_OOR_LO" 16523522 "DTC_LEM_A_FAULT" 16523776 "DTC_LEM_B_OOR_HI" 16523777 "DTC_LEM_B_OOR_LO" 16523778 "DTC_LEM_B_FAULT" 16506880 "DTC_VBAT_MISMATCH" 16506881 "DTC_VBAT_VMAX" 16506882 "DTC_VBAT_VMIN" 16506883 "DTC_PACK_FUSE_A" 16506884 "DTC_PACK_FUSE_B" 16252928 "DTC_KEY_OFF_TIME_ERROR" 16252929 "DTC_PERIODIC_OFF_TIME_ERROR" 14290944 "DTC_AIN_BPWR_FAIL_LO" 14290945 "DTC_AIN_BPWR_FAIL_HI" 14290946 "DTC_AIN_BPWR_OOR_LO" 14290947 "DTC_AIN_BPWR_OOR_HI" 14290960 "DTC_AIN_14V_FAIL_LO" 14290961 "DTC_AIN_14V_FAIL_HI" 14290962 "DTC_AIN_14V_OOR_LO" 14290963 "DTC_AIN_14V_OOR_HI" 14290976 "DTC_AIN_HPWR_FAIL_LO" 14290977 "DTC_AIN_HPWR_FAIL_HI" 14290978 "DTC_AIN_HPWR_OOR_LO" 14290979 "DTC_AIN_HPWR_OOR_HI" 14290992 "DTC_AIN_6V_FAIL_LO" 14290993 "DTC_AIN_6V_FAIL_HI" 14290994 "DTC_AIN_6V_OOR_LO" 14290995 "DTC_AIN_6V_OOR_HI" 14291008 "DTC_AIN_HVIL_FAIL_LO" 14291009 "DTC_AIN_HVIL_FAIL_HI" 14291010 "DTC_AIN_HVIL_OOR_LO" 14291011 "DTC_AIN_HVIL_OOR_HI" 14291024 "DTC_AIN_5V_PWR_FAIL_LO" 14291025 "DTC_AIN_5V_PWR_FAIL_HI" 14291026 "DTC_AIN_5V_PWR_OOR_LO" 14291027 "DTC_AIN_5V_PWR_OOR_HI" 14291040 "DTC_AIN_LEM_HI_FAIL_LO" 14291041 "DTC_AIN_LEM_HI_FAIL_HI" 14291042 "DTC_AIN_LEM_HI_OOR_LO" 14291043 "DTC_AIN_LEM_HI_OOR_HI" 14291056 "DTC_AIN_LEM_LO_FAIL_LO" 14291057 "DTC_AIN_LEM_LO_FAIL_HI" 14291058 "DTC_AIN_LEM_LO_OOR_LO" 14291059 "DTC_AIN_LEM_LO_OOR_HI" 14291072 "DTC_AIN_BCT_AI_FAIL_LO" 14291073 "DTC_AIN_BCT_AI_FAIL_HI" 14291074 "DTC_AIN_BCT_AI_OOR_LO" 14291075 "DTC_AIN_BCT_AI_OOR_HI" 14291088 "DTC_AIN_WTR2_AI_FAIL_LO" 14291089 "DTC_AIN_WTR2_AI_FAIL_HI" 14291090 "DTC_AIN_WTR2_AI_OOR_LO" 14291091 "DTC_AIN_WTR2_AI_OOR_HI" 14291104 "DTC_AIN_WTR1_AI_FAIL_LO" 14291105 "DTC_AIN_WTR1_AI_FAIL_HI" 14291106 "DTC_AIN_WTR1_AI_OOR_LO" 14291107 "DTC_AIN_WTR1_AI_OOR_HI" 14291120 "DTC_AIN_AIA_FAIL_LO" 14291121 "DTC_AIN_AIA_FAIL_HI" 14291122 "DTC_AIN_AIA_OOR_LO" 14291123 "DTC_AIN_AIA_OOR_HI" 14291136 "DTC_AIN_PROX_AI_FAIL_LO" 14291137 "DTC_AIN_PROX_AI_FAIL_HI" 14291138 "DTC_AIN_PROX_AI_OOR_LO" 14291139 "DTC_AIN_PROX_AI_OOR_HI" 14291152 "DTC_AIN_TWV_FB_FAIL_LO" 14291153 "DTC_AIN_TWV_FB_FAIL_HI" 14291154 "DTC_AIN_TWV_FB_OOR_LO" 14291155 "DTC_AIN_TWV_FB_OOR_HI" 14291168 "DTC_AIN_5V_KA_FAIL_LO" 14291169 "DTC_AIN_5V_KA_FAIL_HI" 14291170 "DTC_AIN_5V_KA_OOR_LO" 14291171 "DTC_AIN_5V_KA_OOR_HI" 14291184 "DTC_AIN_CTR1_LSD_FAIL_LO" 14291185 "DTC_AIN_CTR1_LSD_FAIL_HI" 14291186 "DTC_AIN_CTR1_LSD_OOR_LO" 14291187 "DTC_AIN_CTR1_LSD_OOR_HI" 14291200 "DTC_AIN_CTR2_LSD_FAIL_LO" 14291201 "DTC_AIN_CTR2_LSD_FAIL_HI" 14291202 "DTC_AIN_CTR2_LSD_OOR_LO" 14291203 "DTC_AIN_CTR2_LSD_OOR_HI" 14291216 "DTC_AIN_CTR3_LSD_FAIL_LO" 14291217 "DTC_AIN_CTR3_LSD_FAIL_HI" 14291218 "DTC_AIN_CTR3_LSD_OOR_LO" 14291219 "DTC_AIN_CTR3_LSD_OOR_HI" 14291232 "DTC_AIN_CTR4_LSD_FAIL_LO" 14291233 "DTC_AIN_CTR4_LSD_FAIL_HI" 14291234 "DTC_AIN_CTR4_LSD_OOR_LO" 14291235 "DTC_AIN_CTR4_LSD_OOR_HI" 14291248 "DTC_AIN_CTR5_LSD_FAIL_LO" 14291249 "DTC_AIN_CTR5_LSD_FAIL_HI" 14291250 "DTC_AIN_CTR5_LSD_OOR_LO" 14291251 "DTC_AIN_CTR5_LSD_OOR_HI" 14291264 "DTC_AIN_CTR6_LSD_FAIL_LO" 14291265 "DTC_AIN_CTR6_LSD_FAIL_HI" 14291266 "DTC_AIN_CTR6_LSD_OOR_LO" 14291267 "DTC_AIN_CTR6_LSD_OOR_HI" 14291280 "DTC_AIN_CTR7_LSD_FAIL_LO" 14291281 "DTC_AIN_CTR7_LSD_FAIL_HI" 14291282 "DTC_AIN_CTR7_LSD_OOR_LO" 14291283 "DTC_AIN_CTR7_LSD_OOR_HI" 14291296 "DTC_AIN_CTR_PWR_CUR_FAIL_LO" 14291297 "DTC_AIN_CTR_PWR_CUR_FAIL_HI" 14291298 "DTC_AIN_CTR_PWR_CUR_OOR_LO" 14291299 "DTC_AIN_CTR_PWR_CUR_OOR_HI" 14291312 "DTC_AIN_CTR_HLD_CUR_FAIL_LO" 14291313 "DTC_AIN_CTR_HLD_CUR_FAIL_HI" 14291314 "DTC_AIN_CTR_HLD_CUR_OOR_LO" 14291315 "DTC_AIN_CTR_HLD_CUR_OOR_HI" 13431040 "DTC_CTR_FAULT_LATCH" 13431041 "DTC_CTR_FAULT_INVALID_HEARTBEAT" 13373440 "DTC_CTR1_LSD_FAILED_LO" 13373441 "DTC_CTR1_LSD_FAILED_HI" 13373442 "DTC_CTR1_HSD_FAILED_LO" 13373443 "DTC_CTR1_HSD_FAILED_HI" 13373444 "DTC_CTR1_PULL_IN_SHORT" 13373445 "DTC_CTR1_PULL_IN_OPEN" 13373446 "DTC_CTR1_COIL_INVALID" 13373447 "DTC_CTR1_COIL_OPEN" 13373448 "DTC_CTR1_CIRCUIT_FAILED" 13377536 "DTC_CTR2_LSD_FAILED_LO" 13377537 "DTC_CTR2_LSD_FAILED_HI" 13377538 "DTC_CTR2_HSD_FAILED_LO" 13377539 "DTC_CTR2_HSD_FAILED_HI" 13377540 "DTC_CTR2_PULL_IN_SHORT" 13377541 "DTC_CTR2_PULL_IN_OPEN" 13377542 "DTC_CTR2_COIL_INVALID" 13377543 "DTC_CTR2_COIL_OPEN" 13377544 "DTC_CTR2_CIRCUIT_FAILED" 13381632 "DTC_CTR3_LSD_FAILED_LO" 13381633 "DTC_CTR3_LSD_FAILED_HI" 13381634 "DTC_CTR3_HSD_FAILED_LO" 13381635 "DTC_CTR3_HSD_FAILED_HI" 13381636 "DTC_CTR3_PULL_IN_SHORT" 13381637 "DTC_CTR3_PULL_IN_OPEN" 13381638 "DTC_CTR3_COIL_INVALID" 13381639 "DTC_CTR3_COIL_OPEN" 13381640 "DTC_CTR3_CIRCUIT_FAILED" 13385728 "DTC_CTR4_LSD_FAILED_LO" 13385729 "DTC_CTR4_LSD_FAILED_HI" 13385730 "DTC_CTR4_HSD_FAILED_LO" 13385731 "DTC_CTR4_HSD_FAILED_HI" 13385732 "DTC_CTR4_PULL_IN_SHORT" 13385733 "DTC_CTR4_PULL_IN_OPEN" 13385734 "DTC_CTR4_COIL_INVALID" 13385735 "DTC_CTR4_COIL_OPEN" 13385736 "DTC_CTR4_CIRCUIT_FAILED" 13389824 "DTC_CTR5_LSD_FAILED_LO" 13389825 "DTC_CTR5_LSD_FAILED_HI" 13389826 "DTC_CTR5_HSD_FAILED_LO" 13389827 "DTC_CTR5_HSD_FAILED_HI" 13389828 "DTC_CTR5_PULL_IN_SHORT" 13389829 "DTC_CTR5_PULL_IN_OPEN" 13389830 "DTC_CTR5_COIL_INVALID" 13389831 "DTC_CTR5_COIL_OPEN" 13389832 "DTC_CTR5_CIRCUIT_FAILED" 13393920 "DTC_CTR6_LSD_FAILED_LO" 13393921 "DTC_CTR6_LSD_FAILED_HI" 13393922 "DTC_CTR6_HSD_FAILED_LO" 13393923 "DTC_CTR6_HSD_FAILED_HI" 13393924 "DTC_CTR6_PULL_IN_SHORT" 13393925 "DTC_CTR6_PULL_IN_OPEN" 13393926 "DTC_CTR6_COIL_INVALID" 13393927 "DTC_CTR6_COIL_OPEN" 13393928 "DTC_CTR6_CIRCUIT_FAILED" 13398016 "DTC_CTR7_LSD_FAILED_LO" 13398017 "DTC_CTR7_LSD_FAILED_HI" 13398018 "DTC_CTR7_HSD_FAILED_LO" 13398019 "DTC_CTR7_HSD_FAILED_HI" 13398020 "DTC_CTR7_PULL_IN_SHORT" 13398021 "DTC_CTR7_PULL_IN_OPEN" 13398022 "DTC_CTR7_COIL_INVALID" 13398023 "DTC_CTR7_COIL_OPEN" 13398024 "DTC_CTR7_CIRCUIT_FAILED" 14483456 "DTC_DRV_SW14V_PWR_FAILED_LO" 14483457 "DTC_DRV_SW14V_PWR_FAILED_HI" 14483472 "DTC_DRV_CHRGA_ENA_FAILED_LO" 14483473 "DTC_DRV_CHRGA_ENA_FAILED_HI" 14483488 "DTC_DRV_CHRGB_ENA_FAILED_LO" 14483489 "DTC_DRV_CHRGB_ENA_FAILED_HI" 14483504 "DTC_DRV_LSDA_FAILED_LO" 14483505 "DTC_DRV_LSDA_FAILED_HI" 14483520 "DTC_DRV_LSDB_FAILED_LO" 14483521 "DTC_DRV_LSDB_FAILED_HI" 14483536 "DTC_DRV_HSDA_FAILED_LO" 14483537 "DTC_DRV_HSDA_FAILED_HI" 14483552 "DTC_DRV_HSDB_FAILED_LO" 14483553 "DTC_DRV_HSDB_FAILED_HI" 14553088 "DTC_ICM_FGD1_FAIL_LO" 14553089 "DTC_ICM_FGD1_FAIL_HI" 14553090 "DTC_ICM_FGD1_OOR_LO" 14553091 "DTC_ICM_FGD1_OOR_HI" 14553104 "DTC_ICM_FGD2_FAIL_LO" 14553105 "DTC_ICM_FGD2_FAIL_HI" 14553106 "DTC_ICM_FGD2_OOR_LO" 14553107 "DTC_ICM_FGD2_OOR_HI" 14553120 "DTC_ICM_PILOT_FAIL_LO" 14553121 "DTC_ICM_PILOT_FAIL_HI" 14553122 "DTC_ICM_PILOT_OOR_LO" 14553123 "DTC_ICM_PILOT_OOR_HI" 14553136 "DTC_ICM_MOD_FLT_FAIL_LO" 14553137 "DTC_ICM_MOD_FLT_FAIL_HI" 14553138 "DTC_ICM_MOD_FLT_OOR_LO" 14553139 "DTC_ICM_MOD_FLT_OOR_HI" 14553152 "DTC_ICM_CLK_FAIL_LO" 14553153 "DTC_ICM_CLK_FAIL_HI" 14553154 "DTC_ICM_CLK_OOR_LO" 14553155 "DTC_ICM_CLK_OOR_HI" 14553168 "DTC_ICM_LSD_A_FAIL_LO" 14553169 "DTC_ICM_LSD_A_FAIL_HI" 14553170 "DTC_ICM_LSD_A_OOR_LO" 14553171 "DTC_ICM_LSD_A_OOR_HI" 14553184 "DTC_ICM_LSD_B_FAIL_LO" 14553185 "DTC_ICM_LSD_B_FAIL_HI" 14553186 "DTC_ICM_LSD_B_OOR_LO" 14553187 "DTC_ICM_LSD_B_OOR_HI" 14553200 "DTC_ICM_PWM_A_FAIL_LO" 14553201 "DTC_ICM_PWM_A_FAIL_HI" 14553202 "DTC_ICM_PWM_A_OOR_LO" 14553203 "DTC_ICM_PWM_A_OOR_HI" 14553216 "DTC_ICM_PWM_B_FAIL_LO" 14553217 "DTC_ICM_PWM_B_FAIL_HI" 14553218 "DTC_ICM_PWM_B_OOR_LO" 14553219 "DTC_ICM_PWM_B_OOR_HI" 14553232 "DTC_ICM_PWM_C_FAIL_LO" 14553233 "DTC_ICM_PWM_C_FAIL_HI" 14553234 "DTC_ICM_PWM_C_OOR_LO" 14553235 "DTC_ICM_PWM_C_OOR_HI" 14553248 "DTC_ICM_PWM_D_FAIL_LO" 14553249 "DTC_ICM_PWM_D_FAIL_HI" 14553250 "DTC_ICM_PWM_D_OOR_LO" 14553251 "DTC_ICM_PWM_D_OOR_HI" 14606336 "DTC_NVM_EE_0_COMM_WRITE_TO" 14606337 "DTC_NVM_EE_0_COMM_READ_TO" 14606338 "DTC_NVM_EE_0_WRITE_VERIFY" 14606339 "DTC_NVM_EE_0_READ_VERIFY" 14606340 "DTC_NVM_EE_0_READ_ERR" 14606341 "DTC_NVM_EE_0_WRITE_ERR" 14564800 "DTC_PWM_LSD_A_DC_MISMATCH" 14565344 "DTC_PWM_LSD_A_FREQ_MISMATCH" 14564801 "DTC_PWM_PWM_A_DC_MISMATCH" 14565345 "DTC_PWM_PWM_A_FREQ_MISMATCH" 14564802 "DTC_PWM_PWM_B_DC_MISMATCH" 14565346 "DTC_PWM_PWM_B_FREQ_MISMATCH" 14564803 "DTC_PWM_PWM_C_DC_MISMATCH" 14565347 "DTC_PWM_PWM_C_FREQ_MISMATCH" 14564804 "DTC_PWM_PWM_D_DC_MISMATCH" 14565348 "DTC_PWM_PWM_D_FREQ_MISMATCH" 14417920 "DTC_PWR_WAKEUP_CLK_FAILED" 14417921 "DTC_PWR_WAKEUP_CLK_OOR_LO" 14417922 "DTC_PWR_WAKEUP_CLK_OOR_HI" 14614570 "DTC_SDP_HPWR_OOR_HI" 14614571 "DTC_SDP_HPWR_OOR_LO" 14614572 "DTC_SDP_HPWR_COMM_TO" 14614573 "DTC_SDP_DEVICE_FAILURE";
VAL_ 1120 bcm_dtc_071 0 " - " 11276288 "DTC_VEPO" 11276289 "DTC_HSC_MISSING" 11460608 "DTC_NVM_SOC" 11460609 "DTC_NVM_HYST" 11460610 "DTC_NVM_KOT" 11460611 "DTC_NVM_PERIODIC_SHUTDOWN_TIME" 11460612 "DTC_NVM_WAKE" 11460613 "DTC_NVM_CALENDAR_LIFE" 11460614 "DTC_NVM_CYCLE_LIFE" 11460615 "DTC_NVM_DTC" 11460616 "DTC_NVM_APP_SCRATCHPAD" 11517962 "DTC_LOOPTIME_TASK_A" 11517963 "DTC_LOOPTIME_TASK_B" 11517964 "DTC_LOOPTIME_TASK_C" 11517965 "DTC_LOOPTIME_TASK_D" 11517966 "DTC_LOOPTIME_TASK_E" 11517967 "DTC_ILIM_MAX_DISCHARGE" 15728640 "DTC_EPO" 16171008 "DTC_CONT_OPEN" 16171009 "DTC_CONT_CLOSE" 16171010 "DTC_CONT_OPEN_CURRENT" 16171264 "DTC_CONT_CLOSE_ON_RESET" 16171265 "DTC_CONT_CLOSE_SIG_FAILED" 16171520 "DTC_PRECHARGE_TIMEOUT" 16171777 "DTC_CONT_NEG_WELD_AT_SU" 16171778 "DTC_CONT_POS_A_WELD_AT_SU" 16171779 "DTC_CONT_POS_B_WELD_AT_SU" 16172033 "DTC_CONT_NEG_WELD_AT_SD" 16172034 "DTC_CONT_POS_A_WELD_AT_SD" 16172036 "DTC_CONT_POS_B_WELD_AT_SD" 16172289 "DTC_CONT_NEG_OPEN" 16172290 "DTC_CONT_POS_A_OPEN" 16172291 "DTC_CONT_POS_B_OPEN" 16172545 "DTC_CONT_NEG_VDIF" 16172546 "DTC_CONT_POS_A_VDIF" 16172548 "DTC_CONT_POS_B_VDIF" 16174848 "DTC_HVIL" 16174849 "DTC_LVBAT_LO" 16174850 "DTC_LVBAT_HI" 16174851 "DTC_LVBAT_ERR" 16522240 "DTC_CSM_MISSING" 16522752 "DTC_CSM_VBAT" 16522753 "DTC_CSM_VPOS" 16522754 "DTC_CSM_VNEG" 16522755 "DTC_CSM_CPOS" 16522756 "DTC_CSM_CNEG" 16522757 "DTC_CSM_APOS" 16522758 "DTC_CSM_ANEG" 16522759 "DTC_CSM_FUSE_HI" 16522760 "DTC_CSM_FUSE_LO" 16521728 "DTC_CSM_ASIC" 16521729 "DTC_CSM_AILO" 16521730 "DTC_CSM_AIHI" 16520957 "DTC_LEAKAGE_DETECT_FAULT" 16522444 "DTC_REALTIMECLOCK_FAULT" 16520945 "DTC_CSM_LEAK_FAIL_CALC" 16520946 "DTC_CSM_LEAK_FAIL_HW" 16520947 "DTC_CSM_LEAK_EXT_SHORT" 16520948 "DTC_CSM_LEAK_MID_PACK_SHORT" 16520949 "DTC_CSM_LEAK_ERROR" 16520950 "DTC_CSM_LEAK_UNKNOWN" 16523008 "DTC_CSM_VER_MISMATCH" 16523009 "DTC_CSM_DTC_SET" 16523010 "DTC_CSM_CAL_FAULT" 16496320 "DTC_MBB_TOO_FEW" 16496321 "DTC_MBB_TOO_MANY" 16496352 "DTC_CELL_VMAX_ERR" 16496353 "DTC_CELL_VMIN_ERR" 16496354 "DTC_CELL_VMAX" 16496362 "DTC_CELL_VMAX_SEVERE" 16496355 "DTC_CELL_VMIN" 16496363 "DTC_CELL_VMIN_SEVERE" 16496356 "DTC_MOD_VOLTAGE_COMPARE" 16496336 "DTC_CELL_T_ERR" 16496337 "DTC_CELL_TMAX1" 16496338 "DTC_CELL_TMAX2" 16496339 "DTC_CELL_TMIN" 16497665 "DTC_MBB_01_MISSING" 16497666 "DTC_MBB_02_MISSING" 16497667 "DTC_MBB_03_MISSING" 16497668 "DTC_MBB_04_MISSING" 16497669 "DTC_MBB_05_MISSING" 16497670 "DTC_MBB_06_MISSING" 16497671 "DTC_MBB_07_MISSING" 16497672 "DTC_MBB_08_MISSING" 16497673 "DTC_MBB_09_MISSING" 16497680 "DTC_MBB_10_MISSING" 16497681 "DTC_MBB_11_MISSING" 16497682 "DTC_MBB_12_MISSING" 16497683 "DTC_MBB_13_MISSING" 16497684 "DTC_MBB_14_MISSING" 16497685 "DTC_MBB_15_MISSING" 16497686 "DTC_MBB_16_MISSING" 16497687 "DTC_MBB_17_MISSING" 16497688 "DTC_MBB_18_MISSING" 16497689 "DTC_MBB_19_MISSING" 16497696 "DTC_MBB_20_MISSING" 16497697 "DTC_MBB_21_MISSING" 16497698 "DTC_MBB_22_MISSING" 16497699 "DTC_MBB_23_MISSING" 16497700 "DTC_MBB_24_MISSING" 16498177 "DTC_MBB_01_VFAULT" 16498178 "DTC_MBB_02_VFAULT" 16498179 "DTC_MBB_03_VFAULT" 16498180 "DTC_MBB_04_VFAULT" 16498181 "DTC_MBB_05_VFAULT" 16498182 "DTC_MBB_06_VFAULT" 16498183 "DTC_MBB_07_VFAULT" 16498184 "DTC_MBB_08_VFAULT" 16498185 "DTC_MBB_09_VFAULT" 16498192 "DTC_MBB_10_VFAULT" 16498193 "DTC_MBB_11_VFAULT" 16498194 "DTC_MBB_12_VFAULT" 16498195 "DTC_MBB_13_VFAULT" 16498196 "DTC_MBB_14_VFAULT" 16498197 "DTC_MBB_15_VFAULT" 16498198 "DTC_MBB_16_VFAULT" 16498199 "DTC_MBB_17_VFAULT" 16498200 "DTC_MBB_18_VFAULT" 16498201 "DTC_MBB_19_VFAULT" 16498208 "DTC_MBB_20_VFAULT" 16498209 "DTC_MBB_21_VFAULT" 16498210 "DTC_MBB_22_VFAULT" 16498211 "DTC_MBB_23_VFAULT" 16498212 "DTC_MBB_24_VFAULT" 16497921 "DTC_MBB_01_TFAULT" 16497922 "DTC_MBB_02_TFAULT" 16497923 "DTC_MBB_03_TFAULT" 16497924 "DTC_MBB_04_TFAULT" 16497925 "DTC_MBB_05_TFAULT" 16497926 "DTC_MBB_06_TFAULT" 16497927 "DTC_MBB_07_TFAULT" 16497928 "DTC_MBB_08_TFAULT" 16497929 "DTC_MBB_09_TFAULT" 16497936 "DTC_MBB_10_TFAULT" 16497937 "DTC_MBB_11_TFAULT" 16497938 "DTC_MBB_12_TFAULT" 16497939 "DTC_MBB_13_TFAULT" 16497940 "DTC_MBB_14_TFAULT" 16497941 "DTC_MBB_15_TFAULT" 16497942 "DTC_MBB_16_TFAULT" 16497943 "DTC_MBB_17_TFAULT" 16497944 "DTC_MBB_18_TFAULT" 16497945 "DTC_MBB_19_TFAULT" 16497952 "DTC_MBB_20_TFAULT" 16497953 "DTC_MBB_21_TFAULT" 16497954 "DTC_MBB_22_TFAULT" 16497955 "DTC_MBB_23_TFAULT" 16497956 "DTC_MBB_24_TFAULT" 16498688 "DTC_BRUSA_MISSING" 16498689 "DTC_BRUSA_IDC" 16498690 "DTC_BRUSA_REQ_VS_CMD" 16560128 "DTC_IBAT_MISMATCH" 16576512 "DTC_DIS_MAX_I2T" 16576513 "DTC_CHG_MAX_I2T" 16576768 "DTC_DIS_WARNING_I2T" 16576769 "DTC_CHG_WARNING_I2T" 16523520 "DTC_LEM_A_OOR_HI" 16523521 "DTC_LEM_A_OOR_LO" 16523522 "DTC_LEM_A_FAULT" 16523776 "DTC_LEM_B_OOR_HI" 16523777 "DTC_LEM_B_OOR_LO" 16523778 "DTC_LEM_B_FAULT" 16506880 "DTC_VBAT_MISMATCH" 16506881 "DTC_VBAT_VMAX" 16506882 "DTC_VBAT_VMIN" 16506883 "DTC_PACK_FUSE_A" 16506884 "DTC_PACK_FUSE_B" 16252928 "DTC_KEY_OFF_TIME_ERROR" 16252929 "DTC_PERIODIC_OFF_TIME_ERROR" 14290944 "DTC_AIN_BPWR_FAIL_LO" 14290945 "DTC_AIN_BPWR_FAIL_HI" 14290946 "DTC_AIN_BPWR_OOR_LO" 14290947 "DTC_AIN_BPWR_OOR_HI" 14290960 "DTC_AIN_14V_FAIL_LO" 14290961 "DTC_AIN_14V_FAIL_HI" 14290962 "DTC_AIN_14V_OOR_LO" 14290963 "DTC_AIN_14V_OOR_HI" 14290976 "DTC_AIN_HPWR_FAIL_LO" 14290977 "DTC_AIN_HPWR_FAIL_HI" 14290978 "DTC_AIN_HPWR_OOR_LO" 14290979 "DTC_AIN_HPWR_OOR_HI" 14290992 "DTC_AIN_6V_FAIL_LO" 14290993 "DTC_AIN_6V_FAIL_HI" 14290994 "DTC_AIN_6V_OOR_LO" 14290995 "DTC_AIN_6V_OOR_HI" 14291008 "DTC_AIN_HVIL_FAIL_LO" 14291009 "DTC_AIN_HVIL_FAIL_HI" 14291010 "DTC_AIN_HVIL_OOR_LO" 14291011 "DTC_AIN_HVIL_OOR_HI" 14291024 "DTC_AIN_5V_PWR_FAIL_LO" 14291025 "DTC_AIN_5V_PWR_FAIL_HI" 14291026 "DTC_AIN_5V_PWR_OOR_LO" 14291027 "DTC_AIN_5V_PWR_OOR_HI" 14291040 "DTC_AIN_LEM_HI_FAIL_LO" 14291041 "DTC_AIN_LEM_HI_FAIL_HI" 14291042 "DTC_AIN_LEM_HI_OOR_LO" 14291043 "DTC_AIN_LEM_HI_OOR_HI" 14291056 "DTC_AIN_LEM_LO_FAIL_LO" 14291057 "DTC_AIN_LEM_LO_FAIL_HI" 14291058 "DTC_AIN_LEM_LO_OOR_LO" 14291059 "DTC_AIN_LEM_LO_OOR_HI" 14291072 "DTC_AIN_BCT_AI_FAIL_LO" 14291073 "DTC_AIN_BCT_AI_FAIL_HI" 14291074 "DTC_AIN_BCT_AI_OOR_LO" 14291075 "DTC_AIN_BCT_AI_OOR_HI" 14291088 "DTC_AIN_WTR2_AI_FAIL_LO" 14291089 "DTC_AIN_WTR2_AI_FAIL_HI" 14291090 "DTC_AIN_WTR2_AI_OOR_LO" 14291091 "DTC_AIN_WTR2_AI_OOR_HI" 14291104 "DTC_AIN_WTR1_AI_FAIL_LO" 14291105 "DTC_AIN_WTR1_AI_FAIL_HI" 14291106 "DTC_AIN_WTR1_AI_OOR_LO" 14291107 "DTC_AIN_WTR1_AI_OOR_HI" 14291120 "DTC_AIN_AIA_FAIL_LO" 14291121 "DTC_AIN_AIA_FAIL_HI" 14291122 "DTC_AIN_AIA_OOR_LO" 14291123 "DTC_AIN_AIA_OOR_HI" 14291136 "DTC_AIN_PROX_AI_FAIL_LO" 14291137 "DTC_AIN_PROX_AI_FAIL_HI" 14291138 "DTC_AIN_PROX_AI_OOR_LO" 14291139 "DTC_AIN_PROX_AI_OOR_HI" 14291152 "DTC_AIN_TWV_FB_FAIL_LO" 14291153 "DTC_AIN_TWV_FB_FAIL_HI" 14291154 "DTC_AIN_TWV_FB_OOR_LO" 14291155 "DTC_AIN_TWV_FB_OOR_HI" 14291168 "DTC_AIN_5V_KA_FAIL_LO" 14291169 "DTC_AIN_5V_KA_FAIL_HI" 14291170 "DTC_AIN_5V_KA_OOR_LO" 14291171 "DTC_AIN_5V_KA_OOR_HI" 14291184 "DTC_AIN_CTR1_LSD_FAIL_LO" 14291185 "DTC_AIN_CTR1_LSD_FAIL_HI" 14291186 "DTC_AIN_CTR1_LSD_OOR_LO" 14291187 "DTC_AIN_CTR1_LSD_OOR_HI" 14291200 "DTC_AIN_CTR2_LSD_FAIL_LO" 14291201 "DTC_AIN_CTR2_LSD_FAIL_HI" 14291202 "DTC_AIN_CTR2_LSD_OOR_LO" 14291203 "DTC_AIN_CTR2_LSD_OOR_HI" 14291216 "DTC_AIN_CTR3_LSD_FAIL_LO" 14291217 "DTC_AIN_CTR3_LSD_FAIL_HI" 14291218 "DTC_AIN_CTR3_LSD_OOR_LO" 14291219 "DTC_AIN_CTR3_LSD_OOR_HI" 14291232 "DTC_AIN_CTR4_LSD_FAIL_LO" 14291233 "DTC_AIN_CTR4_LSD_FAIL_HI" 14291234 "DTC_AIN_CTR4_LSD_OOR_LO" 14291235 "DTC_AIN_CTR4_LSD_OOR_HI" 14291248 "DTC_AIN_CTR5_LSD_FAIL_LO" 14291249 "DTC_AIN_CTR5_LSD_FAIL_HI" 14291250 "DTC_AIN_CTR5_LSD_OOR_LO" 14291251 "DTC_AIN_CTR5_LSD_OOR_HI" 14291264 "DTC_AIN_CTR6_LSD_FAIL_LO" 14291265 "DTC_AIN_CTR6_LSD_FAIL_HI" 14291266 "DTC_AIN_CTR6_LSD_OOR_LO" 14291267 "DTC_AIN_CTR6_LSD_OOR_HI" 14291280 "DTC_AIN_CTR7_LSD_FAIL_LO" 14291281 "DTC_AIN_CTR7_LSD_FAIL_HI" 14291282 "DTC_AIN_CTR7_LSD_OOR_LO" 14291283 "DTC_AIN_CTR7_LSD_OOR_HI" 14291296 "DTC_AIN_CTR_PWR_CUR_FAIL_LO" 14291297 "DTC_AIN_CTR_PWR_CUR_FAIL_HI" 14291298 "DTC_AIN_CTR_PWR_CUR_OOR_LO" 14291299 "DTC_AIN_CTR_PWR_CUR_OOR_HI" 14291312 "DTC_AIN_CTR_HLD_CUR_FAIL_LO" 14291313 "DTC_AIN_CTR_HLD_CUR_FAIL_HI" 14291314 "DTC_AIN_CTR_HLD_CUR_OOR_LO" 14291315 "DTC_AIN_CTR_HLD_CUR_OOR_HI" 13431040 "DTC_CTR_FAULT_LATCH" 13431041 "DTC_CTR_FAULT_INVALID_HEARTBEAT" 13373440 "DTC_CTR1_LSD_FAILED_LO" 13373441 "DTC_CTR1_LSD_FAILED_HI" 13373442 "DTC_CTR1_HSD_FAILED_LO" 13373443 "DTC_CTR1_HSD_FAILED_HI" 13373444 "DTC_CTR1_PULL_IN_SHORT" 13373445 "DTC_CTR1_PULL_IN_OPEN" 13373446 "DTC_CTR1_COIL_INVALID" 13373447 "DTC_CTR1_COIL_OPEN" 13373448 "DTC_CTR1_CIRCUIT_FAILED" 13377536 "DTC_CTR2_LSD_FAILED_LO" 13377537 "DTC_CTR2_LSD_FAILED_HI" 13377538 "DTC_CTR2_HSD_FAILED_LO" 13377539 "DTC_CTR2_HSD_FAILED_HI" 13377540 "DTC_CTR2_PULL_IN_SHORT" 13377541 "DTC_CTR2_PULL_IN_OPEN" 13377542 "DTC_CTR2_COIL_INVALID" 13377543 "DTC_CTR2_COIL_OPEN" 13377544 "DTC_CTR2_CIRCUIT_FAILED" 13381632 "DTC_CTR3_LSD_FAILED_LO" 13381633 "DTC_CTR3_LSD_FAILED_HI" 13381634 "DTC_CTR3_HSD_FAILED_LO" 13381635 "DTC_CTR3_HSD_FAILED_HI" 13381636 "DTC_CTR3_PULL_IN_SHORT" 13381637 "DTC_CTR3_PULL_IN_OPEN" 13381638 "DTC_CTR3_COIL_INVALID" 13381639 "DTC_CTR3_COIL_OPEN" 13381640 "DTC_CTR3_CIRCUIT_FAILED" 13385728 "DTC_CTR4_LSD_FAILED_LO" 13385729 "DTC_CTR4_LSD_FAILED_HI" 13385730 "DTC_CTR4_HSD_FAILED_LO" 13385731 "DTC_CTR4_HSD_FAILED_HI" 13385732 "DTC_CTR4_PULL_IN_SHORT" 13385733 "DTC_CTR4_PULL_IN_OPEN" 13385734 "DTC_CTR4_COIL_INVALID" 13385735 "DTC_CTR4_COIL_OPEN" 13385736 "DTC_CTR4_CIRCUIT_FAILED" 13389824 "DTC_CTR5_LSD_FAILED_LO" 13389825 "DTC_CTR5_LSD_FAILED_HI" 13389826 "DTC_CTR5_HSD_FAILED_LO" 13389827 "DTC_CTR5_HSD_FAILED_HI" 13389828 "DTC_CTR5_PULL_IN_SHORT" 13389829 "DTC_CTR5_PULL_IN_OPEN" 13389830 "DTC_CTR5_COIL_INVALID" 13389831 "DTC_CTR5_COIL_OPEN" 13389832 "DTC_CTR5_CIRCUIT_FAILED" 13393920 "DTC_CTR6_LSD_FAILED_LO" 13393921 "DTC_CTR6_LSD_FAILED_HI" 13393922 "DTC_CTR6_HSD_FAILED_LO" 13393923 "DTC_CTR6_HSD_FAILED_HI" 13393924 "DTC_CTR6_PULL_IN_SHORT" 13393925 "DTC_CTR6_PULL_IN_OPEN" 13393926 "DTC_CTR6_COIL_INVALID" 13393927 "DTC_CTR6_COIL_OPEN" 13393928 "DTC_CTR6_CIRCUIT_FAILED" 13398016 "DTC_CTR7_LSD_FAILED_LO" 13398017 "DTC_CTR7_LSD_FAILED_HI" 13398018 "DTC_CTR7_HSD_FAILED_LO" 13398019 "DTC_CTR7_HSD_FAILED_HI" 13398020 "DTC_CTR7_PULL_IN_SHORT" 13398021 "DTC_CTR7_PULL_IN_OPEN" 13398022 "DTC_CTR7_COIL_INVALID" 13398023 "DTC_CTR7_COIL_OPEN" 13398024 "DTC_CTR7_CIRCUIT_FAILED" 14483456 "DTC_DRV_SW14V_PWR_FAILED_LO" 14483457 "DTC_DRV_SW14V_PWR_FAILED_HI" 14483472 "DTC_DRV_CHRGA_ENA_FAILED_LO" 14483473 "DTC_DRV_CHRGA_ENA_FAILED_HI" 14483488 "DTC_DRV_CHRGB_ENA_FAILED_LO" 14483489 "DTC_DRV_CHRGB_ENA_FAILED_HI" 14483504 "DTC_DRV_LSDA_FAILED_LO" 14483505 "DTC_DRV_LSDA_FAILED_HI" 14483520 "DTC_DRV_LSDB_FAILED_LO" 14483521 "DTC_DRV_LSDB_FAILED_HI" 14483536 "DTC_DRV_HSDA_FAILED_LO" 14483537 "DTC_DRV_HSDA_FAILED_HI" 14483552 "DTC_DRV_HSDB_FAILED_LO" 14483553 "DTC_DRV_HSDB_FAILED_HI" 14553088 "DTC_ICM_FGD1_FAIL_LO" 14553089 "DTC_ICM_FGD1_FAIL_HI" 14553090 "DTC_ICM_FGD1_OOR_LO" 14553091 "DTC_ICM_FGD1_OOR_HI" 14553104 "DTC_ICM_FGD2_FAIL_LO" 14553105 "DTC_ICM_FGD2_FAIL_HI" 14553106 "DTC_ICM_FGD2_OOR_LO" 14553107 "DTC_ICM_FGD2_OOR_HI" 14553120 "DTC_ICM_PILOT_FAIL_LO" 14553121 "DTC_ICM_PILOT_FAIL_HI" 14553122 "DTC_ICM_PILOT_OOR_LO" 14553123 "DTC_ICM_PILOT_OOR_HI" 14553136 "DTC_ICM_MOD_FLT_FAIL_LO" 14553137 "DTC_ICM_MOD_FLT_FAIL_HI" 14553138 "DTC_ICM_MOD_FLT_OOR_LO" 14553139 "DTC_ICM_MOD_FLT_OOR_HI" 14553152 "DTC_ICM_CLK_FAIL_LO" 14553153 "DTC_ICM_CLK_FAIL_HI" 14553154 "DTC_ICM_CLK_OOR_LO" 14553155 "DTC_ICM_CLK_OOR_HI" 14553168 "DTC_ICM_LSD_A_FAIL_LO" 14553169 "DTC_ICM_LSD_A_FAIL_HI" 14553170 "DTC_ICM_LSD_A_OOR_LO" 14553171 "DTC_ICM_LSD_A_OOR_HI" 14553184 "DTC_ICM_LSD_B_FAIL_LO" 14553185 "DTC_ICM_LSD_B_FAIL_HI" 14553186 "DTC_ICM_LSD_B_OOR_LO" 14553187 "DTC_ICM_LSD_B_OOR_HI" 14553200 "DTC_ICM_PWM_A_FAIL_LO" 14553201 "DTC_ICM_PWM_A_FAIL_HI" 14553202 "DTC_ICM_PWM_A_OOR_LO" 14553203 "DTC_ICM_PWM_A_OOR_HI" 14553216 "DTC_ICM_PWM_B_FAIL_LO" 14553217 "DTC_ICM_PWM_B_FAIL_HI" 14553218 "DTC_ICM_PWM_B_OOR_LO" 14553219 "DTC_ICM_PWM_B_OOR_HI" 14553232 "DTC_ICM_PWM_C_FAIL_LO" 14553233 "DTC_ICM_PWM_C_FAIL_HI" 14553234 "DTC_ICM_PWM_C_OOR_LO" 14553235 "DTC_ICM_PWM_C_OOR_HI" 14553248 "DTC_ICM_PWM_D_FAIL_LO" 14553249 "DTC_ICM_PWM_D_FAIL_HI" 14553250 "DTC_ICM_PWM_D_OOR_LO" 14553251 "DTC_ICM_PWM_D_OOR_HI" 14606336 "DTC_NVM_EE_0_COMM_WRITE_TO" 14606337 "DTC_NVM_EE_0_COMM_READ_TO" 14606338 "DTC_NVM_EE_0_WRITE_VERIFY" 14606339 "DTC_NVM_EE_0_READ_VERIFY" 14606340 "DTC_NVM_EE_0_READ_ERR" 14606341 "DTC_NVM_EE_0_WRITE_ERR" 14564800 "DTC_PWM_LSD_A_DC_MISMATCH" 14565344 "DTC_PWM_LSD_A_FREQ_MISMATCH" 14564801 "DTC_PWM_PWM_A_DC_MISMATCH" 14565345 "DTC_PWM_PWM_A_FREQ_MISMATCH" 14564802 "DTC_PWM_PWM_B_DC_MISMATCH" 14565346 "DTC_PWM_PWM_B_FREQ_MISMATCH" 14564803 "DTC_PWM_PWM_C_DC_MISMATCH" 14565347 "DTC_PWM_PWM_C_FREQ_MISMATCH" 14564804 "DTC_PWM_PWM_D_DC_MISMATCH" 14565348 "DTC_PWM_PWM_D_FREQ_MISMATCH" 14417920 "DTC_PWR_WAKEUP_CLK_FAILED" 14417921 "DTC_PWR_WAKEUP_CLK_OOR_LO" 14417922 "DTC_PWR_WAKEUP_CLK_OOR_HI" 14614570 "DTC_SDP_HPWR_OOR_HI" 14614571 "DTC_SDP_HPWR_OOR_LO" 14614572 "DTC_SDP_HPWR_COMM_TO" 14614573 "DTC_SDP_DEVICE_FAILURE";
VAL_ 1120 bcm_dtc_072 0 " - " 11276288 "DTC_VEPO" 11276289 "DTC_HSC_MISSING" 11460608 "DTC_NVM_SOC" 11460609 "DTC_NVM_HYST" 11460610 "DTC_NVM_KOT" 11460611 "DTC_NVM_PERIODIC_SHUTDOWN_TIME" 11460612 "DTC_NVM_WAKE" 11460613 "DTC_NVM_CALENDAR_LIFE" 11460614 "DTC_NVM_CYCLE_LIFE" 11460615 "DTC_NVM_DTC" 11460616 "DTC_NVM_APP_SCRATCHPAD" 11517962 "DTC_LOOPTIME_TASK_A" 11517963 "DTC_LOOPTIME_TASK_B" 11517964 "DTC_LOOPTIME_TASK_C" 11517965 "DTC_LOOPTIME_TASK_D" 11517966 "DTC_LOOPTIME_TASK_E" 11517967 "DTC_ILIM_MAX_DISCHARGE" 15728640 "DTC_EPO" 16171008 "DTC_CONT_OPEN" 16171009 "DTC_CONT_CLOSE" 16171010 "DTC_CONT_OPEN_CURRENT" 16171264 "DTC_CONT_CLOSE_ON_RESET" 16171265 "DTC_CONT_CLOSE_SIG_FAILED" 16171520 "DTC_PRECHARGE_TIMEOUT" 16171777 "DTC_CONT_NEG_WELD_AT_SU" 16171778 "DTC_CONT_POS_A_WELD_AT_SU" 16171779 "DTC_CONT_POS_B_WELD_AT_SU" 16172033 "DTC_CONT_NEG_WELD_AT_SD" 16172034 "DTC_CONT_POS_A_WELD_AT_SD" 16172036 "DTC_CONT_POS_B_WELD_AT_SD" 16172289 "DTC_CONT_NEG_OPEN" 16172290 "DTC_CONT_POS_A_OPEN" 16172291 "DTC_CONT_POS_B_OPEN" 16172545 "DTC_CONT_NEG_VDIF" 16172546 "DTC_CONT_POS_A_VDIF" 16172548 "DTC_CONT_POS_B_VDIF" 16174848 "DTC_HVIL" 16174849 "DTC_LVBAT_LO" 16174850 "DTC_LVBAT_HI" 16174851 "DTC_LVBAT_ERR" 16522240 "DTC_CSM_MISSING" 16522752 "DTC_CSM_VBAT" 16522753 "DTC_CSM_VPOS" 16522754 "DTC_CSM_VNEG" 16522755 "DTC_CSM_CPOS" 16522756 "DTC_CSM_CNEG" 16522757 "DTC_CSM_APOS" 16522758 "DTC_CSM_ANEG" 16522759 "DTC_CSM_FUSE_HI" 16522760 "DTC_CSM_FUSE_LO" 16521728 "DTC_CSM_ASIC" 16521729 "DTC_CSM_AILO" 16521730 "DTC_CSM_AIHI" 16520957 "DTC_LEAKAGE_DETECT_FAULT" 16522444 "DTC_REALTIMECLOCK_FAULT" 16520945 "DTC_CSM_LEAK_FAIL_CALC" 16520946 "DTC_CSM_LEAK_FAIL_HW" 16520947 "DTC_CSM_LEAK_EXT_SHORT" 16520948 "DTC_CSM_LEAK_MID_PACK_SHORT" 16520949 "DTC_CSM_LEAK_ERROR" 16520950 "DTC_CSM_LEAK_UNKNOWN" 16523008 "DTC_CSM_VER_MISMATCH" 16523009 "DTC_CSM_DTC_SET" 16523010 "DTC_CSM_CAL_FAULT" 16496320 "DTC_MBB_TOO_FEW" 16496321 "DTC_MBB_TOO_MANY" 16496352 "DTC_CELL_VMAX_ERR" 16496353 "DTC_CELL_VMIN_ERR" 16496354 "DTC_CELL_VMAX" 16496362 "DTC_CELL_VMAX_SEVERE" 16496355 "DTC_CELL_VMIN" 16496363 "DTC_CELL_VMIN_SEVERE" 16496356 "DTC_MOD_VOLTAGE_COMPARE" 16496336 "DTC_CELL_T_ERR" 16496337 "DTC_CELL_TMAX1" 16496338 "DTC_CELL_TMAX2" 16496339 "DTC_CELL_TMIN" 16497665 "DTC_MBB_01_MISSING" 16497666 "DTC_MBB_02_MISSING" 16497667 "DTC_MBB_03_MISSING" 16497668 "DTC_MBB_04_MISSING" 16497669 "DTC_MBB_05_MISSING" 16497670 "DTC_MBB_06_MISSING" 16497671 "DTC_MBB_07_MISSING" 16497672 "DTC_MBB_08_MISSING" 16497673 "DTC_MBB_09_MISSING" 16497680 "DTC_MBB_10_MISSING" 16497681 "DTC_MBB_11_MISSING" 16497682 "DTC_MBB_12_MISSING" 16497683 "DTC_MBB_13_MISSING" 16497684 "DTC_MBB_14_MISSING" 16497685 "DTC_MBB_15_MISSING" 16497686 "DTC_MBB_16_MISSING" 16497687 "DTC_MBB_17_MISSING" 16497688 "DTC_MBB_18_MISSING" 16497689 "DTC_MBB_19_MISSING" 16497696 "DTC_MBB_20_MISSING" 16497697 "DTC_MBB_21_MISSING" 16497698 "DTC_MBB_22_MISSING" 16497699 "DTC_MBB_23_MISSING" 16497700 "DTC_MBB_24_MISSING" 16498177 "DTC_MBB_01_VFAULT" 16498178 "DTC_MBB_02_VFAULT" 16498179 "DTC_MBB_03_VFAULT" 16498180 "DTC_MBB_04_VFAULT" 16498181 "DTC_MBB_05_VFAULT" 16498182 "DTC_MBB_06_VFAULT" 16498183 "DTC_MBB_07_VFAULT" 16498184 "DTC_MBB_08_VFAULT" 16498185 "DTC_MBB_09_VFAULT" 16498192 "DTC_MBB_10_VFAULT" 16498193 "DTC_MBB_11_VFAULT" 16498194 "DTC_MBB_12_VFAULT" 16498195 "DTC_MBB_13_VFAULT" 16498196 "DTC_MBB_14_VFAULT" 16498197 "DTC_MBB_15_VFAULT" 16498198 "DTC_MBB_16_VFAULT" 16498199 "DTC_MBB_17_VFAULT" 16498200 "DTC_MBB_18_VFAULT" 16498201 "DTC_MBB_19_VFAULT" 16498208 "DTC_MBB_20_VFAULT" 16498209 "DTC_MBB_21_VFAULT" 16498210 "DTC_MBB_22_VFAULT" 16498211 "DTC_MBB_23_VFAULT" 16498212 "DTC_MBB_24_VFAULT" 16497921 "DTC_MBB_01_TFAULT" 16497922 "DTC_MBB_02_TFAULT" 16497923 "DTC_MBB_03_TFAULT" 16497924 "DTC_MBB_04_TFAULT" 16497925 "DTC_MBB_05_TFAULT" 16497926 "DTC_MBB_06_TFAULT" 16497927 "DTC_MBB_07_TFAULT" 16497928 "DTC_MBB_08_TFAULT" 16497929 "DTC_MBB_09_TFAULT" 16497936 "DTC_MBB_10_TFAULT" 16497937 "DTC_MBB_11_TFAULT" 16497938 "DTC_MBB_12_TFAULT" 16497939 "DTC_MBB_13_TFAULT" 16497940 "DTC_MBB_14_TFAULT" 16497941 "DTC_MBB_15_TFAULT" 16497942 "DTC_MBB_16_TFAULT" 16497943 "DTC_MBB_17_TFAULT" 16497944 "DTC_MBB_18_TFAULT" 16497945 "DTC_MBB_19_TFAULT" 16497952 "DTC_MBB_20_TFAULT" 16497953 "DTC_MBB_21_TFAULT" 16497954 "DTC_MBB_22_TFAULT" 16497955 "DTC_MBB_23_TFAULT" 16497956 "DTC_MBB_24_TFAULT" 16498688 "DTC_BRUSA_MISSING" 16498689 "DTC_BRUSA_IDC" 16498690 "DTC_BRUSA_REQ_VS_CMD" 16560128 "DTC_IBAT_MISMATCH" 16576512 "DTC_DIS_MAX_I2T" 16576513 "DTC_CHG_MAX_I2T" 16576768 "DTC_DIS_WARNING_I2T" 16576769 "DTC_CHG_WARNING_I2T" 16523520 "DTC_LEM_A_OOR_HI" 16523521 "DTC_LEM_A_OOR_LO" 16523522 "DTC_LEM_A_FAULT" 16523776 "DTC_LEM_B_OOR_HI" 16523777 "DTC_LEM_B_OOR_LO" 16523778 "DTC_LEM_B_FAULT" 16506880 "DTC_VBAT_MISMATCH" 16506881 "DTC_VBAT_VMAX" 16506882 "DTC_VBAT_VMIN" 16506883 "DTC_PACK_FUSE_A" 16506884 "DTC_PACK_FUSE_B" 16252928 "DTC_KEY_OFF_TIME_ERROR" 16252929 "DTC_PERIODIC_OFF_TIME_ERROR" 14290944 "DTC_AIN_BPWR_FAIL_LO" 14290945 "DTC_AIN_BPWR_FAIL_HI" 14290946 "DTC_AIN_BPWR_OOR_LO" 14290947 "DTC_AIN_BPWR_OOR_HI" 14290960 "DTC_AIN_14V_FAIL_LO" 14290961 "DTC_AIN_14V_FAIL_HI" 14290962 "DTC_AIN_14V_OOR_LO" 14290963 "DTC_AIN_14V_OOR_HI" 14290976 "DTC_AIN_HPWR_FAIL_LO" 14290977 "DTC_AIN_HPWR_FAIL_HI" 14290978 "DTC_AIN_HPWR_OOR_LO" 14290979 "DTC_AIN_HPWR_OOR_HI" 14290992 "DTC_AIN_6V_FAIL_LO" 14290993 "DTC_AIN_6V_FAIL_HI" 14290994 "DTC_AIN_6V_OOR_LO" 14290995 "DTC_AIN_6V_OOR_HI" 14291008 "DTC_AIN_HVIL_FAIL_LO" 14291009 "DTC_AIN_HVIL_FAIL_HI" 14291010 "DTC_AIN_HVIL_OOR_LO" 14291011 "DTC_AIN_HVIL_OOR_HI" 14291024 "DTC_AIN_5V_PWR_FAIL_LO" 14291025 "DTC_AIN_5V_PWR_FAIL_HI" 14291026 "DTC_AIN_5V_PWR_OOR_LO" 14291027 "DTC_AIN_5V_PWR_OOR_HI" 14291040 "DTC_AIN_LEM_HI_FAIL_LO" 14291041 "DTC_AIN_LEM_HI_FAIL_HI" 14291042 "DTC_AIN_LEM_HI_OOR_LO" 14291043 "DTC_AIN_LEM_HI_OOR_HI" 14291056 "DTC_AIN_LEM_LO_FAIL_LO" 14291057 "DTC_AIN_LEM_LO_FAIL_HI" 14291058 "DTC_AIN_LEM_LO_OOR_LO" 14291059 "DTC_AIN_LEM_LO_OOR_HI" 14291072 "DTC_AIN_BCT_AI_FAIL_LO" 14291073 "DTC_AIN_BCT_AI_FAIL_HI" 14291074 "DTC_AIN_BCT_AI_OOR_LO" 14291075 "DTC_AIN_BCT_AI_OOR_HI" 14291088 "DTC_AIN_WTR2_AI_FAIL_LO" 14291089 "DTC_AIN_WTR2_AI_FAIL_HI" 14291090 "DTC_AIN_WTR2_AI_OOR_LO" 14291091 "DTC_AIN_WTR2_AI_OOR_HI" 14291104 "DTC_AIN_WTR1_AI_FAIL_LO" 14291105 "DTC_AIN_WTR1_AI_FAIL_HI" 14291106 "DTC_AIN_WTR1_AI_OOR_LO" 14291107 "DTC_AIN_WTR1_AI_OOR_HI" 14291120 "DTC_AIN_AIA_FAIL_LO" 14291121 "DTC_AIN_AIA_FAIL_HI" 14291122 "DTC_AIN_AIA_OOR_LO" 14291123 "DTC_AIN_AIA_OOR_HI" 14291136 "DTC_AIN_PROX_AI_FAIL_LO" 14291137 "DTC_AIN_PROX_AI_FAIL_HI" 14291138 "DTC_AIN_PROX_AI_OOR_LO" 14291139 "DTC_AIN_PROX_AI_OOR_HI" 14291152 "DTC_AIN_TWV_FB_FAIL_LO" 14291153 "DTC_AIN_TWV_FB_FAIL_HI" 14291154 "DTC_AIN_TWV_FB_OOR_LO" 14291155 "DTC_AIN_TWV_FB_OOR_HI" 14291168 "DTC_AIN_5V_KA_FAIL_LO" 14291169 "DTC_AIN_5V_KA_FAIL_HI" 14291170 "DTC_AIN_5V_KA_OOR_LO" 14291171 "DTC_AIN_5V_KA_OOR_HI" 14291184 "DTC_AIN_CTR1_LSD_FAIL_LO" 14291185 "DTC_AIN_CTR1_LSD_FAIL_HI" 14291186 "DTC_AIN_CTR1_LSD_OOR_LO" 14291187 "DTC_AIN_CTR1_LSD_OOR_HI" 14291200 "DTC_AIN_CTR2_LSD_FAIL_LO" 14291201 "DTC_AIN_CTR2_LSD_FAIL_HI" 14291202 "DTC_AIN_CTR2_LSD_OOR_LO" 14291203 "DTC_AIN_CTR2_LSD_OOR_HI" 14291216 "DTC_AIN_CTR3_LSD_FAIL_LO" 14291217 "DTC_AIN_CTR3_LSD_FAIL_HI" 14291218 "DTC_AIN_CTR3_LSD_OOR_LO" 14291219 "DTC_AIN_CTR3_LSD_OOR_HI" 14291232 "DTC_AIN_CTR4_LSD_FAIL_LO" 14291233 "DTC_AIN_CTR4_LSD_FAIL_HI" 14291234 "DTC_AIN_CTR4_LSD_OOR_LO" 14291235 "DTC_AIN_CTR4_LSD_OOR_HI" 14291248 "DTC_AIN_CTR5_LSD_FAIL_LO" 14291249 "DTC_AIN_CTR5_LSD_FAIL_HI" 14291250 "DTC_AIN_CTR5_LSD_OOR_LO" 14291251 "DTC_AIN_CTR5_LSD_OOR_HI" 14291264 "DTC_AIN_CTR6_LSD_FAIL_LO" 14291265 "DTC_AIN_CTR6_LSD_FAIL_HI" 14291266 "DTC_AIN_CTR6_LSD_OOR_LO" 14291267 "DTC_AIN_CTR6_LSD_OOR_HI" 14291280 "DTC_AIN_CTR7_LSD_FAIL_LO" 14291281 "DTC_AIN_CTR7_LSD_FAIL_HI" 14291282 "DTC_AIN_CTR7_LSD_OOR_LO" 14291283 "DTC_AIN_CTR7_LSD_OOR_HI" 14291296 "DTC_AIN_CTR_PWR_CUR_FAIL_LO" 14291297 "DTC_AIN_CTR_PWR_CUR_FAIL_HI" 14291298 "DTC_AIN_CTR_PWR_CUR_OOR_LO" 14291299 "DTC_AIN_CTR_PWR_CUR_OOR_HI" 14291312 "DTC_AIN_CTR_HLD_CUR_FAIL_LO" 14291313 "DTC_AIN_CTR_HLD_CUR_FAIL_HI" 14291314 "DTC_AIN_CTR_HLD_CUR_OOR_LO" 14291315 "DTC_AIN_CTR_HLD_CUR_OOR_HI" 13431040 "DTC_CTR_FAULT_LATCH" 13431041 "DTC_CTR_FAULT_INVALID_HEARTBEAT" 13373440 "DTC_CTR1_LSD_FAILED_LO" 13373441 "DTC_CTR1_LSD_FAILED_HI" 13373442 "DTC_CTR1_HSD_FAILED_LO" 13373443 "DTC_CTR1_HSD_FAILED_HI" 13373444 "DTC_CTR1_PULL_IN_SHORT" 13373445 "DTC_CTR1_PULL_IN_OPEN" 13373446 "DTC_CTR1_COIL_INVALID" 13373447 "DTC_CTR1_COIL_OPEN" 13373448 "DTC_CTR1_CIRCUIT_FAILED" 13377536 "DTC_CTR2_LSD_FAILED_LO" 13377537 "DTC_CTR2_LSD_FAILED_HI" 13377538 "DTC_CTR2_HSD_FAILED_LO" 13377539 "DTC_CTR2_HSD_FAILED_HI" 13377540 "DTC_CTR2_PULL_IN_SHORT" 13377541 "DTC_CTR2_PULL_IN_OPEN" 13377542 "DTC_CTR2_COIL_INVALID" 13377543 "DTC_CTR2_COIL_OPEN" 13377544 "DTC_CTR2_CIRCUIT_FAILED" 13381632 "DTC_CTR3_LSD_FAILED_LO" 13381633 "DTC_CTR3_LSD_FAILED_HI" 13381634 "DTC_CTR3_HSD_FAILED_LO" 13381635 "DTC_CTR3_HSD_FAILED_HI" 13381636 "DTC_CTR3_PULL_IN_SHORT" 13381637 "DTC_CTR3_PULL_IN_OPEN" 13381638 "DTC_CTR3_COIL_INVALID" 13381639 "DTC_CTR3_COIL_OPEN" 13381640 "DTC_CTR3_CIRCUIT_FAILED" 13385728 "DTC_CTR4_LSD_FAILED_LO" 13385729 "DTC_CTR4_LSD_FAILED_HI" 13385730 "DTC_CTR4_HSD_FAILED_LO" 13385731 "DTC_CTR4_HSD_FAILED_HI" 13385732 "DTC_CTR4_PULL_IN_SHORT" 13385733 "DTC_CTR4_PULL_IN_OPEN" 13385734 "DTC_CTR4_COIL_INVALID" 13385735 "DTC_CTR4_COIL_OPEN" 13385736 "DTC_CTR4_CIRCUIT_FAILED" 13389824 "DTC_CTR5_LSD_FAILED_LO" 13389825 "DTC_CTR5_LSD_FAILED_HI" 13389826 "DTC_CTR5_HSD_FAILED_LO" 13389827 "DTC_CTR5_HSD_FAILED_HI" 13389828 "DTC_CTR5_PULL_IN_SHORT" 13389829 "DTC_CTR5_PULL_IN_OPEN" 13389830 "DTC_CTR5_COIL_INVALID" 13389831 "DTC_CTR5_COIL_OPEN" 13389832 "DTC_CTR5_CIRCUIT_FAILED" 13393920 "DTC_CTR6_LSD_FAILED_LO" 13393921 "DTC_CTR6_LSD_FAILED_HI" 13393922 "DTC_CTR6_HSD_FAILED_LO" 13393923 "DTC_CTR6_HSD_FAILED_HI" 13393924 "DTC_CTR6_PULL_IN_SHORT" 13393925 "DTC_CTR6_PULL_IN_OPEN" 13393926 "DTC_CTR6_COIL_INVALID" 13393927 "DTC_CTR6_COIL_OPEN" 13393928 "DTC_CTR6_CIRCUIT_FAILED" 13398016 "DTC_CTR7_LSD_FAILED_LO" 13398017 "DTC_CTR7_LSD_FAILED_HI" 13398018 "DTC_CTR7_HSD_FAILED_LO" 13398019 "DTC_CTR7_HSD_FAILED_HI" 13398020 "DTC_CTR7_PULL_IN_SHORT" 13398021 "DTC_CTR7_PULL_IN_OPEN" 13398022 "DTC_CTR7_COIL_INVALID" 13398023 "DTC_CTR7_COIL_OPEN" 13398024 "DTC_CTR7_CIRCUIT_FAILED" 14483456 "DTC_DRV_SW14V_PWR_FAILED_LO" 14483457 "DTC_DRV_SW14V_PWR_FAILED_HI" 14483472 "DTC_DRV_CHRGA_ENA_FAILED_LO" 14483473 "DTC_DRV_CHRGA_ENA_FAILED_HI" 14483488 "DTC_DRV_CHRGB_ENA_FAILED_LO" 14483489 "DTC_DRV_CHRGB_ENA_FAILED_HI" 14483504 "DTC_DRV_LSDA_FAILED_LO" 14483505 "DTC_DRV_LSDA_FAILED_HI" 14483520 "DTC_DRV_LSDB_FAILED_LO" 14483521 "DTC_DRV_LSDB_FAILED_HI" 14483536 "DTC_DRV_HSDA_FAILED_LO" 14483537 "DTC_DRV_HSDA_FAILED_HI" 14483552 "DTC_DRV_HSDB_FAILED_LO" 14483553 "DTC_DRV_HSDB_FAILED_HI" 14553088 "DTC_ICM_FGD1_FAIL_LO" 14553089 "DTC_ICM_FGD1_FAIL_HI" 14553090 "DTC_ICM_FGD1_OOR_LO" 14553091 "DTC_ICM_FGD1_OOR_HI" 14553104 "DTC_ICM_FGD2_FAIL_LO" 14553105 "DTC_ICM_FGD2_FAIL_HI" 14553106 "DTC_ICM_FGD2_OOR_LO" 14553107 "DTC_ICM_FGD2_OOR_HI" 14553120 "DTC_ICM_PILOT_FAIL_LO" 14553121 "DTC_ICM_PILOT_FAIL_HI" 14553122 "DTC_ICM_PILOT_OOR_LO" 14553123 "DTC_ICM_PILOT_OOR_HI" 14553136 "DTC_ICM_MOD_FLT_FAIL_LO" 14553137 "DTC_ICM_MOD_FLT_FAIL_HI" 14553138 "DTC_ICM_MOD_FLT_OOR_LO" 14553139 "DTC_ICM_MOD_FLT_OOR_HI" 14553152 "DTC_ICM_CLK_FAIL_LO" 14553153 "DTC_ICM_CLK_FAIL_HI" 14553154 "DTC_ICM_CLK_OOR_LO" 14553155 "DTC_ICM_CLK_OOR_HI" 14553168 "DTC_ICM_LSD_A_FAIL_LO" 14553169 "DTC_ICM_LSD_A_FAIL_HI" 14553170 "DTC_ICM_LSD_A_OOR_LO" 14553171 "DTC_ICM_LSD_A_OOR_HI" 14553184 "DTC_ICM_LSD_B_FAIL_LO" 14553185 "DTC_ICM_LSD_B_FAIL_HI" 14553186 "DTC_ICM_LSD_B_OOR_LO" 14553187 "DTC_ICM_LSD_B_OOR_HI" 14553200 "DTC_ICM_PWM_A_FAIL_LO" 14553201 "DTC_ICM_PWM_A_FAIL_HI" 14553202 "DTC_ICM_PWM_A_OOR_LO" 14553203 "DTC_ICM_PWM_A_OOR_HI" 14553216 "DTC_ICM_PWM_B_FAIL_LO" 14553217 "DTC_ICM_PWM_B_FAIL_HI" 14553218 "DTC_ICM_PWM_B_OOR_LO" 14553219 "DTC_ICM_PWM_B_OOR_HI" 14553232 "DTC_ICM_PWM_C_FAIL_LO" 14553233 "DTC_ICM_PWM_C_FAIL_HI" 14553234 "DTC_ICM_PWM_C_OOR_LO" 14553235 "DTC_ICM_PWM_C_OOR_HI" 14553248 "DTC_ICM_PWM_D_FAIL_LO" 14553249 "DTC_ICM_PWM_D_FAIL_HI" 14553250 "DTC_ICM_PWM_D_OOR_LO" 14553251 "DTC_ICM_PWM_D_OOR_HI" 14606336 "DTC_NVM_EE_0_COMM_WRITE_TO" 14606337 "DTC_NVM_EE_0_COMM_READ_TO" 14606338 "DTC_NVM_EE_0_WRITE_VERIFY" 14606339 "DTC_NVM_EE_0_READ_VERIFY" 14606340 "DTC_NVM_EE_0_READ_ERR" 14606341 "DTC_NVM_EE_0_WRITE_ERR" 14564800 "DTC_PWM_LSD_A_DC_MISMATCH" 14565344 "DTC_PWM_LSD_A_FREQ_MISMATCH" 14564801 "DTC_PWM_PWM_A_DC_MISMATCH" 14565345 "DTC_PWM_PWM_A_FREQ_MISMATCH" 14564802 "DTC_PWM_PWM_B_DC_MISMATCH" 14565346 "DTC_PWM_PWM_B_FREQ_MISMATCH" 14564803 "DTC_PWM_PWM_C_DC_MISMATCH" 14565347 "DTC_PWM_PWM_C_FREQ_MISMATCH" 14564804 "DTC_PWM_PWM_D_DC_MISMATCH" 14565348 "DTC_PWM_PWM_D_FREQ_MISMATCH" 14417920 "DTC_PWR_WAKEUP_CLK_FAILED" 14417921 "DTC_PWR_WAKEUP_CLK_OOR_LO" 14417922 "DTC_PWR_WAKEUP_CLK_OOR_HI" 14614570 "DTC_SDP_HPWR_OOR_HI" 14614571 "DTC_SDP_HPWR_OOR_LO" 14614572 "DTC_SDP_HPWR_COMM_TO" 14614573 "DTC_SDP_DEVICE_FAILURE";
VAL_ 1120 bcm_dtc_073 0 " - " 11276288 "DTC_VEPO" 11276289 "DTC_HSC_MISSING" 11460608 "DTC_NVM_SOC" 11460609 "DTC_NVM_HYST" 11460610 "DTC_NVM_KOT" 11460611 "DTC_NVM_PERIODIC_SHUTDOWN_TIME" 11460612 "DTC_NVM_WAKE" 11460613 "DTC_NVM_CALENDAR_LIFE" 11460614 "DTC_NVM_CYCLE_LIFE" 11460615 "DTC_NVM_DTC" 11460616 "DTC_NVM_APP_SCRATCHPAD" 11517962 "DTC_LOOPTIME_TASK_A" 11517963 "DTC_LOOPTIME_TASK_B" 11517964 "DTC_LOOPTIME_TASK_C" 11517965 "DTC_LOOPTIME_TASK_D" 11517966 "DTC_LOOPTIME_TASK_E" 11517967 "DTC_ILIM_MAX_DISCHARGE" 15728640 "DTC_EPO" 16171008 "DTC_CONT_OPEN" 16171009 "DTC_CONT_CLOSE" 16171010 "DTC_CONT_OPEN_CURRENT" 16171264 "DTC_CONT_CLOSE_ON_RESET" 16171265 "DTC_CONT_CLOSE_SIG_FAILED" 16171520 "DTC_PRECHARGE_TIMEOUT" 16171777 "DTC_CONT_NEG_WELD_AT_SU" 16171778 "DTC_CONT_POS_A_WELD_AT_SU" 16171779 "DTC_CONT_POS_B_WELD_AT_SU" 16172033 "DTC_CONT_NEG_WELD_AT_SD" 16172034 "DTC_CONT_POS_A_WELD_AT_SD" 16172036 "DTC_CONT_POS_B_WELD_AT_SD" 16172289 "DTC_CONT_NEG_OPEN" 16172290 "DTC_CONT_POS_A_OPEN" 16172291 "DTC_CONT_POS_B_OPEN" 16172545 "DTC_CONT_NEG_VDIF" 16172546 "DTC_CONT_POS_A_VDIF" 16172548 "DTC_CONT_POS_B_VDIF" 16174848 "DTC_HVIL" 16174849 "DTC_LVBAT_LO" 16174850 "DTC_LVBAT_HI" 16174851 "DTC_LVBAT_ERR" 16522240 "DTC_CSM_MISSING" 16522752 "DTC_CSM_VBAT" 16522753 "DTC_CSM_VPOS" 16522754 "DTC_CSM_VNEG" 16522755 "DTC_CSM_CPOS" 16522756 "DTC_CSM_CNEG" 16522757 "DTC_CSM_APOS" 16522758 "DTC_CSM_ANEG" 16522759 "DTC_CSM_FUSE_HI" 16522760 "DTC_CSM_FUSE_LO" 16521728 "DTC_CSM_ASIC" 16521729 "DTC_CSM_AILO" 16521730 "DTC_CSM_AIHI" 16520957 "DTC_LEAKAGE_DETECT_FAULT" 16522444 "DTC_REALTIMECLOCK_FAULT" 16520945 "DTC_CSM_LEAK_FAIL_CALC" 16520946 "DTC_CSM_LEAK_FAIL_HW" 16520947 "DTC_CSM_LEAK_EXT_SHORT" 16520948 "DTC_CSM_LEAK_MID_PACK_SHORT" 16520949 "DTC_CSM_LEAK_ERROR" 16520950 "DTC_CSM_LEAK_UNKNOWN" 16523008 "DTC_CSM_VER_MISMATCH" 16523009 "DTC_CSM_DTC_SET" 16523010 "DTC_CSM_CAL_FAULT" 16496320 "DTC_MBB_TOO_FEW" 16496321 "DTC_MBB_TOO_MANY" 16496352 "DTC_CELL_VMAX_ERR" 16496353 "DTC_CELL_VMIN_ERR" 16496354 "DTC_CELL_VMAX" 16496362 "DTC_CELL_VMAX_SEVERE" 16496355 "DTC_CELL_VMIN" 16496363 "DTC_CELL_VMIN_SEVERE" 16496356 "DTC_MOD_VOLTAGE_COMPARE" 16496336 "DTC_CELL_T_ERR" 16496337 "DTC_CELL_TMAX1" 16496338 "DTC_CELL_TMAX2" 16496339 "DTC_CELL_TMIN" 16497665 "DTC_MBB_01_MISSING" 16497666 "DTC_MBB_02_MISSING" 16497667 "DTC_MBB_03_MISSING" 16497668 "DTC_MBB_04_MISSING" 16497669 "DTC_MBB_05_MISSING" 16497670 "DTC_MBB_06_MISSING" 16497671 "DTC_MBB_07_MISSING" 16497672 "DTC_MBB_08_MISSING" 16497673 "DTC_MBB_09_MISSING" 16497680 "DTC_MBB_10_MISSING" 16497681 "DTC_MBB_11_MISSING" 16497682 "DTC_MBB_12_MISSING" 16497683 "DTC_MBB_13_MISSING" 16497684 "DTC_MBB_14_MISSING" 16497685 "DTC_MBB_15_MISSING" 16497686 "DTC_MBB_16_MISSING" 16497687 "DTC_MBB_17_MISSING" 16497688 "DTC_MBB_18_MISSING" 16497689 "DTC_MBB_19_MISSING" 16497696 "DTC_MBB_20_MISSING" 16497697 "DTC_MBB_21_MISSING" 16497698 "DTC_MBB_22_MISSING" 16497699 "DTC_MBB_23_MISSING" 16497700 "DTC_MBB_24_MISSING" 16498177 "DTC_MBB_01_VFAULT" 16498178 "DTC_MBB_02_VFAULT" 16498179 "DTC_MBB_03_VFAULT" 16498180 "DTC_MBB_04_VFAULT" 16498181 "DTC_MBB_05_VFAULT" 16498182 "DTC_MBB_06_VFAULT" 16498183 "DTC_MBB_07_VFAULT" 16498184 "DTC_MBB_08_VFAULT" 16498185 "DTC_MBB_09_VFAULT" 16498192 "DTC_MBB_10_VFAULT" 16498193 "DTC_MBB_11_VFAULT" 16498194 "DTC_MBB_12_VFAULT" 16498195 "DTC_MBB_13_VFAULT" 16498196 "DTC_MBB_14_VFAULT" 16498197 "DTC_MBB_15_VFAULT" 16498198 "DTC_MBB_16_VFAULT" 16498199 "DTC_MBB_17_VFAULT" 16498200 "DTC_MBB_18_VFAULT" 16498201 "DTC_MBB_19_VFAULT" 16498208 "DTC_MBB_20_VFAULT" 16498209 "DTC_MBB_21_VFAULT" 16498210 "DTC_MBB_22_VFAULT" 16498211 "DTC_MBB_23_VFAULT" 16498212 "DTC_MBB_24_VFAULT" 16497921 "DTC_MBB_01_TFAULT" 16497922 "DTC_MBB_02_TFAULT" 16497923 "DTC_MBB_03_TFAULT" 16497924 "DTC_MBB_04_TFAULT" 16497925 "DTC_MBB_05_TFAULT" 16497926 "DTC_MBB_06_TFAULT" 16497927 "DTC_MBB_07_TFAULT" 16497928 "DTC_MBB_08_TFAULT" 16497929 "DTC_MBB_09_TFAULT" 16497936 "DTC_MBB_10_TFAULT" 16497937 "DTC_MBB_11_TFAULT" 16497938 "DTC_MBB_12_TFAULT" 16497939 "DTC_MBB_13_TFAULT" 16497940 "DTC_MBB_14_TFAULT" 16497941 "DTC_MBB_15_TFAULT" 16497942 "DTC_MBB_16_TFAULT" 16497943 "DTC_MBB_17_TFAULT" 16497944 "DTC_MBB_18_TFAULT" 16497945 "DTC_MBB_19_TFAULT" 16497952 "DTC_MBB_20_TFAULT" 16497953 "DTC_MBB_21_TFAULT" 16497954 "DTC_MBB_22_TFAULT" 16497955 "DTC_MBB_23_TFAULT" 16497956 "DTC_MBB_24_TFAULT" 16498688 "DTC_BRUSA_MISSING" 16498689 "DTC_BRUSA_IDC" 16498690 "DTC_BRUSA_REQ_VS_CMD" 16560128 "DTC_IBAT_MISMATCH" 16576512 "DTC_DIS_MAX_I2T" 16576513 "DTC_CHG_MAX_I2T" 16576768 "DTC_DIS_WARNING_I2T" 16576769 "DTC_CHG_WARNING_I2T" 16523520 "DTC_LEM_A_OOR_HI" 16523521 "DTC_LEM_A_OOR_LO" 16523522 "DTC_LEM_A_FAULT" 16523776 "DTC_LEM_B_OOR_HI" 16523777 "DTC_LEM_B_OOR_LO" 16523778 "DTC_LEM_B_FAULT" 16506880 "DTC_VBAT_MISMATCH" 16506881 "DTC_VBAT_VMAX" 16506882 "DTC_VBAT_VMIN" 16506883 "DTC_PACK_FUSE_A" 16506884 "DTC_PACK_FUSE_B" 16252928 "DTC_KEY_OFF_TIME_ERROR" 16252929 "DTC_PERIODIC_OFF_TIME_ERROR" 14290944 "DTC_AIN_BPWR_FAIL_LO" 14290945 "DTC_AIN_BPWR_FAIL_HI" 14290946 "DTC_AIN_BPWR_OOR_LO" 14290947 "DTC_AIN_BPWR_OOR_HI" 14290960 "DTC_AIN_14V_FAIL_LO" 14290961 "DTC_AIN_14V_FAIL_HI" 14290962 "DTC_AIN_14V_OOR_LO" 14290963 "DTC_AIN_14V_OOR_HI" 14290976 "DTC_AIN_HPWR_FAIL_LO" 14290977 "DTC_AIN_HPWR_FAIL_HI" 14290978 "DTC_AIN_HPWR_OOR_LO" 14290979 "DTC_AIN_HPWR_OOR_HI" 14290992 "DTC_AIN_6V_FAIL_LO" 14290993 "DTC_AIN_6V_FAIL_HI" 14290994 "DTC_AIN_6V_OOR_LO" 14290995 "DTC_AIN_6V_OOR_HI" 14291008 "DTC_AIN_HVIL_FAIL_LO" 14291009 "DTC_AIN_HVIL_FAIL_HI" 14291010 "DTC_AIN_HVIL_OOR_LO" 14291011 "DTC_AIN_HVIL_OOR_HI" 14291024 "DTC_AIN_5V_PWR_FAIL_LO" 14291025 "DTC_AIN_5V_PWR_FAIL_HI" 14291026 "DTC_AIN_5V_PWR_OOR_LO" 14291027 "DTC_AIN_5V_PWR_OOR_HI" 14291040 "DTC_AIN_LEM_HI_FAIL_LO" 14291041 "DTC_AIN_LEM_HI_FAIL_HI" 14291042 "DTC_AIN_LEM_HI_OOR_LO" 14291043 "DTC_AIN_LEM_HI_OOR_HI" 14291056 "DTC_AIN_LEM_LO_FAIL_LO" 14291057 "DTC_AIN_LEM_LO_FAIL_HI" 14291058 "DTC_AIN_LEM_LO_OOR_LO" 14291059 "DTC_AIN_LEM_LO_OOR_HI" 14291072 "DTC_AIN_BCT_AI_FAIL_LO" 14291073 "DTC_AIN_BCT_AI_FAIL_HI" 14291074 "DTC_AIN_BCT_AI_OOR_LO" 14291075 "DTC_AIN_BCT_AI_OOR_HI" 14291088 "DTC_AIN_WTR2_AI_FAIL_LO" 14291089 "DTC_AIN_WTR2_AI_FAIL_HI" 14291090 "DTC_AIN_WTR2_AI_OOR_LO" 14291091 "DTC_AIN_WTR2_AI_OOR_HI" 14291104 "DTC_AIN_WTR1_AI_FAIL_LO" 14291105 "DTC_AIN_WTR1_AI_FAIL_HI" 14291106 "DTC_AIN_WTR1_AI_OOR_LO" 14291107 "DTC_AIN_WTR1_AI_OOR_HI" 14291120 "DTC_AIN_AIA_FAIL_LO" 14291121 "DTC_AIN_AIA_FAIL_HI" 14291122 "DTC_AIN_AIA_OOR_LO" 14291123 "DTC_AIN_AIA_OOR_HI" 14291136 "DTC_AIN_PROX_AI_FAIL_LO" 14291137 "DTC_AIN_PROX_AI_FAIL_HI" 14291138 "DTC_AIN_PROX_AI_OOR_LO" 14291139 "DTC_AIN_PROX_AI_OOR_HI" 14291152 "DTC_AIN_TWV_FB_FAIL_LO" 14291153 "DTC_AIN_TWV_FB_FAIL_HI" 14291154 "DTC_AIN_TWV_FB_OOR_LO" 14291155 "DTC_AIN_TWV_FB_OOR_HI" 14291168 "DTC_AIN_5V_KA_FAIL_LO" 14291169 "DTC_AIN_5V_KA_FAIL_HI" 14291170 "DTC_AIN_5V_KA_OOR_LO" 14291171 "DTC_AIN_5V_KA_OOR_HI" 14291184 "DTC_AIN_CTR1_LSD_FAIL_LO" 14291185 "DTC_AIN_CTR1_LSD_FAIL_HI" 14291186 "DTC_AIN_CTR1_LSD_OOR_LO" 14291187 "DTC_AIN_CTR1_LSD_OOR_HI" 14291200 "DTC_AIN_CTR2_LSD_FAIL_LO" 14291201 "DTC_AIN_CTR2_LSD_FAIL_HI" 14291202 "DTC_AIN_CTR2_LSD_OOR_LO" 14291203 "DTC_AIN_CTR2_LSD_OOR_HI" 14291216 "DTC_AIN_CTR3_LSD_FAIL_LO" 14291217 "DTC_AIN_CTR3_LSD_FAIL_HI" 14291218 "DTC_AIN_CTR3_LSD_OOR_LO" 14291219 "DTC_AIN_CTR3_LSD_OOR_HI" 14291232 "DTC_AIN_CTR4_LSD_FAIL_LO" 14291233 "DTC_AIN_CTR4_LSD_FAIL_HI" 14291234 "DTC_AIN_CTR4_LSD_OOR_LO" 14291235 "DTC_AIN_CTR4_LSD_OOR_HI" 14291248 "DTC_AIN_CTR5_LSD_FAIL_LO" 14291249 "DTC_AIN_CTR5_LSD_FAIL_HI" 14291250 "DTC_AIN_CTR5_LSD_OOR_LO" 14291251 "DTC_AIN_CTR5_LSD_OOR_HI" 14291264 "DTC_AIN_CTR6_LSD_FAIL_LO" 14291265 "DTC_AIN_CTR6_LSD_FAIL_HI" 14291266 "DTC_AIN_CTR6_LSD_OOR_LO" 14291267 "DTC_AIN_CTR6_LSD_OOR_HI" 14291280 "DTC_AIN_CTR7_LSD_FAIL_LO" 14291281 "DTC_AIN_CTR7_LSD_FAIL_HI" 14291282 "DTC_AIN_CTR7_LSD_OOR_LO" 14291283 "DTC_AIN_CTR7_LSD_OOR_HI" 14291296 "DTC_AIN_CTR_PWR_CUR_FAIL_LO" 14291297 "DTC_AIN_CTR_PWR_CUR_FAIL_HI" 14291298 "DTC_AIN_CTR_PWR_CUR_OOR_LO" 14291299 "DTC_AIN_CTR_PWR_CUR_OOR_HI" 14291312 "DTC_AIN_CTR_HLD_CUR_FAIL_LO" 14291313 "DTC_AIN_CTR_HLD_CUR_FAIL_HI" 14291314 "DTC_AIN_CTR_HLD_CUR_OOR_LO" 14291315 "DTC_AIN_CTR_HLD_CUR_OOR_HI" 13431040 "DTC_CTR_FAULT_LATCH" 13431041 "DTC_CTR_FAULT_INVALID_HEARTBEAT" 13373440 "DTC_CTR1_LSD_FAILED_LO" 13373441 "DTC_CTR1_LSD_FAILED_HI" 13373442 "DTC_CTR1_HSD_FAILED_LO" 13373443 "DTC_CTR1_HSD_FAILED_HI" 13373444 "DTC_CTR1_PULL_IN_SHORT" 13373445 "DTC_CTR1_PULL_IN_OPEN" 13373446 "DTC_CTR1_COIL_INVALID" 13373447 "DTC_CTR1_COIL_OPEN" 13373448 "DTC_CTR1_CIRCUIT_FAILED" 13377536 "DTC_CTR2_LSD_FAILED_LO" 13377537 "DTC_CTR2_LSD_FAILED_HI" 13377538 "DTC_CTR2_HSD_FAILED_LO" 13377539 "DTC_CTR2_HSD_FAILED_HI" 13377540 "DTC_CTR2_PULL_IN_SHORT" 13377541 "DTC_CTR2_PULL_IN_OPEN" 13377542 "DTC_CTR2_COIL_INVALID" 13377543 "DTC_CTR2_COIL_OPEN" 13377544 "DTC_CTR2_CIRCUIT_FAILED" 13381632 "DTC_CTR3_LSD_FAILED_LO" 13381633 "DTC_CTR3_LSD_FAILED_HI" 13381634 "DTC_CTR3_HSD_FAILED_LO" 13381635 "DTC_CTR3_HSD_FAILED_HI" 13381636 "DTC_CTR3_PULL_IN_SHORT" 13381637 "DTC_CTR3_PULL_IN_OPEN" 13381638 "DTC_CTR3_COIL_INVALID" 13381639 "DTC_CTR3_COIL_OPEN" 13381640 "DTC_CTR3_CIRCUIT_FAILED" 13385728 "DTC_CTR4_LSD_FAILED_LO" 13385729 "DTC_CTR4_LSD_FAILED_HI" 13385730 "DTC_CTR4_HSD_FAILED_LO" 13385731 "DTC_CTR4_HSD_FAILED_HI" 13385732 "DTC_CTR4_PULL_IN_SHORT" 13385733 "DTC_CTR4_PULL_IN_OPEN" 13385734 "DTC_CTR4_COIL_INVALID" 13385735 "DTC_CTR4_COIL_OPEN" 13385736 "DTC_CTR4_CIRCUIT_FAILED" 13389824 "DTC_CTR5_LSD_FAILED_LO" 13389825 "DTC_CTR5_LSD_FAILED_HI" 13389826 "DTC_CTR5_HSD_FAILED_LO" 13389827 "DTC_CTR5_HSD_FAILED_HI" 13389828 "DTC_CTR5_PULL_IN_SHORT" 13389829 "DTC_CTR5_PULL_IN_OPEN" 13389830 "DTC_CTR5_COIL_INVALID" 13389831 "DTC_CTR5_COIL_OPEN" 13389832 "DTC_CTR5_CIRCUIT_FAILED" 13393920 "DTC_CTR6_LSD_FAILED_LO" 13393921 "DTC_CTR6_LSD_FAILED_HI" 13393922 "DTC_CTR6_HSD_FAILED_LO" 13393923 "DTC_CTR6_HSD_FAILED_HI" 13393924 "DTC_CTR6_PULL_IN_SHORT" 13393925 "DTC_CTR6_PULL_IN_OPEN" 13393926 "DTC_CTR6_COIL_INVALID" 13393927 "DTC_CTR6_COIL_OPEN" 13393928 "DTC_CTR6_CIRCUIT_FAILED" 13398016 "DTC_CTR7_LSD_FAILED_LO" 13398017 "DTC_CTR7_LSD_FAILED_HI" 13398018 "DTC_CTR7_HSD_FAILED_LO" 13398019 "DTC_CTR7_HSD_FAILED_HI" 13398020 "DTC_CTR7_PULL_IN_SHORT" 13398021 "DTC_CTR7_PULL_IN_OPEN" 13398022 "DTC_CTR7_COIL_INVALID" 13398023 "DTC_CTR7_COIL_OPEN" 13398024 "DTC_CTR7_CIRCUIT_FAILED" 14483456 "DTC_DRV_SW14V_PWR_FAILED_LO" 14483457 "DTC_DRV_SW14V_PWR_FAILED_HI" 14483472 "DTC_DRV_CHRGA_ENA_FAILED_LO" 14483473 "DTC_DRV_CHRGA_ENA_FAILED_HI" 14483488 "DTC_DRV_CHRGB_ENA_FAILED_LO" 14483489 "DTC_DRV_CHRGB_ENA_FAILED_HI" 14483504 "DTC_DRV_LSDA_FAILED_LO" 14483505 "DTC_DRV_LSDA_FAILED_HI" 14483520 "DTC_DRV_LSDB_FAILED_LO" 14483521 "DTC_DRV_LSDB_FAILED_HI" 14483536 "DTC_DRV_HSDA_FAILED_LO" 14483537 "DTC_DRV_HSDA_FAILED_HI" 14483552 "DTC_DRV_HSDB_FAILED_LO" 14483553 "DTC_DRV_HSDB_FAILED_HI" 14553088 "DTC_ICM_FGD1_FAIL_LO" 14553089 "DTC_ICM_FGD1_FAIL_HI" 14553090 "DTC_ICM_FGD1_OOR_LO" 14553091 "DTC_ICM_FGD1_OOR_HI" 14553104 "DTC_ICM_FGD2_FAIL_LO" 14553105 "DTC_ICM_FGD2_FAIL_HI" 14553106 "DTC_ICM_FGD2_OOR_LO" 14553107 "DTC_ICM_FGD2_OOR_HI" 14553120 "DTC_ICM_PILOT_FAIL_LO" 14553121 "DTC_ICM_PILOT_FAIL_HI" 14553122 "DTC_ICM_PILOT_OOR_LO" 14553123 "DTC_ICM_PILOT_OOR_HI" 14553136 "DTC_ICM_MOD_FLT_FAIL_LO" 14553137 "DTC_ICM_MOD_FLT_FAIL_HI" 14553138 "DTC_ICM_MOD_FLT_OOR_LO" 14553139 "DTC_ICM_MOD_FLT_OOR_HI" 14553152 "DTC_ICM_CLK_FAIL_LO" 14553153 "DTC_ICM_CLK_FAIL_HI" 14553154 "DTC_ICM_CLK_OOR_LO" 14553155 "DTC_ICM_CLK_OOR_HI" 14553168 "DTC_ICM_LSD_A_FAIL_LO" 14553169 "DTC_ICM_LSD_A_FAIL_HI" 14553170 "DTC_ICM_LSD_A_OOR_LO" 14553171 "DTC_ICM_LSD_A_OOR_HI" 14553184 "DTC_ICM_LSD_B_FAIL_LO" 14553185 "DTC_ICM_LSD_B_FAIL_HI" 14553186 "DTC_ICM_LSD_B_OOR_LO" 14553187 "DTC_ICM_LSD_B_OOR_HI" 14553200 "DTC_ICM_PWM_A_FAIL_LO" 14553201 "DTC_ICM_PWM_A_FAIL_HI" 14553202 "DTC_ICM_PWM_A_OOR_LO" 14553203 "DTC_ICM_PWM_A_OOR_HI" 14553216 "DTC_ICM_PWM_B_FAIL_LO" 14553217 "DTC_ICM_PWM_B_FAIL_HI" 14553218 "DTC_ICM_PWM_B_OOR_LO" 14553219 "DTC_ICM_PWM_B_OOR_HI" 14553232 "DTC_ICM_PWM_C_FAIL_LO" 14553233 "DTC_ICM_PWM_C_FAIL_HI" 14553234 "DTC_ICM_PWM_C_OOR_LO" 14553235 "DTC_ICM_PWM_C_OOR_HI" 14553248 "DTC_ICM_PWM_D_FAIL_LO" 14553249 "DTC_ICM_PWM_D_FAIL_HI" 14553250 "DTC_ICM_PWM_D_OOR_LO" 14553251 "DTC_ICM_PWM_D_OOR_HI" 14606336 "DTC_NVM_EE_0_COMM_WRITE_TO" 14606337 "DTC_NVM_EE_0_COMM_READ_TO" 14606338 "DTC_NVM_EE_0_WRITE_VERIFY" 14606339 "DTC_NVM_EE_0_READ_VERIFY" 14606340 "DTC_NVM_EE_0_READ_ERR" 14606341 "DTC_NVM_EE_0_WRITE_ERR" 14564800 "DTC_PWM_LSD_A_DC_MISMATCH" 14565344 "DTC_PWM_LSD_A_FREQ_MISMATCH" 14564801 "DTC_PWM_PWM_A_DC_MISMATCH" 14565345 "DTC_PWM_PWM_A_FREQ_MISMATCH" 14564802 "DTC_PWM_PWM_B_DC_MISMATCH" 14565346 "DTC_PWM_PWM_B_FREQ_MISMATCH" 14564803 "DTC_PWM_PWM_C_DC_MISMATCH" 14565347 "DTC_PWM_PWM_C_FREQ_MISMATCH" 14564804 "DTC_PWM_PWM_D_DC_MISMATCH" 14565348 "DTC_PWM_PWM_D_FREQ_MISMATCH" 14417920 "DTC_PWR_WAKEUP_CLK_FAILED" 14417921 "DTC_PWR_WAKEUP_CLK_OOR_LO" 14417922 "DTC_PWR_WAKEUP_CLK_OOR_HI" 14614570 "DTC_SDP_HPWR_OOR_HI" 14614571 "DTC_SDP_HPWR_OOR_LO" 14614572 "DTC_SDP_HPWR_COMM_TO" 14614573 "DTC_SDP_DEVICE_FAILURE";
VAL_ 1120 bcm_dtc_074 0 " - " 11276288 "DTC_VEPO" 11276289 "DTC_HSC_MISSING" 11460608 "DTC_NVM_SOC" 11460609 "DTC_NVM_HYST" 11460610 "DTC_NVM_KOT" 11460611 "DTC_NVM_PERIODIC_SHUTDOWN_TIME" 11460612 "DTC_NVM_WAKE" 11460613 "DTC_NVM_CALENDAR_LIFE" 11460614 "DTC_NVM_CYCLE_LIFE" 11460615 "DTC_NVM_DTC" 11460616 "DTC_NVM_APP_SCRATCHPAD" 11517962 "DTC_LOOPTIME_TASK_A" 11517963 "DTC_LOOPTIME_TASK_B" 11517964 "DTC_LOOPTIME_TASK_C" 11517965 "DTC_LOOPTIME_TASK_D" 11517966 "DTC_LOOPTIME_TASK_E" 11517967 "DTC_ILIM_MAX_DISCHARGE" 15728640 "DTC_EPO" 16171008 "DTC_CONT_OPEN" 16171009 "DTC_CONT_CLOSE" 16171010 "DTC_CONT_OPEN_CURRENT" 16171264 "DTC_CONT_CLOSE_ON_RESET" 16171265 "DTC_CONT_CLOSE_SIG_FAILED" 16171520 "DTC_PRECHARGE_TIMEOUT" 16171777 "DTC_CONT_NEG_WELD_AT_SU" 16171778 "DTC_CONT_POS_A_WELD_AT_SU" 16171779 "DTC_CONT_POS_B_WELD_AT_SU" 16172033 "DTC_CONT_NEG_WELD_AT_SD" 16172034 "DTC_CONT_POS_A_WELD_AT_SD" 16172036 "DTC_CONT_POS_B_WELD_AT_SD" 16172289 "DTC_CONT_NEG_OPEN" 16172290 "DTC_CONT_POS_A_OPEN" 16172291 "DTC_CONT_POS_B_OPEN" 16172545 "DTC_CONT_NEG_VDIF" 16172546 "DTC_CONT_POS_A_VDIF" 16172548 "DTC_CONT_POS_B_VDIF" 16174848 "DTC_HVIL" 16174849 "DTC_LVBAT_LO" 16174850 "DTC_LVBAT_HI" 16174851 "DTC_LVBAT_ERR" 16522240 "DTC_CSM_MISSING" 16522752 "DTC_CSM_VBAT" 16522753 "DTC_CSM_VPOS" 16522754 "DTC_CSM_VNEG" 16522755 "DTC_CSM_CPOS" 16522756 "DTC_CSM_CNEG" 16522757 "DTC_CSM_APOS" 16522758 "DTC_CSM_ANEG" 16522759 "DTC_CSM_FUSE_HI" 16522760 "DTC_CSM_FUSE_LO" 16521728 "DTC_CSM_ASIC" 16521729 "DTC_CSM_AILO" 16521730 "DTC_CSM_AIHI" 16520957 "DTC_LEAKAGE_DETECT_FAULT" 16522444 "DTC_REALTIMECLOCK_FAULT" 16520945 "DTC_CSM_LEAK_FAIL_CALC" 16520946 "DTC_CSM_LEAK_FAIL_HW" 16520947 "DTC_CSM_LEAK_EXT_SHORT" 16520948 "DTC_CSM_LEAK_MID_PACK_SHORT" 16520949 "DTC_CSM_LEAK_ERROR" 16520950 "DTC_CSM_LEAK_UNKNOWN" 16523008 "DTC_CSM_VER_MISMATCH" 16523009 "DTC_CSM_DTC_SET" 16523010 "DTC_CSM_CAL_FAULT" 16496320 "DTC_MBB_TOO_FEW" 16496321 "DTC_MBB_TOO_MANY" 16496352 "DTC_CELL_VMAX_ERR" 16496353 "DTC_CELL_VMIN_ERR" 16496354 "DTC_CELL_VMAX" 16496362 "DTC_CELL_VMAX_SEVERE" 16496355 "DTC_CELL_VMIN" 16496363 "DTC_CELL_VMIN_SEVERE" 16496356 "DTC_MOD_VOLTAGE_COMPARE" 16496336 "DTC_CELL_T_ERR" 16496337 "DTC_CELL_TMAX1" 16496338 "DTC_CELL_TMAX2" 16496339 "DTC_CELL_TMIN" 16497665 "DTC_MBB_01_MISSING" 16497666 "DTC_MBB_02_MISSING" 16497667 "DTC_MBB_03_MISSING" 16497668 "DTC_MBB_04_MISSING" 16497669 "DTC_MBB_05_MISSING" 16497670 "DTC_MBB_06_MISSING" 16497671 "DTC_MBB_07_MISSING" 16497672 "DTC_MBB_08_MISSING" 16497673 "DTC_MBB_09_MISSING" 16497680 "DTC_MBB_10_MISSING" 16497681 "DTC_MBB_11_MISSING" 16497682 "DTC_MBB_12_MISSING" 16497683 "DTC_MBB_13_MISSING" 16497684 "DTC_MBB_14_MISSING" 16497685 "DTC_MBB_15_MISSING" 16497686 "DTC_MBB_16_MISSING" 16497687 "DTC_MBB_17_MISSING" 16497688 "DTC_MBB_18_MISSING" 16497689 "DTC_MBB_19_MISSING" 16497696 "DTC_MBB_20_MISSING" 16497697 "DTC_MBB_21_MISSING" 16497698 "DTC_MBB_22_MISSING" 16497699 "DTC_MBB_23_MISSING" 16497700 "DTC_MBB_24_MISSING" 16498177 "DTC_MBB_01_VFAULT" 16498178 "DTC_MBB_02_VFAULT" 16498179 "DTC_MBB_03_VFAULT" 16498180 "DTC_MBB_04_VFAULT" 16498181 "DTC_MBB_05_VFAULT" 16498182 "DTC_MBB_06_VFAULT" 16498183 "DTC_MBB_07_VFAULT" 16498184 "DTC_MBB_08_VFAULT" 16498185 "DTC_MBB_09_VFAULT" 16498192 "DTC_MBB_10_VFAULT" 16498193 "DTC_MBB_11_VFAULT" 16498194 "DTC_MBB_12_VFAULT" 16498195 "DTC_MBB_13_VFAULT" 16498196 "DTC_MBB_14_VFAULT" 16498197 "DTC_MBB_15_VFAULT" 16498198 "DTC_MBB_16_VFAULT" 16498199 "DTC_MBB_17_VFAULT" 16498200 "DTC_MBB_18_VFAULT" 16498201 "DTC_MBB_19_VFAULT" 16498208 "DTC_MBB_20_VFAULT" 16498209 "DTC_MBB_21_VFAULT" 16498210 "DTC_MBB_22_VFAULT" 16498211 "DTC_MBB_23_VFAULT" 16498212 "DTC_MBB_24_VFAULT" 16497921 "DTC_MBB_01_TFAULT" 16497922 "DTC_MBB_02_TFAULT" 16497923 "DTC_MBB_03_TFAULT" 16497924 "DTC_MBB_04_TFAULT" 16497925 "DTC_MBB_05_TFAULT" 16497926 "DTC_MBB_06_TFAULT" 16497927 "DTC_MBB_07_TFAULT" 16497928 "DTC_MBB_08_TFAULT" 16497929 "DTC_MBB_09_TFAULT" 16497936 "DTC_MBB_10_TFAULT" 16497937 "DTC_MBB_11_TFAULT" 16497938 "DTC_MBB_12_TFAULT" 16497939 "DTC_MBB_13_TFAULT" 16497940 "DTC_MBB_14_TFAULT" 16497941 "DTC_MBB_15_TFAULT" 16497942 "DTC_MBB_16_TFAULT" 16497943 "DTC_MBB_17_TFAULT" 16497944 "DTC_MBB_18_TFAULT" 16497945 "DTC_MBB_19_TFAULT" 16497952 "DTC_MBB_20_TFAULT" 16497953 "DTC_MBB_21_TFAULT" 16497954 "DTC_MBB_22_TFAULT" 16497955 "DTC_MBB_23_TFAULT" 16497956 "DTC_MBB_24_TFAULT" 16498688 "DTC_BRUSA_MISSING" 16498689 "DTC_BRUSA_IDC" 16498690 "DTC_BRUSA_REQ_VS_CMD" 16560128 "DTC_IBAT_MISMATCH" 16576512 "DTC_DIS_MAX_I2T" 16576513 "DTC_CHG_MAX_I2T" 16576768 "DTC_DIS_WARNING_I2T" 16576769 "DTC_CHG_WARNING_I2T" 16523520 "DTC_LEM_A_OOR_HI" 16523521 "DTC_LEM_A_OOR_LO" 16523522 "DTC_LEM_A_FAULT" 16523776 "DTC_LEM_B_OOR_HI" 16523777 "DTC_LEM_B_OOR_LO" 16523778 "DTC_LEM_B_FAULT" 16506880 "DTC_VBAT_MISMATCH" 16506881 "DTC_VBAT_VMAX" 16506882 "DTC_VBAT_VMIN" 16506883 "DTC_PACK_FUSE_A" 16506884 "DTC_PACK_FUSE_B" 16252928 "DTC_KEY_OFF_TIME_ERROR" 16252929 "DTC_PERIODIC_OFF_TIME_ERROR" 14290944 "DTC_AIN_BPWR_FAIL_LO" 14290945 "DTC_AIN_BPWR_FAIL_HI" 14290946 "DTC_AIN_BPWR_OOR_LO" 14290947 "DTC_AIN_BPWR_OOR_HI" 14290960 "DTC_AIN_14V_FAIL_LO" 14290961 "DTC_AIN_14V_FAIL_HI" 14290962 "DTC_AIN_14V_OOR_LO" 14290963 "DTC_AIN_14V_OOR_HI" 14290976 "DTC_AIN_HPWR_FAIL_LO" 14290977 "DTC_AIN_HPWR_FAIL_HI" 14290978 "DTC_AIN_HPWR_OOR_LO" 14290979 "DTC_AIN_HPWR_OOR_HI" 14290992 "DTC_AIN_6V_FAIL_LO" 14290993 "DTC_AIN_6V_FAIL_HI" 14290994 "DTC_AIN_6V_OOR_LO" 14290995 "DTC_AIN_6V_OOR_HI" 14291008 "DTC_AIN_HVIL_FAIL_LO" 14291009 "DTC_AIN_HVIL_FAIL_HI" 14291010 "DTC_AIN_HVIL_OOR_LO" 14291011 "DTC_AIN_HVIL_OOR_HI" 14291024 "DTC_AIN_5V_PWR_FAIL_LO" 14291025 "DTC_AIN_5V_PWR_FAIL_HI" 14291026 "DTC_AIN_5V_PWR_OOR_LO" 14291027 "DTC_AIN_5V_PWR_OOR_HI" 14291040 "DTC_AIN_LEM_HI_FAIL_LO" 14291041 "DTC_AIN_LEM_HI_FAIL_HI" 14291042 "DTC_AIN_LEM_HI_OOR_LO" 14291043 "DTC_AIN_LEM_HI_OOR_HI" 14291056 "DTC_AIN_LEM_LO_FAIL_LO" 14291057 "DTC_AIN_LEM_LO_FAIL_HI" 14291058 "DTC_AIN_LEM_LO_OOR_LO" 14291059 "DTC_AIN_LEM_LO_OOR_HI" 14291072 "DTC_AIN_BCT_AI_FAIL_LO" 14291073 "DTC_AIN_BCT_AI_FAIL_HI" 14291074 "DTC_AIN_BCT_AI_OOR_LO" 14291075 "DTC_AIN_BCT_AI_OOR_HI" 14291088 "DTC_AIN_WTR2_AI_FAIL_LO" 14291089 "DTC_AIN_WTR2_AI_FAIL_HI" 14291090 "DTC_AIN_WTR2_AI_OOR_LO" 14291091 "DTC_AIN_WTR2_AI_OOR_HI" 14291104 "DTC_AIN_WTR1_AI_FAIL_LO" 14291105 "DTC_AIN_WTR1_AI_FAIL_HI" 14291106 "DTC_AIN_WTR1_AI_OOR_LO" 14291107 "DTC_AIN_WTR1_AI_OOR_HI" 14291120 "DTC_AIN_AIA_FAIL_LO" 14291121 "DTC_AIN_AIA_FAIL_HI" 14291122 "DTC_AIN_AIA_OOR_LO" 14291123 "DTC_AIN_AIA_OOR_HI" 14291136 "DTC_AIN_PROX_AI_FAIL_LO" 14291137 "DTC_AIN_PROX_AI_FAIL_HI" 14291138 "DTC_AIN_PROX_AI_OOR_LO" 14291139 "DTC_AIN_PROX_AI_OOR_HI" 14291152 "DTC_AIN_TWV_FB_FAIL_LO" 14291153 "DTC_AIN_TWV_FB_FAIL_HI" 14291154 "DTC_AIN_TWV_FB_OOR_LO" 14291155 "DTC_AIN_TWV_FB_OOR_HI" 14291168 "DTC_AIN_5V_KA_FAIL_LO" 14291169 "DTC_AIN_5V_KA_FAIL_HI" 14291170 "DTC_AIN_5V_KA_OOR_LO" 14291171 "DTC_AIN_5V_KA_OOR_HI" 14291184 "DTC_AIN_CTR1_LSD_FAIL_LO" 14291185 "DTC_AIN_CTR1_LSD_FAIL_HI" 14291186 "DTC_AIN_CTR1_LSD_OOR_LO" 14291187 "DTC_AIN_CTR1_LSD_OOR_HI" 14291200 "DTC_AIN_CTR2_LSD_FAIL_LO" 14291201 "DTC_AIN_CTR2_LSD_FAIL_HI" 14291202 "DTC_AIN_CTR2_LSD_OOR_LO" 14291203 "DTC_AIN_CTR2_LSD_OOR_HI" 14291216 "DTC_AIN_CTR3_LSD_FAIL_LO" 14291217 "DTC_AIN_CTR3_LSD_FAIL_HI" 14291218 "DTC_AIN_CTR3_LSD_OOR_LO" 14291219 "DTC_AIN_CTR3_LSD_OOR_HI" 14291232 "DTC_AIN_CTR4_LSD_FAIL_LO" 14291233 "DTC_AIN_CTR4_LSD_FAIL_HI" 14291234 "DTC_AIN_CTR4_LSD_OOR_LO" 14291235 "DTC_AIN_CTR4_LSD_OOR_HI" 14291248 "DTC_AIN_CTR5_LSD_FAIL_LO" 14291249 "DTC_AIN_CTR5_LSD_FAIL_HI" 14291250 "DTC_AIN_CTR5_LSD_OOR_LO" 14291251 "DTC_AIN_CTR5_LSD_OOR_HI" 14291264 "DTC_AIN_CTR6_LSD_FAIL_LO" 14291265 "DTC_AIN_CTR6_LSD_FAIL_HI" 14291266 "DTC_AIN_CTR6_LSD_OOR_LO" 14291267 "DTC_AIN_CTR6_LSD_OOR_HI" 14291280 "DTC_AIN_CTR7_LSD_FAIL_LO" 14291281 "DTC_AIN_CTR7_LSD_FAIL_HI" 14291282 "DTC_AIN_CTR7_LSD_OOR_LO" 14291283 "DTC_AIN_CTR7_LSD_OOR_HI" 14291296 "DTC_AIN_CTR_PWR_CUR_FAIL_LO" 14291297 "DTC_AIN_CTR_PWR_CUR_FAIL_HI" 14291298 "DTC_AIN_CTR_PWR_CUR_OOR_LO" 14291299 "DTC_AIN_CTR_PWR_CUR_OOR_HI" 14291312 "DTC_AIN_CTR_HLD_CUR_FAIL_LO" 14291313 "DTC_AIN_CTR_HLD_CUR_FAIL_HI" 14291314 "DTC_AIN_CTR_HLD_CUR_OOR_LO" 14291315 "DTC_AIN_CTR_HLD_CUR_OOR_HI" 13431040 "DTC_CTR_FAULT_LATCH" 13431041 "DTC_CTR_FAULT_INVALID_HEARTBEAT" 13373440 "DTC_CTR1_LSD_FAILED_LO" 13373441 "DTC_CTR1_LSD_FAILED_HI" 13373442 "DTC_CTR1_HSD_FAILED_LO" 13373443 "DTC_CTR1_HSD_FAILED_HI" 13373444 "DTC_CTR1_PULL_IN_SHORT" 13373445 "DTC_CTR1_PULL_IN_OPEN" 13373446 "DTC_CTR1_COIL_INVALID" 13373447 "DTC_CTR1_COIL_OPEN" 13373448 "DTC_CTR1_CIRCUIT_FAILED" 13377536 "DTC_CTR2_LSD_FAILED_LO" 13377537 "DTC_CTR2_LSD_FAILED_HI" 13377538 "DTC_CTR2_HSD_FAILED_LO" 13377539 "DTC_CTR2_HSD_FAILED_HI" 13377540 "DTC_CTR2_PULL_IN_SHORT" 13377541 "DTC_CTR2_PULL_IN_OPEN" 13377542 "DTC_CTR2_COIL_INVALID" 13377543 "DTC_CTR2_COIL_OPEN" 13377544 "DTC_CTR2_CIRCUIT_FAILED" 13381632 "DTC_CTR3_LSD_FAILED_LO" 13381633 "DTC_CTR3_LSD_FAILED_HI" 13381634 "DTC_CTR3_HSD_FAILED_LO" 13381635 "DTC_CTR3_HSD_FAILED_HI" 13381636 "DTC_CTR3_PULL_IN_SHORT" 13381637 "DTC_CTR3_PULL_IN_OPEN" 13381638 "DTC_CTR3_COIL_INVALID" 13381639 "DTC_CTR3_COIL_OPEN" 13381640 "DTC_CTR3_CIRCUIT_FAILED" 13385728 "DTC_CTR4_LSD_FAILED_LO" 13385729 "DTC_CTR4_LSD_FAILED_HI" 13385730 "DTC_CTR4_HSD_FAILED_LO" 13385731 "DTC_CTR4_HSD_FAILED_HI" 13385732 "DTC_CTR4_PULL_IN_SHORT" 13385733 "DTC_CTR4_PULL_IN_OPEN" 13385734 "DTC_CTR4_COIL_INVALID" 13385735 "DTC_CTR4_COIL_OPEN" 13385736 "DTC_CTR4_CIRCUIT_FAILED" 13389824 "DTC_CTR5_LSD_FAILED_LO" 13389825 "DTC_CTR5_LSD_FAILED_HI" 13389826 "DTC_CTR5_HSD_FAILED_LO" 13389827 "DTC_CTR5_HSD_FAILED_HI" 13389828 "DTC_CTR5_PULL_IN_SHORT" 13389829 "DTC_CTR5_PULL_IN_OPEN" 13389830 "DTC_CTR5_COIL_INVALID" 13389831 "DTC_CTR5_COIL_OPEN" 13389832 "DTC_CTR5_CIRCUIT_FAILED" 13393920 "DTC_CTR6_LSD_FAILED_LO" 13393921 "DTC_CTR6_LSD_FAILED_HI" 13393922 "DTC_CTR6_HSD_FAILED_LO" 13393923 "DTC_CTR6_HSD_FAILED_HI" 13393924 "DTC_CTR6_PULL_IN_SHORT" 13393925 "DTC_CTR6_PULL_IN_OPEN" 13393926 "DTC_CTR6_COIL_INVALID" 13393927 "DTC_CTR6_COIL_OPEN" 13393928 "DTC_CTR6_CIRCUIT_FAILED" 13398016 "DTC_CTR7_LSD_FAILED_LO" 13398017 "DTC_CTR7_LSD_FAILED_HI" 13398018 "DTC_CTR7_HSD_FAILED_LO" 13398019 "DTC_CTR7_HSD_FAILED_HI" 13398020 "DTC_CTR7_PULL_IN_SHORT" 13398021 "DTC_CTR7_PULL_IN_OPEN" 13398022 "DTC_CTR7_COIL_INVALID" 13398023 "DTC_CTR7_COIL_OPEN" 13398024 "DTC_CTR7_CIRCUIT_FAILED" 14483456 "DTC_DRV_SW14V_PWR_FAILED_LO" 14483457 "DTC_DRV_SW14V_PWR_FAILED_HI" 14483472 "DTC_DRV_CHRGA_ENA_FAILED_LO" 14483473 "DTC_DRV_CHRGA_ENA_FAILED_HI" 14483488 "DTC_DRV_CHRGB_ENA_FAILED_LO" 14483489 "DTC_DRV_CHRGB_ENA_FAILED_HI" 14483504 "DTC_DRV_LSDA_FAILED_LO" 14483505 "DTC_DRV_LSDA_FAILED_HI" 14483520 "DTC_DRV_LSDB_FAILED_LO" 14483521 "DTC_DRV_LSDB_FAILED_HI" 14483536 "DTC_DRV_HSDA_FAILED_LO" 14483537 "DTC_DRV_HSDA_FAILED_HI" 14483552 "DTC_DRV_HSDB_FAILED_LO" 14483553 "DTC_DRV_HSDB_FAILED_HI" 14553088 "DTC_ICM_FGD1_FAIL_LO" 14553089 "DTC_ICM_FGD1_FAIL_HI" 14553090 "DTC_ICM_FGD1_OOR_LO" 14553091 "DTC_ICM_FGD1_OOR_HI" 14553104 "DTC_ICM_FGD2_FAIL_LO" 14553105 "DTC_ICM_FGD2_FAIL_HI" 14553106 "DTC_ICM_FGD2_OOR_LO" 14553107 "DTC_ICM_FGD2_OOR_HI" 14553120 "DTC_ICM_PILOT_FAIL_LO" 14553121 "DTC_ICM_PILOT_FAIL_HI" 14553122 "DTC_ICM_PILOT_OOR_LO" 14553123 "DTC_ICM_PILOT_OOR_HI" 14553136 "DTC_ICM_MOD_FLT_FAIL_LO" 14553137 "DTC_ICM_MOD_FLT_FAIL_HI" 14553138 "DTC_ICM_MOD_FLT_OOR_LO" 14553139 "DTC_ICM_MOD_FLT_OOR_HI" 14553152 "DTC_ICM_CLK_FAIL_LO" 14553153 "DTC_ICM_CLK_FAIL_HI" 14553154 "DTC_ICM_CLK_OOR_LO" 14553155 "DTC_ICM_CLK_OOR_HI" 14553168 "DTC_ICM_LSD_A_FAIL_LO" 14553169 "DTC_ICM_LSD_A_FAIL_HI" 14553170 "DTC_ICM_LSD_A_OOR_LO" 14553171 "DTC_ICM_LSD_A_OOR_HI" 14553184 "DTC_ICM_LSD_B_FAIL_LO" 14553185 "DTC_ICM_LSD_B_FAIL_HI" 14553186 "DTC_ICM_LSD_B_OOR_LO" 14553187 "DTC_ICM_LSD_B_OOR_HI" 14553200 "DTC_ICM_PWM_A_FAIL_LO" 14553201 "DTC_ICM_PWM_A_FAIL_HI" 14553202 "DTC_ICM_PWM_A_OOR_LO" 14553203 "DTC_ICM_PWM_A_OOR_HI" 14553216 "DTC_ICM_PWM_B_FAIL_LO" 14553217 "DTC_ICM_PWM_B_FAIL_HI" 14553218 "DTC_ICM_PWM_B_OOR_LO" 14553219 "DTC_ICM_PWM_B_OOR_HI" 14553232 "DTC_ICM_PWM_C_FAIL_LO" 14553233 "DTC_ICM_PWM_C_FAIL_HI" 14553234 "DTC_ICM_PWM_C_OOR_LO" 14553235 "DTC_ICM_PWM_C_OOR_HI" 14553248 "DTC_ICM_PWM_D_FAIL_LO" 14553249 "DTC_ICM_PWM_D_FAIL_HI" 14553250 "DTC_ICM_PWM_D_OOR_LO" 14553251 "DTC_ICM_PWM_D_OOR_HI" 14606336 "DTC_NVM_EE_0_COMM_WRITE_TO" 14606337 "DTC_NVM_EE_0_COMM_READ_TO" 14606338 "DTC_NVM_EE_0_WRITE_VERIFY" 14606339 "DTC_NVM_EE_0_READ_VERIFY" 14606340 "DTC_NVM_EE_0_READ_ERR" 14606341 "DTC_NVM_EE_0_WRITE_ERR" 14564800 "DTC_PWM_LSD_A_DC_MISMATCH" 14565344 "DTC_PWM_LSD_A_FREQ_MISMATCH" 14564801 "DTC_PWM_PWM_A_DC_MISMATCH" 14565345 "DTC_PWM_PWM_A_FREQ_MISMATCH" 14564802 "DTC_PWM_PWM_B_DC_MISMATCH" 14565346 "DTC_PWM_PWM_B_FREQ_MISMATCH" 14564803 "DTC_PWM_PWM_C_DC_MISMATCH" 14565347 "DTC_PWM_PWM_C_FREQ_MISMATCH" 14564804 "DTC_PWM_PWM_D_DC_MISMATCH" 14565348 "DTC_PWM_PWM_D_FREQ_MISMATCH" 14417920 "DTC_PWR_WAKEUP_CLK_FAILED" 14417921 "DTC_PWR_WAKEUP_CLK_OOR_LO" 14417922 "DTC_PWR_WAKEUP_CLK_OOR_HI" 14614570 "DTC_SDP_HPWR_OOR_HI" 14614571 "DTC_SDP_HPWR_OOR_LO" 14614572 "DTC_SDP_HPWR_COMM_TO" 14614573 "DTC_SDP_DEVICE_FAILURE";
