/************************************************
* ASAP2 file
* Generated by Raptor 4/17/2023 4:48:17 PM
* New Eagle, LLC 2012
* Machine: DESKTOP-OARROFR
* User : jerod
* OS : Microsoft Windows NT 6.2.9200.0
************************************************/ ASAP2_VERSION 1 51
/begin PROJECT Lightning_McSeas_VCU_OLD_CONTROLLER_Speed_Mode_050
/*LongIdentifier (BUILD_UID) */ "Ht5Bj0DH8UGLtEQSu7fnL"
/begin MODULE Lightning_McSeas_VCU_OLD_CONTROLLER_Speed_Mode
/*LongIdentifier (XCPProdID) */ "20038"
/begin IF_DATA XCP
 /begin PROTOCOL_LAYER /* XCP protocol layer version */ 0x100 /* T1 [ms] */ 2000 /* T2 [ms] */ 2000 /* T3 [ms] */ 2000 /* T4 [ms] */ 2000 /* T5 [ms] */ 2000 /* T6 [ms] */ 0050 /* T7 [ms] */ 0050 /* MAX_CTO */ 8 /* MAX_DTO */ 8 /* BYTE_ORDER */ BYTE_ORDER_MSB_FIRST /* ADDRESS_GRANULARITY */ ADDRESS_GRANULARITY_BYTE OPTIONAL_CMD SET_REQUEST OPTIONAL_CMD SET_MTA OPTIONAL_CMD UPLOAD OPTIONAL_CMD BUILD_CHECKSUM OPTIONAL_CMD TRANSPORT_LAYER_CMD OPTIONAL_CMD CLEAR_DAQ_LIST OPTIONAL_CMD SET_DAQ_PTR OPTIONAL_CMD WRITE_DAQ OPTIONAL_CMD SET_DAQ_LIST_MODE OPTIONAL_CMD START_STOP_DAQ_LIST OPTIONAL_CMD START_STOP_SYNCH OPTIONAL_CMD GET_DAQ_CLOCK OPTIONAL_CMD FREE_DAQ OPTIONAL_CMD ALLOC_DAQ OPTIONAL_CMD ALLOC_ODT OPTIONAL_CMD ALLOC_ODT_ENTRY OPTIONAL_CMD GET_SEED OPTIONAL_CMD UNLOCK OPTIONAL_CMD GET_DAQ_RESOLUTION_INFO OPTIONAL_CMD GET_DAQ_PROCESSOR_INFO OPTIONAL_CMD DOWNLOAD OPTIONAL_CMD GET_COMM_MODE_INFO
  /begin COMMUNICATION_MODE_SUPPORTED /begin BLOCK SLAVE MASTER /* MAX_BS */ 0xff /* MIN_ST */ 100 /end BLOCK /end COMMUNICATION_MODE_SUPPORTED
  SEED_AND_KEY_EXTERNAL_FUNCTION "raptor_XCPSecurity.dll" /end PROTOCOL_LAYER
 /begin DAQ /* DAQ_CONFIG_TYPE */ DYNAMIC /* MAX_DAQ */ 5 /* MAX_EVENT_CHANNEL */ 5 /* MIN_DAQ */ 0 /* OPTIMISATION_TYPE */ OPTIMISATION_TYPE_DEFAULT /* ADDRESS_EXTENSION */ ADDRESS_EXTENSION_DAQ /* IDENTIFICATION_FIELD */ IDENTIFICATION_FIELD_TYPE_ABSOLUTE /* GRANULARITY_ODT_ENTRY_SIZE_DAQ */ GRANULARITY_ODT_ENTRY_SIZE_DAQ_BYTE /* MAX_ODT_ENTRY_SIZE_DAQ */ 4 /* OVERLOAD_INDICATION */ NO_OVERLOAD_INDICATION
  /begin TIMESTAMP_SUPPORTED /* TIMESTAMP_TICKS */ 1 /* TIMESTAMP_SIZE */ SIZE_DWORD /* TIMESTAMP_RESOLUTION */ UNIT_1MS /end TIMESTAMP_SUPPORTED
  /begin EVENT "List_10ms" "List_10ms" 0 DAQ 20 10 6 0 /end EVENT
  /begin EVENT "List_50ms" "List_50ms" 1 DAQ 20 50 6 0 /end EVENT
  /begin EVENT "List_100ms" "List_100ms" 2 DAQ 20 100 6 0 /end EVENT
  /begin EVENT "List_500ms" "List_500ms" 3 DAQ 20 50 7 0 /end EVENT
  /begin EVENT "List_1000ms" "List_1000ms" 4 DAQ 20 100 7 0 /end EVENT
 /end DAQ
 /begin XCP_ON_CAN /* XCP on CAN 1.0 */ 0x0100 /* auto-detection -- Bit31= 1: EXT */ CAN_ID_BROADCAST 0x100 /* CMD/STIM (master -> slave) -- Bit31= 1: EXT */ CAN_ID_MASTER 0x200 /* RES/ERR/EV/SERV/DAQ (slave -> master) -- Bit31= 1: EXT */ CAN_ID_SLAVE 0x300 /* In Hz */ BAUDRATE 500000 /* Percentage of complete bit time. */ SAMPLE_POINT 75 SAMPLE_RATE SINGLE /* Slots per bit time. */ BTL_CYCLES 0 /* Length of the synch segment. */ SJW 2 /* Sync Edge */ SYNC_EDGE SINGLE /end XCP_ON_CAN
/end IF_DATA
/begin MOD_PAR /* COMMENT */ "" ECU_CALIBRATION_OFFSET 0x00000000 ADDR_EPK 0x00045905 EPK "Ht5Bj0DH8UGLtEQSu7fnL"
 /begin MEMORY_SEGMENT CODE "App Descriptor" CODE FLASH INTERN 0x00000000 0x00002000 -1 -1 -1 -1 -1
  /begin IF_DATA XCP
   /begin SEGMENT 5 0x01 0x00 0x00 0x00 /begin CHECKSUM XCP_CRC_16_CITT /end CHECKSUM /end SEGMENT
  /end IF_DATA
 /end MEMORY_SEGMENT
 /begin MEMORY_SEGMENT APP_CODE "Application Code" CODE FLASH INTERN 0x00002000 0x0003AF88 -1 -1 -1 -1 -1
  /begin IF_DATA XCP
   /begin SEGMENT 6 0x01 0x00 0x00 0x00 /begin CHECKSUM XCP_CRC_16_CITT /end CHECKSUM /end SEGMENT
  /end IF_DATA
 /end MEMORY_SEGMENT
 /begin MEMORY_SEGMENT EEPROM_CALS "Calibration Space" DATA EEPROM INTERN 0x0003CF88 0x0000002C -1 -1 -1 -1 -1
  /begin IF_DATA XCP
   /begin SEGMENT 1 0x01 0x00 0x00 0x00 /begin CHECKSUM XCP_CRC_16_CITT /end CHECKSUM /begin ADDRESS_MAPPING 0x0003CF88 0x40000FD8 0x0000002C /end ADDRESS_MAPPING /end SEGMENT
  /end IF_DATA
 /end MEMORY_SEGMENT
 /begin MEMORY_SEGMENT ConstFLASH "Const FLASH Space" CODE FLASH INTERN 0x00045848 0x000000F0 -1 -1 -1 -1 -1
  /begin IF_DATA XCP
   /begin SEGMENT 0 0x01 0x00 0x00 0x00 /begin CHECKSUM XCP_CRC_16_CITT /end CHECKSUM /end SEGMENT
  /end IF_DATA
 /end MEMORY_SEGMENT
 /begin MEMORY_SEGMENT LIB_CODE "Application Code" CODE FLASH INTERN 0x00045938 0x00000128 -1 -1 -1 -1 -1
  /begin IF_DATA XCP
   /begin SEGMENT 3 0x01 0x00 0x00 0x00 /begin CHECKSUM XCP_CRC_16_CITT /end CHECKSUM /end SEGMENT
  /end IF_DATA
 /end MEMORY_SEGMENT
 /begin MEMORY_SEGMENT MeasurmentRAM "Measurement Space" VARIABLES RAM INTERN 0x40000000 0x00038000 -1 -1 -1 -1 -1
  /begin IF_DATA XCP
   /begin SEGMENT 4 0x01 0x00 0x00 0x00 /begin CHECKSUM XCP_CRC_16_CITT /end CHECKSUM /end SEGMENT
  /end IF_DATA
 /end MEMORY_SEGMENT
 /* 0x00000000 - 0x00002000 : CODE */ /* 0x00002000 - 0x0003CF88 : APP_CODE */ /* 0x0003CF88 - 0x0003CFB4 : EEPROM_CALS */ /* 0x00045848 - 0x00045938 : ConstFLASH */ /* 0x00045938 - 0x00045A60 : LIB_CODE */ /* 0x40000000 - 0x40038000 : MeasurmentRAM */ /end MOD_PAR
/begin MOD_COMMON /* COMMENT */ "" BYTE_ORDER MSB_FIRST ALIGNMENT_BYTE 1 ALIGNMENT_FLOAT32_IEEE 1 ALIGNMENT_FLOAT64_IEEE 1 ALIGNMENT_LONG 1 ALIGNMENT_WORD 1 /end MOD_COMMON
/begin RECORD_LAYOUT RECORD_LAYOUT__3 FNC_VALUES 1 UBYTE ROW_DIR DIRECT /end RECORD_LAYOUT
/begin RECORD_LAYOUT RECORD_LAYOUT__1 FNC_VALUES 1 ULONG ROW_DIR DIRECT /end RECORD_LAYOUT
/begin RECORD_LAYOUT RECORD_LAYOUT__2 FNC_VALUES 1 UWORD ROW_DIR DIRECT /end RECORD_LAYOUT
/begin COMPU_METHOD COMPU_METHOD__12 "" RAT_FUNC "%3.0" "" COEFFS 0 1 0 0 0 1 /end COMPU_METHOD
/begin COMPU_METHOD COMPU_METHOD__3 "" RAT_FUNC "%3.3" "sec" COEFFS 0 1 0 0 0 0.1 /end COMPU_METHOD
/begin COMPU_METHOD COMPU_METHOD__14 "" RAT_FUNC "%4.0" "" COEFFS 0 1 0 0 0 1 /end COMPU_METHOD
/begin COMPU_METHOD COMPU_METHOD__2 "" RAT_FUNC "%5.0" "" COEFFS 0 1 0 0 0 1 /end COMPU_METHOD
/begin COMPU_METHOD COMPU_METHOD__10 "" RAT_FUNC "%5.0" "any wake source is keeping the module alive" COEFFS 0 1 0 0 0 1 /end COMPU_METHOD
/begin COMPU_METHOD COMPU_METHOD__6 "" RAT_FUNC "%5.0" "bool" COEFFS 0 1 0 0 0 1 /end COMPU_METHOD
/begin COMPU_METHOD COMPU_METHOD__1 "" RAT_FUNC "%5.0" "Bool" COEFFS 0 1 0 0 0 1 /end COMPU_METHOD
/begin COMPU_METHOD COMPU_METHOD__5 "" RAT_FUNC "%5.0" "milliseconds" COEFFS 0 1 0 0 0 1 /end COMPU_METHOD
/begin COMPU_METHOD COMPU_METHOD__8 "" RAT_FUNC "%5.0" "register" COEFFS 0 1 0 0 0 1 /end COMPU_METHOD
/begin COMPU_METHOD COMPU_METHOD__4 "" RAT_FUNC "%5.0" "V" COEFFS 0 1 0 0 0 1 /end COMPU_METHOD
/begin COMPU_METHOD COMPU_METHOD__9 "" RAT_FUNC "%5.0" "wake source at startup... kinda. it often reads that LIN work the module even if the LIN bus isnt connected." COEFFS 0 1 0 0 0 1 /end COMPU_METHOD
/begin COMPU_METHOD COMPU_METHOD__11 "" RAT_FUNC "%5.0" "wake source at the current instant" COEFFS 0 1 0 0 0 1 /end COMPU_METHOD
/begin COMPU_METHOD COMPU_METHOD__7 "" RAT_FUNC "%7.2" "" COEFFS 0 1 0 0 0 0.00927734375 /end COMPU_METHOD
/begin COMPU_METHOD COMPU_METHOD__16 "" TAB_VERB "%3.0" "" COMPU_TAB_REF COMPU_VTAB__3 /end COMPU_METHOD
/begin COMPU_METHOD COMPU_METHOD__15 "" TAB_VERB "%4.0" "" COMPU_TAB_REF COMPU_VTAB__2 /end COMPU_METHOD
/begin COMPU_METHOD COMPU_METHOD__13 "" TAB_VERB "%6.0" "" COMPU_TAB_REF COMPU_VTAB__1 /end COMPU_METHOD
/begin COMPU_VTAB COMPU_VTAB__3 "" TAB_VERB 13 0 "Initialization" 1 "Loaded Defaults - Manual" 2 "Loaded Defaults - After Reprogramming" 3 "Loaded Defaults - Incorrect CRC" 4 "Loaded Defaults - Incorrect EE Format" 5 "Loaded Defaults - Error Reading EEPROM" 6 "Loaded Defaults - Failed Driver Initialization" 7 "Loaded Saved Values - After Reprogramming" 8 "Loaded Saved Values - Normal Startup" 9 "Loaded Saved Values - Backup Copy" 10 "Store In Progess" 11 "Store Attempt Failed" 12 "Store Succeeded" /end COMPU_VTAB
/begin COMPU_VTAB COMPU_VTAB__1 "" TAB_VERB 2 0 "None" 20038 "Lite" /end COMPU_VTAB
/begin COMPU_VTAB COMPU_VTAB__2 "" TAB_VERB 22 0 "UNKNOWN_RESET" 160 "POWER_OFF_RESET" 176 "BOOT_REQUEST" 208 "PROCESSOR_EXCEPTION" 209 "UNHANDLED_ISR_EXCEPTION" 210 "WATCHDOG_EXCPTION" 211 "STACK_OVERFLOW" 224 "IVOR0_TRAP" 225 "MACHINE_CHECK" 226 "IVOR2_TRAP" 227 "IVOR3_TRAP" 229 "IVOR5_TRAP" 230 "IVOR6_TRAP" 231 "IVOR7_TRAP" 232 "IVOR8_TRAP" 233 "IVOR9_TRAP" 234 "IVOR10_TRAP" 235 "IVOR11_TRAP" 236 "IVOR12_TRAP" 237 "IVOR13_TRAP" 238 "IVOR14_TRAP" 239 "IVOR15_TRAP" /end COMPU_VTAB
/begin MEASUREMENT dt_read "" ULONG COMPU_METHOD__2 0 0 0 4294967295 ECU_ADDRESS 0x40000FA8 /begin FUNCTION_LIST PowerUp_Down /end FUNCTION_LIST /end MEASUREMENT
/begin MEASUREMENT EEPROM_State "EEPROM State on startup." UBYTE COMPU_METHOD__16 0 0 0 255 ECU_ADDRESS 0x40000FCC /begin FUNCTION_LIST System /end FUNCTION_LIST /end MEASUREMENT
/begin MEASUREMENT FgndTasksStopped "Boolean indicating foreground tasks stopped" UBYTE COMPU_METHOD__1 0 0 0 1 ECU_ADDRESS 0x40000F89 /begin FUNCTION_LIST PowerUp_Down /end FUNCTION_LIST /end MEASUREMENT
/begin MEASUREMENT KeepModuleOn "Boolean indicating module to be kept on" UBYTE COMPU_METHOD__1 0 0 0 1 ECU_ADDRESS 0x40000FB7 /begin FUNCTION_LIST PowerUp_Down /end FUNCTION_LIST /end MEASUREMENT
/begin MEASUREMENT KeySw_Bgnd "Key switch reading from background task" UBYTE COMPU_METHOD__1 0 0 0 1 ECU_ADDRESS 0x40000FB6 /begin FUNCTION_LIST PowerUp_Down /end FUNCTION_LIST /end MEASUREMENT
/begin MEASUREMENT Reset_History "Reset History." UBYTE COMPU_METHOD__15 0 0 0 255 ECU_ADDRESS 0x40001005 MATRIX_DIM 1 10 1 /begin FUNCTION_LIST Platform /end FUNCTION_LIST /end MEASUREMENT
/begin MEASUREMENT ResetReason "The last reset reason." UBYTE COMPU_METHOD__15 0 0 0 255 ECU_ADDRESS 0x40001004 /begin FUNCTION_LIST Platform /end FUNCTION_LIST /end MEASUREMENT
/begin MEASUREMENT StackMinBytesFree "The minimum amount of stack seen since reset." ULONG COMPU_METHOD__14 0 0 0 65536 ECU_ADDRESS 0x40000D08 /begin FUNCTION_LIST Platform /end FUNCTION_LIST /end MEASUREMENT
/begin MEASUREMENT Wake_AnyWakeSourceActive "bool" UBYTE COMPU_METHOD__10 0 0 0 1 ECU_ADDRESS 0x40000FB2 /begin FUNCTION_LIST PowerUp_Down /end FUNCTION_LIST /end MEASUREMENT
/begin MEASUREMENT Wake_CAN2_RxCount "" ULONG COMPU_METHOD__2 0 0 0 4294967295 ECU_ADDRESS 0x40000F9C /begin FUNCTION_LIST PowerUp_Down /end FUNCTION_LIST /end MEASUREMENT
/begin MEASUREMENT Wake_CAN2_SleepDelayTTmr "time that gets compared to Wake_CAN2_SleepDelayTime" ULONG COMPU_METHOD__3 0 0 0 429496729.5 ECU_ADDRESS 0x40000FA0 /begin FUNCTION_LIST PowerUp_Down /end FUNCTION_LIST /end MEASUREMENT
/begin MEASUREMENT Wake_Debug_StartupEventRaised "" UBYTE COMPU_METHOD__2 0 0 0 1 ECU_ADDRESS 0x40000F8A /begin FUNCTION_LIST PowerUp_Down /end FUNCTION_LIST /end MEASUREMENT
/begin MEASUREMENT Wake_DlyStopOfFgndTaskTTmr "time that gets compared to Wake_DlyStopOfFgndTaskTime" ULONG COMPU_METHOD__3 0 0 0 429496729.5 ECU_ADDRESS 0x40000F90 /begin FUNCTION_LIST PowerUp_Down /end FUNCTION_LIST /end MEASUREMENT
/begin MEASUREMENT Wake_INPUT1_Vlts "" UWORD COMPU_METHOD__7 0 0 0 607.99072265625 ECU_ADDRESS 0x40000F94 /begin FUNCTION_LIST PowerUp_Down /end FUNCTION_LIST /end MEASUREMENT
/begin MEASUREMENT Wake_LIN2_RxCount "" ULONG COMPU_METHOD__2 0 0 0 4294967295 ECU_ADDRESS 0x40000F98 /begin FUNCTION_LIST PowerUp_Down /end FUNCTION_LIST /end MEASUREMENT
/begin MEASUREMENT Wake_LIN2_SleepDelayTTmr "time that gets compared to Wake_LIN2_SleepDelayTime" ULONG COMPU_METHOD__3 0 0 0 429496729.5 ECU_ADDRESS 0x40000FA4 /begin FUNCTION_LIST PowerUp_Down /end FUNCTION_LIST /end MEASUREMENT
/begin MEASUREMENT Wake_SourceBitAndWakeConfigRegister "" UWORD COMPU_METHOD__2 0 0 0 65535 ECU_ADDRESS 0x40000FB0 /begin FUNCTION_LIST PowerUp_Down /end FUNCTION_LIST /end MEASUREMENT
/begin MEASUREMENT WakeConfigRegister "" UWORD COMPU_METHOD__8 0 0 0 65535 ECU_ADDRESS 0x40000FAC /begin FUNCTION_LIST PowerUp_Down /end FUNCTION_LIST /end MEASUREMENT
/begin MEASUREMENT WakeSource_Current "" UWORD COMPU_METHOD__11 0 0 0 65535 ECU_ADDRESS 0x40000FB4 /begin FUNCTION_LIST PowerUp_Down /end FUNCTION_LIST /end MEASUREMENT
/begin MEASUREMENT WakeSource_RaptorIntrnlMeas "" UWORD COMPU_METHOD__9 0 0 0 65535 ECU_ADDRESS 0x40000FAE /begin FUNCTION_LIST PowerUp_Down /end FUNCTION_LIST /end MEASUREMENT
/begin MEASUREMENT WakeSource_Startup "" UWORD COMPU_METHOD__2 0 0 0 65535 ECU_ADDRESS 0x40000F8C /begin FUNCTION_LIST PowerUp_Down /end FUNCTION_LIST /end MEASUREMENT
/begin CHARACTERISTIC BuildNumber "Model build number." VALUE 0x00045878 RECORD_LAYOUT__1 0 COMPU_METHOD__12 0 4294967295 READ_ONLY /end CHARACTERISTIC
/begin CHARACTERISTIC BuildUID "Unique build ID for this software." ASCII 0x00045905 RECORD_LAYOUT__3 0 COMPU_METHOD__12 0 255 READ_ONLY MATRIX_DIM 21 1 1 /end CHARACTERISTIC
/begin CHARACTERISTIC CalIdTxt "Calibration ID for this Software Package." ASCII 0x000458CF RECORD_LAYOUT__3 0 COMPU_METHOD__12 0 255 MATRIX_DIM 54 1 1 /end CHARACTERISTIC
/begin CHARACTERISTIC CAN1__XCP_BC_ID "CAN message ID used to identify XCP targets on the CAN bus. This should be the same for all ECUs on the CAN bus. This is how Raptor-Cal discovers ECUs on the CAN bus." VALUE 0x0003CFA4 RECORD_LAYOUT__1 0 COMPU_METHOD__2 0 4294967295 /begin FUNCTION_LIST XCP /end FUNCTION_LIST /end CHARACTERISTIC
/begin CHARACTERISTIC CAN1__XCP_RX_ID "CAN message ID that the module will receive CMD and STIM commands from the calibration tool on." VALUE 0x0003CFA8 RECORD_LAYOUT__1 0 COMPU_METHOD__2 0 4294967295 /begin FUNCTION_LIST XCP /end FUNCTION_LIST /end CHARACTERISTIC
/begin CHARACTERISTIC CAN1__XCP_Security "Calibration to change XCP security, takes effect at next power-up." VALUE 0x0003CFB0 RECORD_LAYOUT__2 0 COMPU_METHOD__13 0 65535 /begin FUNCTION_LIST XCP /end FUNCTION_LIST /end CHARACTERISTIC
/begin CHARACTERISTIC CAN1__XCP_TX_ID "CAN message ID that the module will send RES, ERR, EV, SERV and DAQ commands to the calibration tool on." VALUE 0x0003CFAC RECORD_LAYOUT__1 0 COMPU_METHOD__2 0 4294967295 /begin FUNCTION_LIST XCP /end FUNCTION_LIST /end CHARACTERISTIC
/begin CHARACTERISTIC DateStamp "Date and time the model was built." ASCII 0x00045920 RECORD_LAYOUT__3 0 COMPU_METHOD__12 0 255 READ_ONLY MATRIX_DIM 20 1 1 /end CHARACTERISTIC
/begin CHARACTERISTIC GCM48Wake_CAN2_cal "1 configures the module to wake via this input, 0 ignores this input" VALUE 0x0003CF9D RECORD_LAYOUT__3 0 COMPU_METHOD__6 0 1 /begin FUNCTION_LIST PowerUp_Down /end FUNCTION_LIST /end CHARACTERISTIC
/begin CHARACTERISTIC GCM48Wake_INPUT1_cal "1 configures the module to wake via this input, 0 ignores this input" VALUE 0x0003CF9E RECORD_LAYOUT__3 0 COMPU_METHOD__6 0 1 /begin FUNCTION_LIST PowerUp_Down /end FUNCTION_LIST /end CHARACTERISTIC
/begin CHARACTERISTIC GCM48Wake_LIN2_cal "1 configures the module to wake via this input, 0 ignores this input" VALUE 0x0003CF9C RECORD_LAYOUT__3 0 COMPU_METHOD__6 0 1 /begin FUNCTION_LIST PowerUp_Down /end FUNCTION_LIST /end CHARACTERISTIC
/begin CHARACTERISTIC HardwareType "Hardware type for the target." VALUE 0x0004591C RECORD_LAYOUT__1 0 COMPU_METHOD__12 0 4294967295 READ_ONLY /end CHARACTERISTIC
/begin CHARACTERISTIC IdTableRev "IdTableRev for the model (XCP device ids)." VALUE 0x0004591A RECORD_LAYOUT__2 0 COMPU_METHOD__12 0 65535 READ_ONLY /end CHARACTERISTIC
/begin CHARACTERISTIC KeySwLoTimeThr "State low time threshold" VALUE 0x0003CF98 RECORD_LAYOUT__1 0 COMPU_METHOD__5 0 4294967295 /begin FUNCTION_LIST PowerUp_Down /end FUNCTION_LIST /end CHARACTERISTIC
/begin CHARACTERISTIC LiteModeKey "Indicates that the build was produced with Lite mode." VALUE 0x00045934 RECORD_LAYOUT__1 0 COMPU_METHOD__12 0 4294967295 READ_ONLY /end CHARACTERISTIC
/begin CHARACTERISTIC MatlabVersion "Matlab version used for build." ASCII 0x0004587C RECORD_LAYOUT__3 0 COMPU_METHOD__12 0 255 READ_ONLY MATRIX_DIM 13 1 1 /end CHARACTERISTIC
/begin CHARACTERISTIC ModelName "Name of model" ASCII 0x00045848 RECORD_LAYOUT__3 0 COMPU_METHOD__12 0 255 READ_ONLY MATRIX_DIM 46 1 1 /end CHARACTERISTIC
/begin CHARACTERISTIC RaptorVersion "Raptor version used for build." ASCII 0x00045889 RECORD_LAYOUT__3 0 COMPU_METHOD__12 0 255 READ_ONLY MATRIX_DIM 20 1 1 /end CHARACTERISTIC
/begin CHARACTERISTIC SwIdTxt "Software name for this build." ASCII 0x0004589D RECORD_LAYOUT__3 0 COMPU_METHOD__12 0 255 READ_ONLY MATRIX_DIM 50 1 1 /end CHARACTERISTIC
/begin CHARACTERISTIC Wake_CAN2_SleepDelayTime "make sure this is long enough that we dont trigger a ton of EEPROM writes between messages" VALUE 0x0003CF94 RECORD_LAYOUT__1 0 COMPU_METHOD__3 0 429496729.5 /begin FUNCTION_LIST PowerUp_Down /end FUNCTION_LIST /end CHARACTERISTIC
/begin CHARACTERISTIC Wake_DlyStopOfFgndTaskTime "When key switch goes false, the foreground task will be held on for this amount of time to allow low side outputs to turn off" VALUE 0x0003CFA0 RECORD_LAYOUT__1 0 COMPU_METHOD__3 0 429496729.5 /begin FUNCTION_LIST PowerUp_Down /end FUNCTION_LIST /end CHARACTERISTIC
/begin CHARACTERISTIC WAKE_INPUT1_Threshold "The value of WAKE_INPUT1 analog to set key switch to true." VALUE 0x0003CF8C RECORD_LAYOUT__2 0 COMPU_METHOD__4 0 65535 /begin FUNCTION_LIST PowerUp_Down /end FUNCTION_LIST /end CHARACTERISTIC
/begin CHARACTERISTIC Wake_LIN2_SleepDelayTime "make sure this is long enough that we dont trigger a ton of EEPROM writes between messages" VALUE 0x0003CF90 RECORD_LAYOUT__1 0 COMPU_METHOD__3 0 429496729.5 /begin FUNCTION_LIST PowerUp_Down /end FUNCTION_LIST /end CHARACTERISTIC
/begin FUNCTION System "System" /begin SUB_FUNCTION Platform PowerUp_Down XCP /end SUB_FUNCTION /end FUNCTION
/begin FUNCTION Platform "Platform" /end FUNCTION
/begin FUNCTION PowerUp_Down "PowerUp_Down" /end FUNCTION
/begin FUNCTION XCP "XCP" /end FUNCTION
/begin USER_RIGHTS Access4 /begin REF_GROUP GroupAccess4 /end REF_GROUP /end USER_RIGHTS
/begin USER_RIGHTS Access2 /begin REF_GROUP GroupAccess2 /end REF_GROUP /end USER_RIGHTS
/begin USER_RIGHTS Access1 /begin REF_GROUP GroupAccess1 /end REF_GROUP /end USER_RIGHTS
/begin GROUP GroupAccess1
 /begin REF_CHARACTERISTIC CAN1__XCP_BC_ID CAN1__XCP_RX_ID CAN1__XCP_TX_ID ModelName BuildNumber MatlabVersion RaptorVersion SwIdTxt CalIdTxt BuildUID IdTableRev HardwareType DateStamp LiteModeKey CAN1__XCP_Security /end REF_CHARACTERISTIC
 /begin REF_MEASUREMENT StackMinBytesFree Reset_History ResetReason EEPROM_State /end REF_MEASUREMENT
/end GROUP
/begin GROUP GroupAccess2
 /begin REF_MEASUREMENT Wake_SourceBitAndWakeConfigRegister Wake_AnyWakeSourceActive WakeSource_Current KeepModuleOn /end REF_MEASUREMENT
/end GROUP
/begin GROUP GroupAccess4
 /begin REF_CHARACTERISTIC Wake_LIN2_SleepDelayTime Wake_CAN2_SleepDelayTime WAKE_INPUT1_Threshold KeySwLoTimeThr GCM48Wake_LIN2_cal GCM48Wake_CAN2_cal GCM48Wake_INPUT1_cal Wake_DlyStopOfFgndTaskTime /end REF_CHARACTERISTIC
 /begin REF_MEASUREMENT FgndTasksStopped Wake_Debug_StartupEventRaised WakeSource_Startup Wake_DlyStopOfFgndTaskTTmr Wake_INPUT1_Vlts Wake_LIN2_RxCount Wake_CAN2_RxCount Wake_CAN2_SleepDelayTTmr Wake_LIN2_SleepDelayTTmr dt_read WakeConfigRegister WakeSource_RaptorIntrnlMeas KeySw_Bgnd /end REF_MEASUREMENT
/end GROUP
/end MODULE
/end PROJECT
